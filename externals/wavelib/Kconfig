## sdk/bsp/Kconfig
```kconfig
#
# For a description of the syntax of this configuration file,
# see the file kconfig-language.txt in the NuttX tools repository.
#

menu "Board Configuration"

choice
	prompt "Board Selection"
	default BOARD_SPRESENSE

	config BOARD_SPRESENSE
		bool "SPRESENSE"

	config BOARD_CORVO
		bool "Corvo"

	config BOARD_COLLET
		bool "Collet"

endchoice

comment "Board-Specific Options"

config BOARD_NAME
	string
	default "corvo" if BOARD_CORVO
	default "collet" if BOARD_COLLET
	default "spresense" if BOARD_SPRESENSE

source "$SDKDIR/bsp/board/corvo/Kconfig"
source "$SDKDIR/bsp/board/collet/Kconfig"
source "$SDKDIR/bsp/board/spresense/Kconfig"

endmenu

menu "CXD56xx Configuration"

choice
	prompt "CXD56xx package selection"
	default CXD56_FCBGA if !CXD56_100PIN
	default CXD56_WLCSP if CXD56_100PIN

config CXD56_FCBGA
	bool "FCBGA 185 pin package"

config CXD56_WLCSP
	bool "WLCSP 100 pin package"

endchoice

comment "Basic Options"

config CXD56_XOSC_CLOCK
	int
	default 26000000

config CXD56_SPH
	bool
	default y if ASMP

config CXD56_PMIC
	bool
	default y

config CXD56_CPUFIFO
	bool

config CXD56_ICC
	bool
	default y

config CXD56_FARAPI
	bool
	default y
	select CXD56_CPUFIFO

menu "Far API Configuration"
	depends on CXD56_FARAPI

config CXD56_FARAPI_VERSION_CHECK
	bool "Far API Version Compatibility Check"
	default y
	---help---
		Enable the Far API version compatibility check. If the version
		mismatch is deteced during system bootup, the target system shows
		the message to update the loader and gnssfw firmwares.

if CXD56_FARAPI_VERSION_CHECK

config CXD56_FARAPI_VERSION_FAILED_PANIC
	bool "Far API Version Check Failed to PANIC"
	default n
	---help---
		If the version mismatch is deteced, do PANIC() to stop the system.

endif

config CXD56_FARAPI_DEBUG
	bool "Debug Far API"

endmenu # Far API Configuration

comment "Timer Options"

config CXD56_RTC
	bool "Real Time Clock (RTC)"
	default y
	---help---
		Support RTC

menuconfig CXD56_TIMER
	bool "Timer"
	default y

if CXD56_TIMER

choice
	prompt "Timer divider selection"
	default CXD56_TIMER_DIVIDER_1
	---help---
		Timer divider selects 1, 16 or 256. The smaller the divider, the higher
		time resolution, but the shorter the maximum time until wrap-around.

config CXD56_TIMER_DIVIDER_1
	bool "Divider 1"

config CXD56_TIMER_DIVIDER_16
	bool "Divider 16"

config CXD56_TIMER_DIVIDER_256
	bool "Divider 256"

endchoice

endif # CXD56_TIMER

menuconfig CXD56_WDT
	bool "Watchdog Timer (WDT)"
	default y

if CXD56_WDT

config CXD56_WDT_INTERRUPT
	bool "Interrupt on timeout"
	default y
	---help---
		This watchdog timer run 2 laps as long as the counter is not reloaded.
		In the first lap, the watchdog interrupt occurs. Without interrupt
		clear, The reset signal is asserted in the second timeout. This setting
		enables the first interrupt.

config CXD56_WDT_REGDEBUG
	bool "Register level debug"
	default n
	---help---
		Enable low-level register debug output

endif # CXD56_WDT

comment "Storage Options"

menuconfig CXD56_SFC
	bool "SPI Flash"
	default y

if CXD56_SFC

config CXD56_SFC_PAGE_SHIFT_SIZE
	int "SPI Flash page shift size"
	default 12
	range 8 12
	---help---
		Specify page shift size to determine block size of SPI flash access.
		Relationship between page shift size and block size is as follows.
		  page shift size : block size
		    8 : 256
		    9 : 512
		   10 : 1024
		   11 : 2048
		   12 : 4096
		When file system is SMART file system, please set the value to SMART
		Device sector size or less.
		Following equation is satisfied.
		  MTD_SMART_SECTOR_SIZE >= (1 << CXD56_SFC_PAGE_SHIFT_SIZE)

config CXD56_SFC_VERIFY_WRITE
	bool "Enable write with verify"
	default n
	---help---
		Enalbe SPI flash write function with verify.

endif # CXD56_SFC

menuconfig CXD56_SDIO
	bool "SDIO SD Card"
	default n
	select ARCH_HAVE_SDIO

if CXD56_SDIO

config CXD56_SDIO_DMA
	bool "Support DMA data transfers"
	default y
	select SDIO_DMA
	---help---
		Support DMA data transfers.
		Enable SD card DMA data transfers.  This is marginally optional.
		For most usages, SD accesses will cause data overruns if used without
		DMA.

config CXD56_SDIO_WIDTH_D1_ONLY
	bool "Use D1 only"
	default n
	---help---
		Select 1-bit transfer mode.  Default: 4-bit transfer mode.

config CXD56_SDIO_DISABLE_CD_WP
	bool "Disable the CD and WP pin for SDIO"
	default y
	---help---
		Disable the CD and WP pin for Embedded SDIO.If the CD pin is not disable,
		the SDIO initialization will be failed.

config CXD56_SDIO_ENABLE_MULTIFUNCTION
	bool "Enable SDIO multi-function"
	default n
	---help---
		Support multi-function with SDIO interfaced peripheral other than SD Card.

endif # SDIO Configuration

menuconfig CXD56_SPISD
	bool "SPI SD Card"
	default n

if CXD56_SPISD

config CXD56_SPISD_SLOT_NO
	int "SPI SD Card Slot Number"
	default 0
	---help---
		Select spi sd card slot number.

endif # SPISD Configuration

config CXD56_EMMC
	bool "eMMC"
	default y if BOARD_CORVO

comment "Peripheral Options"

config CXD56_GPIO_IRQ
	bool "GPIO interrupt"
	default y
	---help---
		Enable support for GPIO interrupts

config CXD56_DMAC
	bool "DMAC"
	default y
	---help---
		Enables DMAC
		Currently supports SPI4 TX/RX and SPI5 TX/RX

config CXD56_UART
	bool "UART"
	default y

if CXD56_UART

config CXD56_UART1
	bool "UART1"
	default y
	---help---
		UART interface in the communication subsystem. This doesn't have any
		hardware flow control, and is mainly used for debug console.

menuconfig CXD56_UART2
	bool "UART2"
	default y
	---help---
		UART interface with hardware flow control in the application subsystem.

if CXD56_UART2

config CXD56_UART2_BASE_CLOCK_DIVIDER
	int "Base clock divider"
	default 4
	range 2 64
	---help---
		>=2 in 100MHz ADSP clock
		>=4 in 160MHz ADSP clock

endif # CXD56_UART2

endif # CXD56_UART

config CXD56_SPI
	bool "SPI"

if CXD56_SPI

config CXD56_SPI0
	bool "SPI0"

menuconfig CXD56_SPI3
	bool "SPI3"

if CXD56_SPI3

config CXD56_SPI3_SCUSEQ
	bool "SCU Sequencer"
	default y
	depends on CXD56_SCU
	---help---
		Use the sensor control unit (SCU) sequencer.

config CXD56_SPI3_CS0
	bool "SPI3 Chip Select 0"
	default y
	---help---
		Enable chip select 0 of SPI3

config CXD56_SPI3_CS1
	bool "SPI3 Chip Select 1"
	default n
	---help---
		Enable chip select 1 of SPI3

config CXD56_SPI3_CS2
	bool "SPI3 Chip Select 2"
	default n
	---help---
		Enable chip select 2 of SPI3

endif # CXD56_SPI3

menuconfig CXD56_SPI4
	bool "SPI4"

if CXD56_SPI4

config CXD56_DMAC_SPI4_TX
	bool "DMAC support for SPI4 TX"
	default n
	select CXD56_DMAC
	---help---
		Enables DMAC for SPI4 TX

if CXD56_DMAC_SPI4_TX

config CXD56_DMAC_SPI4_TX_CH
	int "TX channel"
	default 2
	range 2 6

config CXD56_DMAC_SPI4_TX_MAXSIZE
	int "Max size to be sent in bytes"
	default 192000
	range 1 1572864
	---help---
		This value should be same as RX.

endif # CXD56_DMAC_SPI4_TX

config CXD56_DMAC_SPI4_RX
	bool "DMAC support for SPI4 RX"
	default n
	select CXD56_DMAC

	---help---
		Enables DMAC for SPI4 RX

if CXD56_DMAC_SPI4_RX

config CXD56_DMAC_SPI4_RX_CH
	int "RX channel"
	default 3
	range 2 6

config CXD56_DMAC_SPI4_RX_MAXSIZE
	int "Max size to be received in bytes"
	default 192000
	range 1 1572864
	---help---
		This value should be same as TX.

endif # CXD56_DMAC_SPI4_RX

endif # CXD56_SPI4

menuconfig CXD56_SPI5
	bool "SPI5"

if CXD56_SPI5

choice
	prompt "SPI5 pin configuration"
	default CXD56_SPI5_PINMAP_EMMC

config CXD56_SPI5_PINMAP_EMMC
	bool "SPI5 pin assign to eMMC"
	---help---
		SPI5 assigns to the shared pins with eMMC.

config CXD56_SPI5_PINMAP_SDIO
	bool "SPI5 pin assign to SDIO"
	---help---
		SPI5 assigns to the shared pins with SDIO.
endchoice

config CXD56_DMAC_SPI5_TX
	bool "DMAC support for SPI5 TX"
	default n
	select CXD56_DMAC
	---help---
		Enables DMAC for SPI5 TX

if CXD56_DMAC_SPI5_TX

config CXD56_DMAC_SPI5_TX_CH
	int "TX channel"
	default 4
	range 2 6

config CXD56_DMAC_SPI5_TX_MAXSIZE
	int "Max size to be sent in bytes"
	default 1516
	range 1 1572864
	---help---
		This value should be same as RX.

endif # CXD56_DMAC_SPI5_TX

config CXD56_DMAC_SPI5_RX
	bool "DMAC support for SPI5 RX"
	default n
	select CXD56_DMAC

	---help---
		Enables DMAC for SPI5 RX

if CXD56_DMAC_SPI5_RX

config CXD56_DMAC_SPI5_RX_CH
	int "RX channel"
	default 5
	range 2 6

config CXD56_DMAC_SPI5_RX_MAXSIZE
	int "Max size to be received in bytes"
	default 1516
	range 1 1572864
	---help---
		This value should be same as TX.

endif # CXD56_DMAC_SPI5_RX

endif # CXD56_SPI5

endif

config CXD56_I2C
	bool "I2C"

if CXD56_I2C

menuconfig CXD56_I2C0
	bool "I2C0"

if CXD56_I2C0

config CXD56_I2C0_SCUSEQ
	bool "SCU Sequencer"
	default y
	depends on CXD56_SCU
	---help---
		Use the sensor control unit (SCU) sequencer.

endif # CXD56_I2C0

menuconfig CXD56_I2C1
	bool "I2C1"

if CXD56_I2C1

config CXD56_I2C1_SCUSEQ
	bool "SCU Sequencer"
	default y
	depends on CXD56_SCU
	---help---
		Use the sensor control unit (SCU) sequencer.

endif # CXD56_I2C1

config CXD56_I2C2
	bool "I2C2"

endif

config CXD56_PWM
	bool "PWM"

if CXD56_PWM

config CXD56_PWM0
	bool "PWM0"
	default n
	---help---
		Enable PWM channel 0

config CXD56_PWM1
	bool "PWM1"
	default n
	---help---
		Enable PWM channel 1

config CXD56_PWM2
	bool "PWM2"
	default n
	---help---
		Enable PWM channel 2

config CXD56_PWM3
	bool "PWM3"
	default n
	---help---
		Enable PWM channel 3

endif # CXD56_PWM

config CXD56_ADC
	bool "ADC"
	default n
	depends on CXD56_SCU
	---help---
		Support ADC interface

if CXD56_ADC

menuconfig CXD56_HPADC0
	bool "HPADC0"
	default n

if CXD56_HPADC0

config CXD56_HPADC0_FREQ
	int "Coefficient of sampling frequency"
	default 11 if CXD56_SCU_32K
	default 7 if CXD56_SCU_RCOSC
	default 7 if CXD56_SCU_XOSC
	range 9 11 if CXD56_SCU_32K
	range 7 7 if CXD56_SCU_RCOSC
	range 6 7 if CXD56_SCU_XOSC
	---help---
		This configuration set to sampling frequency calculated by the following formula.
			Sampling frequency = adc clock / 2 ^ n [Hz]
			adc clock = SCU clock     : if SCU clock is SCU32K or RCOSC.
			adc clock = SCU clock / 3 : if SCU clock is XOSC.
		Note. Setable range depends on the SCU clock mode.
			SCU32K : 9 to 11
			RCOSC  : 7 (fix)
			XOSC   : 6 to 7

config CXD56_HPADC0_OFFSET
	int "Offset"
	default 0
	range 0 65535

config CXD56_HPADC0_GAIN
	int "Gain"
	default 0
	range 0 65535

config CXD56_HPADC0_FSIZE
	int "SCU FIFO size"
	default 64
	range 2 40960
	---help---
		SCU FIFO size

endif # CXD56_HPADC0

menuconfig CXD56_HPADC1
	bool "HPADC1"
	default n

if CXD56_HPADC1

config CXD56_HPADC1_FREQ
	int "Coefficient of sampling frequency"
	default 11 if CXD56_SCU_32K
	default 7 if CXD56_SCU_RCOSC
	default 7 if CXD56_SCU_XOSC
	range 9 11 if CXD56_SCU_32K
	range 7 7 if CXD56_SCU_RCOSC
	range 6 7 if CXD56_SCU_XOSC
	---help---
		This configuration set to sampling frequency calculated by the following formula.
			Sampling frequency = adc clock / 2 ^ n [Hz]
			adc clock = SCU clock     : if SCU clock is SCU32K or RCOSC.
			adc clock = SCU clock / 3 : if SCU clock is XOSC.
		Note. Setable range depends on the SCU clock mode.
			SCU32K : 9 to 11
			RCOSC  : 7 (fix)
			XOSC   : 6 to 7

config CXD56_HPADC1_OFFSET
	int "Offset"
	default 0
	range 0 65535

config CXD56_HPADC1_GAIN
	int "Gain"
	default 0
	range 0 65535

config CXD56_HPADC1_FSIZE
	int "SCU FIFO size"
	default 64
	range 2 40960
	---help---
		SCU FIFO size

endif # CXD56_HPADC1

config CXD56_LPADC
	bool "LPADC"
	default n

if CXD56_LPADC

choice
	prompt "Select LPADC channel"
	default CXD56_LPADC0

config CXD56_LPADC0
	bool "LPADC channel 0"
	---help---
		Enable LPADC channel 0.
		Other LPADC channel can not be used.

config CXD56_LPADC1
	bool "LPADC channel 1"
	---help---
		Enable LPADC channel 1.
		Other LPADC channel can not be used.

config CXD56_LPADC2
	bool "LPADC channel 2"
	---help---
		Enable LPADC channel 2.
		Other LPADC channel can not be used.

config CXD56_LPADC3
	bool "LPADC channel 3"
	---help---
		Enable LPADC channel 3.
		Other LPADC channel can not be used.

config CXD56_LPADC0_1
	bool "LPADC channel 0 and channel 1"
	---help---
		Enable LPADC channel 0 and LPADC channel 1.
		Switch the LPADC channel 0 sampling and LPADC channel 1 sampling in time division.

config CXD56_LPADC_ALL
	bool "LPADC all channels"
	---help---
		Enable LPADC all channels.
		Switch the LPADC all channels sampling in time division.
endchoice

menu "LADC0"
	depends on CXD56_LPADC0

config CXD56_LPADC0_FREQ
	int "Coefficient of sampling frequency"
	default 12
	range 11 15 if CXD56_SCU_32K
	range 3 15 if CXD56_SCU_RCOSC
	range 2 15 if CXD56_SCU_XOSC
	---help---
		This configuration set to sampling frequency calculated by the following formula.
			Sampling frequency = SCU32K / 2 ^ n [Hz]
		Note. Setable range depends on the SCU clock mode.
			SCU32K : 11 to 15
			RCOSC  :  3 to 15
			XOSC   :  2 to 15

config CXD56_LPADC0_OFFSET
	int "Offset"
	default 0
	range 0 65535

config CXD56_LPADC0_GAIN
	int "Gain"
	default 0
	range 0 65535

config CXD56_LPADC0_FSIZE
	int "SCU FIFO size"
	default 16
	range 2 40960
	---help---
		SCU FIFO size

endmenu # CXD56_LPADC0

menu "LADC1"
	depends on CXD56_LPADC1

config CXD56_LPADC1_FREQ
	int "Coefficient of sampling frequency"
	default 12
	range 11 15 if CXD56_SCU_32K
	range 3 15 if CXD56_SCU_RCOSC
	range 2 15 if CXD56_SCU_XOSC
	---help---
		This configuration set to sampling frequency calculated by the following formula.
			Sampling frequency = SCU32K / 2 ^ n [Hz]
		Note. Setable range depends on the SCU clock mode.
			SCU32K : 11 to 15
			RCOSC  :  3 to 15
			XOSC   :  2 to 15

config CXD56_LPADC1_OFFSET
	int "Offset"
	default 0
	range 0 65535

config CXD56_LPADC1_GAIN
	int "Gain"
	default 0
	range 0 65535

config CXD56_LPADC1_FSIZE
	int "SCU FIFO size"
	default 16
	range 2 40960
	---help---
		SCU FIFO size

endmenu # CXD56_LPADC1

menu "LADC2"
	depends on CXD56_LPADC2

config CXD56_LPADC2_FREQ
	int "Coefficient of sampling frequency"
	default 12
	range 11 15 if CXD56_SCU_32K
	range 3 15 if CXD56_SCU_RCOSC
	range 2 15 if CXD56_SCU_XOSC
	---help---
		This configuration set to sampling frequency calculated by the following formula.
			Sampling frequency = SCU32K / 2 ^ n [Hz]
		Note. Setable range depends on the SCU clock mode.
			SCU32K : 11 to 15
			RCOSC  :  3 to 15
			XOSC   :  2 to 15

config CXD56_LPADC2_OFFSET
	int "Offset"
	default 0
	range 0 65535

config CXD56_LPADC2_GAIN
	int "Gain"
	default 0
	range 0 65535

config CXD56_LPADC2_FSIZE
	int "SCU FIFO size"
	default 16
	range 2 40960
	---help---
		SCU FIFO size

endmenu # CXD56_LPADC2

menu "LADC3"
	depends on CXD56_LPADC3

config CXD56_LPADC3_FREQ
	int "Coefficient of sampling frequency"
	default 12
	range 11 15 if CXD56_SCU_32K
	range 3 15 if CXD56_SCU_RCOSC
	range 2 15 if CXD56_SCU_XOSC
	---help---
		This configuration set to sampling frequency calculated by the following formula.
			Sampling frequency = SCU32K / 2 ^ n [Hz]
		Note. Setable range depends on the SCU clock mode.
			SCU32K : 11 to 15
			RCOSC  :  3 to 15
			XOSC   :  2 to 15

config CXD56_LPADC3_OFFSET
	int "Offset"
	default 0
	range 0 65535

config CXD56_LPADC3_GAIN
	int "Gain"
	default 0
	range 0 65535

config CXD56_LPADC3_FSIZE
	int "SCU FIFO size"
	default 16
	range 2 40960
	---help---
		SCU FIFO size

endmenu # CXD56_LPADC3

menu "LADC0"
	depends on CXD56_LPADC0_1

config CXD56_LPADC0_FREQ
	int "Coefficient of sampling frequency"
	default 12
	range 12 15 if CXD56_SCU_32K
	range 6 15 if CXD56_SCU_RCOSC
	range 6 15 if CXD56_SCU_XOSC
	---help---
		This configuration set to sampling frequency calculated by the following formula.
			Sampling frequency = SCU32K / 2 ^ (n+1) [Hz]
		Note. Setable range depends on the SCU clock mode.
			SCU32K : 12 to 15
			RCOSC  :  6 to 15
			XOSC   :  6 to 15

config CXD56_LPADC0_OFFSET
	int "Offset"
	default 0
	range 0 65535

config CXD56_LPADC0_GAIN
	int "Gain"
	default 0
	range 0 65535

config CXD56_LPADC0_FSIZE
	int "SCU FIFO size"
	default 16
	range 2 40960
	---help---
		SCU FIFO size

endmenu # CXD56_LPADC0_1

menu "LADC1"
	depends on CXD56_LPADC0_1

config CXD56_LPADC1_FREQ
	int "Coefficient of sampling frequency"
	default 12
	range 12 15 if CXD56_SCU_32K
	range 6 15 if CXD56_SCU_RCOSC
	range 6 15 if CXD56_SCU_XOSC
	---help---
		This configuration set to sampling frequency calculated by the following formula.
			Sampling frequency = SCU32K / 2 ^ (n+1) [Hz]
		Note. Setable range depends on the SCU clock mode.
			SCU32K : 12 to 15
			RCOSC  :  6 to 15
			XOSC   :  6 to 15

config CXD56_LPADC1_OFFSET
	int "Offset"
	default 0
	range 0 65535

config CXD56_LPADC1_GAIN
	int "Gain"
	default 0
	range 0 65535

config CXD56_LPADC1_FSIZE
	int "SCU FIFO size"
	default 16
	range 2 40960
	---help---
		SCU FIFO size

endmenu # CXD56_LPADC0_1

menu "LADC0"
	depends on CXD56_LPADC_ALL

config CXD56_LPADC0_FREQ
	int "Coefficient of sampling frequency"
	default 12
	range 11 15 if CXD56_SCU_32K
	range 7 15 if CXD56_SCU_RCOSC
	range 7 15 if CXD56_SCU_XOSC
	---help---
		This configuration set to sampling frequency calculated by the following formula.
			Sampling frequency = SCU32K / 2 ^ (n+2) [Hz]
		Note. Setable range depends on the SCU clock mode.
			SCU32K : 11 to 15
			RCOSC  :  7 to 15
			XOSC   :  7 to 15

config CXD56_LPADC0_OFFSET
	int "Offset"
	default 0
	range 0 65535

config CXD56_LPADC0_GAIN
	int "Gain"
	default 0
	range 0 65535

config CXD56_LPADC0_FSIZE
	int "SCU FIFO size"
	default 16
	range 2 40960
	---help---
		SCU FIFO size

endmenu # CXD56_LPADC_ALL

menu "LADC1"
	depends on CXD56_LPADC_ALL

config CXD56_LPADC1_FREQ
	int "Coefficient of sampling frequency"
	default 12
	range 11 15 if CXD56_SCU_32K
	range 7 15 if CXD56_SCU_RCOSC
	range 7 15 if CXD56_SCU_XOSC
	---help---
		This configuration set to sampling frequency calculated by the following formula.
			Sampling frequency = SCU32K / 2 ^ (n+2) [Hz]
		Note. Setable range depends on the SCU clock mode.
			SCU32K : 11 to 15
			RCOSC  :  7 to 15
			XOSC   :  7 to 15

config CXD56_LPADC1_OFFSET
	int "Offset"
	default 0
	range 0 65535

config CXD56_LPADC1_GAIN
	int "Gain"
	default 0
	range 0 65535

config CXD56_LPADC1_FSIZE
	int "SCU FIFO size"
	default 16
	range 2 40960
	---help---
		SCU FIFO size

endmenu # CXD56_LPADC_ALL

menu "LADC2"
	depends on CXD56_LPADC_ALL

config CXD56_LPADC2_FREQ
	int "Coefficient of sampling frequency"
	default 12
	range 11 15 if CXD56_SCU_32K
	range 7 15 if CXD56_SCU_RCOSC
	range 7 15 if CXD56_SCU_XOSC
	---help---
		This configuration set to sampling frequency calculated by the following formula.
			Sampling frequency = SCU32K / 2 ^ (n+2) [Hz]
		Note. Setable range depends on the SCU clock mode.
			SCU32K : 11 to 15
			RCOSC  :  7 to 15
			XOSC   :  7 to 15

config CXD56_LPADC2_OFFSET
	int "Offset"
	default 0
	range 0 65535

config CXD56_LPADC2_GAIN
	int "Gain"
	default 0
	range 0 65535

config CXD56_LPADC2_FSIZE
	int "SCU FIFO size"
	default 16
	range 2 40960
	---help---
		SCU FIFO size

endmenu # CXD56_LPADC_ALL

menu "LADC3"
	depends on CXD56_LPADC_ALL

config CXD56_LPADC3_FREQ
	int "Coefficient of sampling frequency"
	default 12
	range 11 15 if CXD56_SCU_32K
	range 7 15 if CXD56_SCU_RCOSC
	range 7 15 if CXD56_SCU_XOSC
	---help---
		This configuration set to sampling frequency calculated by the following formula.
			Sampling frequency = SCU32K / 2 ^ (n+2) [Hz]
		Note. Setable range depends on the SCU clock mode.
			SCU32K : 11 to 15
			RCOSC  :  7 to 15
			XOSC   :  7 to 15

config CXD56_LPADC3_OFFSET
	int "Offset"
	default 0
	range 0 65535

config CXD56_LPADC3_GAIN
	int "Gain"
	default 0
	range 0 65535

config CXD56_LPADC3_FSIZE
	int "SCU FIFO size"
	default 16
	range 2 40960
	---help---
		SCU FIFO size

endmenu # CXD56_LPADC_ALL

endif # CXD56_LPADC

endif # CXD56_ADC

menuconfig CXD56_SCU
	bool "Sensor Control Unit (SCU)"
	default y

if CXD56_SCU

config CXD56_SCU_PREDIV
	int "Sequencer Sampling Predivider"
	default 64
	range 1 256
	---help---
	  This configuration ralated to maximum sampling rate based on 32.768KHz.
	  e.g. 32768 / 64 = 512 (samples)

choice
	prompt "SCU clock mode"
	default CXD56_SCU_RCOSC

config CXD56_SCU_32K
	bool "Same with SCU32K"

config CXD56_SCU_RCOSC
	bool "RCOSC"

config CXD56_SCU_XOSC
	bool "XOSC"
endchoice

if CXD56_SCU_XOSC
config CXD56_SCU_XOSC_DIV
	int "SCU XOSC predivider"
	default 2
	range 1 4
endif

choice
	prompt "SCU32K clock source"
	default CXD56_SCU32K_RTC

config CXD56_SCU32K_RCRTC
	bool "RCRTC"

config CXD56_SCU32K_RTC
	bool "RTC"
endchoice

menu "SCU Decimator assignments"

config CXD56_DECI_GYRO
	bool "BMI160 Gyroscope to decimator"
	default n

config CXD56_DECI_ACCEL
	bool "BMI160 Accelerometer to decimator"
	default n

config CXD56_DECI_AK09912
	bool "AK09912 Magnetometer to decimator"
	default n

config CXD56_DECI_KX022
	bool "KX022 Accelerometer to decimator"
	default n

config CXD56_DECI_BM1422GMV
	bool "BM1422GMV Magnetometer to decimator"
	default n

endmenu

config CXD56_SCU_DEBUG
	bool "SCU Debug"
	default n

config CXD56_SCU_DEBUG_ERR
	bool "Error Messages"
	default n
	depends on CXD56_SCU_DEBUG

config CXD56_SCU_DEBUG_WARN
	bool "Warning Messages"
	default n
	depends on CXD56_SCU_DEBUG_ERR

config CXD56_SCU_DEBUG_INFO
	bool "Info Messages"
	default n
	depends on CXD56_SCU_DEBUG_WARN

config CXD56_UDMAC
	bool "DMAC support"
	default y
	select ARCH_DMA
	---help---
		Use DMAC for reading sensing data from SCU FIFO.

endif # CXD56_SCU

config CXD56_CISIF
	bool "CMOS image sensor interface"
	default n
	---help---
		TODO

comment "Audio Options"

menuconfig CXD56_AUDIO
	bool "Audio"
	default n

if CXD56_AUDIO

config CXD56_I2S0
	bool "I2S0"
	default y
	---help---
		Enable I2S channel 0

config CXD56_I2S1
	bool "I2S1"
	default n
	---help---
		Enable I2S channel 1

menu "Audio baseband config settings"

choice
	prompt "Audio analog block selection"
	default CXD56_AUDIO_ANALOG_CXD5247

config CXD56_AUDIO_ANALOG_CXD5247
	bool "CXD5247"

config CXD56_AUDIO_ANALOG_NONE
	bool "System does not use audio analog block"
endchoice

if CXD56_AUDIO_ANALOG_CXD5247
menu "CXD5247 settings"
choice
	prompt "X'tal frequency of the CXD5247"
	default CXD56_AUDIO_XTAL_SEL_49_152MHZ

config CXD56_AUDIO_XTAL_SEL_24_576MHZ
	bool "24.576MHz"

config CXD56_AUDIO_XTAL_SEL_49_152MHZ
	bool "49.152MHz"
endchoice

choice
	prompt "MICBIAS voltage of the CXD5247"
	default CXD56_AUDIO_MICBIAS_20V

config CXD56_AUDIO_MICBIAS_20V
	bool "2.0V"

config CXD56_AUDIO_MICBIAS_28V
	bool "2.8V"
endchoice

config CXD56_AUDIO_MIC_CHANNEL_SEL
	hex "MIC channel select map"
	default 0xFFFF4321
	range 0 0xFFFFFFFF
	---help---
		This designates microphone input of the CXD5247 in matrix format.
		One microphone can be assigned to multiple channels (CHs.)
		(Example: When DMA transfer is performed in monaural mode,
		AMIC1 is assigned to CH1 and CH2 and the same audio data is
		transferred to the each channel)

choice
	prompt "Output drive strength of MCLKOUT selection"
	default CXD56_AUDIO_MCLKOUT_WEAKEST

config CXD56_AUDIO_MCLKOUT_WEAKEST
	bool "2mA"

config CXD56_AUDIO_MCLKOUT_WEAKER
	bool "4mA"

config CXD56_AUDIO_MCLKOUT_STRONGER
	bool "6mA"

config CXD56_AUDIO_MCLKOUT_STRONGEST
	bool "8mA"
endchoice

choice
	prompt "Output drive strength of CLKOUT_DMIC selection"
	default CXD56_AUDIO_CLKOUT_DMIC_WEAKEST

config CXD56_AUDIO_CLKOUT_DMIC_WEAKEST
	bool "2mA"

config CXD56_AUDIO_CLKOUT_DMIC_WEAKER
	bool "4mA"

config CXD56_AUDIO_CLKOUT_DMIC_STRONGER
	bool "6mA"

config CXD56_AUDIO_CLKOUT_DMIC_STRONGEST
	bool "8mA"
endchoice

choice
	prompt "Output drive strength of DA_DATA selection"
	default CXD56_AUDIO_DA_DATA_WEAKEST

config CXD56_AUDIO_DA_DATA_WEAKEST
	bool "2mA"

config CXD56_AUDIO_DA_DATA_WEAKER
	bool "4mA"

config CXD56_AUDIO_DA_DATA_STRONGER
	bool "6mA"

config CXD56_AUDIO_DA_DATA_STRONGEST
	bool "8mA"
endchoice

choice
	prompt "Output drive strength of GPO_A selection"
	default CXD56_AUDIO_GPO_A_WEAKEST

config CXD56_AUDIO_GPO_A_WEAKEST
	bool "2mA"

config CXD56_AUDIO_GPO_A_WEAKER
	bool "4mA"

config CXD56_AUDIO_GPO_A_STRONGER
	bool "6mA"

config CXD56_AUDIO_GPO_A_STRONGEST
	bool "8mA"
endchoice

choice
	prompt "Input source of Cascaded Integrator-Comb filter selection"
	default CXD56_AUDIO_CIC_IN_SEL_CXD

config CXD56_AUDIO_CIC_IN_SEL_CXD
	bool "from CXD5247"

config CXD56_AUDIO_CIC_IN_SEL_DMIC
	bool "from DMIC"

config CXD56_AUDIO_CIC_IN_SEL_NONE
	bool "No Cascaded Integrator-Comb filter input"
endchoice

choice
	prompt "Drive currents of PDM signals"
	default CXD56_AUDIO_PDM_LOWEMI_2MA

config CXD56_AUDIO_PDM_LOWEMI_2MA
	bool "2mA"

config CXD56_AUDIO_PDM_LOWEMI_4MA
	bool "4mA"
endchoice

choice
	prompt "HPADC mic bias selection"
	default CXD56_AUDIO_HPADC_MIC_BIAS_OFF
	---help---
		This setting depends on a circuit board configration. 
		Set "Microphone bias is enabled" when a microphone connected to
		HPADC should be applied with voltage from the CXD5247.
		Otherwise, set "Microphone bias is disabled".

config CXD56_AUDIO_HPADC_MIC_BIAS_ON
	bool "Microphone bias is enabled"

config CXD56_AUDIO_HPADC_MIC_BIAS_OFF
	bool "Microphone bias is disabled"
endchoice

choice
	prompt "Version of the CXD5247"
	default CXD56_CXD5247_VER_ES4

config CXD56_CXD5247_VER_ES2
	bool "ES Version 2.0"

config CXD56_CXD5247_VER_ES3
	bool "ES Version 3.0"

config CXD56_CXD5247_VER_ES4
	bool "ES Version 4.0"
endchoice

if CXD56_CXD5247_VER_ES4
choice
	prompt "Speaker time split on drive selection"
	default CXD56_AUDIO_SP_SPLIT_SHORTEST

config CXD56_AUDIO_SP_SPLIT_SHORTEST
	bool "shortest"

config CXD56_AUDIO_SP_SPLIT_SHORT
	bool "short"

config CXD56_AUDIO_SP_SPLIT_LONG
	bool "long"

config CXD56_AUDIO_SP_SPLIT_LONGEST
	bool "longest"
endchoice

choice
	prompt "Speaker drive mode selection"
	default CXD56_AUDIO_SP_DRV_4DRIVERT

config CXD56_AUDIO_SP_DRV_4DRIVERT
	bool "4Driver(SPK)"

config CXD56_AUDIO_SP_DRV_2DRIVERT
	bool "2Driver"

config CXD56_AUDIO_SP_DRV_1DRIVERT
	bool "1Driver(HP)"

config CXD56_AUDIO_SP_DRV_LINEOUT
	bool "Lineout"
endchoice
endif # CXD56_CXD5247_VER_ES4
endmenu
endif # CXD56_AUDIO_ANALOG_CXD5247

menu "I2S settings"

if CXD56_I2S0
choice
	prompt "I2S0 device mode selection"
	default CXD56_AUDIO_I2S_DEVICE_1_SLAVE
	---help---
		This designates ports and clock modes that are connected
		as interfaces for PCM signal input and output.

config CXD56_AUDIO_I2S_DEVICE_1_SLAVE
	bool "I2S0 Slave mode"

config CXD56_AUDIO_I2S_DEVICE_1_MASTER
	bool "I2S0 Master mode"
endchoice

choice
	prompt "I2S0 format type selection"
	default CXD56_AUDIO_I2S_FORMAT_1_I2S
	---help---
		This designates the format of PCM signals on I2S.

config CXD56_AUDIO_I2S_FORMAT_1_I2S
	bool "I2S format"

config CXD56_AUDIO_I2S_FORMAT_1_LEFT
	bool "Left Justified format"
endchoice

choice
	prompt "I2S0 bypass mode selection"
	default CXD56_AUDIO_I2S_BYPASS_MODE_1_DISABLE
	---help---
		This designates the bypass mode of the sampling rate converter.
		To improve sound quality, set it to "Enable".
		The bypass mode can be enable when audio clk_mode is Hi-Res mode,
		and I2S device mode is master mode and rate is 192kHz(192000).

config CXD56_AUDIO_I2S_BYPASS_MODE_1_ENABLE
	bool "Enable bypass"

config CXD56_AUDIO_I2S_BYPASS_MODE_1_DISABLE
	bool "Disable bypass"
endchoice

config CXD56_AUDIO_I2S_RATE_1
	int "I2S0 data rate"
	default  48000
	range 48000 192000
	---help---
		This designates input and output data rate of I2S.
		The maximum rate is 192000.

endif # CXD56_I2S0

if CXD56_I2S1
choice
	prompt "I2S1 device mode selection"
	default CXD56_AUDIO_I2S_DEVICE_2_SLAVE
	---help---
		This designates ports and clock modes that are connected
		as interfaces for PCM signal input and output.

config CXD56_AUDIO_I2S_DEVICE_2_SLAVE
	bool "I2S1 Slave mode"

config CXD56_AUDIO_I2S_DEVICE_2_MASTER
	bool "I2S1 Master mode"
endchoice

choice
	prompt "I2S1 format type selection"
	default CXD56_AUDIO_I2S_FORMAT_2_I2S
	---help---
		This designates the format of PCM signals on I2S0.

config CXD56_AUDIO_I2S_FORMAT_2_I2S
	bool "I2S format"

config CXD56_AUDIO_I2S_FORMAT_2_LEFT
	bool "Left Justified format"
endchoice

choice
	prompt "I2S1 bypass mode selection"
	default CXD56_AUDIO_I2S_BYPASS_MODE_2_DISABLE
	---help---
		This designates the bypass mode of the sampling rate converter.
		To improve sound quality, set it to "Enable".
		The bypass mode can be enable when audio clk_mode is Hi-Res mode,
		and I2S device mode is master mode and rate is 192kHz(192000).

config CXD56_AUDIO_I2S_BYPASS_MODE_2_ENABLE
	bool "Enable bypass"

config CXD56_AUDIO_I2S_BYPASS_MODE_2_DISABLE
	bool "Disable bypass"
endchoice

config CXD56_AUDIO_I2S_RATE_2
	int "I2S1 data rate"
	default  48000
	range 48000 192000
	---help---
		This designates input and output data rate of I2S1.
		The maximum rate is 192000.

endif # CXD56_I2S1

choice
	prompt "Drive currents of I2S signals"
	default CXD56_AUDIO_I2S_LOWEMI_2MA

config CXD56_AUDIO_I2S_LOWEMI_2MA
	bool "2mA"

config CXD56_AUDIO_I2S_LOWEMI_4MA
	bool "4mA"
endchoice
endmenu

choice
	prompt "ON/OFF of Automatic Level Control/Sound Pressure Counter selection"
	default CXD56_AUDIO_ALC_SPC_SEL_OFF

config CXD56_AUDIO_ALC_SPC_SEL_OFF
	bool "All OFF"

config CXD56_AUDIO_ALC_SPC_SEL_ALC
	bool "Automatic Level Control ON"

config CXD56_AUDIO_ALC_SPC_SEL_SPC
	bool "Sound Pressure Counter ON"
endchoice

if CXD56_AUDIO_ALC_SPC_SEL_ALC
menu "Automatic Level Control setting"
config CXD56_AUDIO_ALC_KNEE
	int "Knee levels of Automatic Level Control.[(1/10)dB]"
	default -40
	range -635 0
	---help---
		This command sets integer values 10 times larger than knee levels of
		Automatic Level Control. (step width: 0.5 dB) When a value within the
		range in the table below with a number other than 0 or 5 in one's
		place is designated, it will be regarded as a integer value round up
		to zero or five in the one's place. For example, when "-24" is
		designated, the value will be regarded as "-20".

config CXD56_AUDIO_ALC_TARGET
	int "Target level of Automatic Level Control.[dB]"
	default 0
	range -63 0
endmenu
endif # CXD56_AUDIO_ALC_SPC_SEL_ALC

if CXD56_AUDIO_ALC_SPC_SEL_SPC
menu "Sound Pressure Conter setting"
config CXD56_AUDIO_SPC_LIMIT
	int "Limit levels of Sound Pressure Counter.[(1/10)dB]"
	default 0
	range -250 0
	---help---
		This command sets integer values 10 times larger than limit levels of
		Sound Pressure Counter. (step width: 0.5 dB) When a value within the
		range in the table below with a number other than 0 or 5 in one's
		place is designated, it will be regarded as a integer value round up
		to zero or five in the one's place. For example, when "-24" is
		designated, the value will be regarded as "-20".
endmenu
endif # CXD56_AUDIO_ALC_SPC_SEL_SPC

choice
	prompt "LR data format during DMA transfer"
	default CXD56_AUDIO_DMA_DATA_FORMAT_RL
	---help---
		This sets the data arrangement of left channel and right channel in
		the data format for 16 bit DMA transfer.

config CXD56_AUDIO_DMA_DATA_FORMAT_LR
	bool "allocate left channel data in most significant bit"

config CXD56_AUDIO_DMA_DATA_FORMAT_RL
	bool "allocate right channel data in most significant bit"
endchoice

config CXD56_AUDIO_MIC_BOOT_WAIT
	int "Wait time for mic booting.[msec]"
	default 1100
	range 0 65535

endmenu

endif # CXD56_AUDIO

comment "Power Management Options"

menuconfig CXD56_PM
	bool "Power Management"
	default y

if CXD56_PM

config CPUFREQ_RELEASE_LOCK
	bool "Dynamic clock control"
	default n
	---help---
		Enable dynamically clock frequency change by CPU frequency lock.
		Acquiring the higer frequency lock improves the performance, but
		increases the power consumption. If this option is enabled, the
		system clock is reduced at the lower frequency as long as the
		frequency lock is not acquired. If this option is disabled, the
		system clock has not been dynamically changed and has been keeping
		the max system clock.

config CXD56_HOT_SLEEP
	bool "Hot Sleep"
	default n
	depends on SDK_EXPERIMENTAL
	---help---
		Enable Hot Sleep

if CXD56_HOT_SLEEP

config CXD56_HOT_SLEEP_WAIT_COUNT
	int "Hot Sleep wait counter"
	default 20

config CXD56_HOT_SLEEP_THRESHOLD
	int "Hot Sleep threshold"
	default 1000

config CXD56_GNSS_HOT_SLEEP
	bool "Enable GNSS Hot Sleep"
	default n

endif #CXD56_HOT_SLEEP

config CXD56_PM_PROCFS
	bool "Power Management PROCFS support"
	default n
	---help---
		Enable the power domain status or the clock frequency monitor.

config DEBUG_PM
	bool "Power Management Debug Output"
	default n
	---help---
		Enable power management debug features.

endif # CXD56_PM

config CXD56_GAUGE
    bool "CXD5247 battery gauge"
    default n
    ---help---
        Enable battery gauge driver.
        This is not a lower half of power driver, but compatible with NuttX gauge driver.

if CXD56_GAUGE

config CXD56_GAUGE_DEBUG
    bool "Battery Gauge Debug"
    default n
    ---help---
        Enable battery driver debug messages and debug IO command.

endif

config CXD56_CHARGER
    bool "CXD5247 battery charger"
    default n
    depends on BOARD_CORVO || BOARD_COLLET
    ---help---
        Enable battery charger driver.
        This is not a lower half of power driver, but compatible with NuttX charger driver.

if CXD56_CHARGER

config CXD56_CHARGER_TEMP_PRECISE
    bool "Precise Temperature"
    default y
    ---help---
        Get temperature precisely. If this option is enabled, driver calculate precisely
        from register value to degrees Celsius.
        This option requires libm.

config CXD56_CHARGER_DEBUG
    bool "Battery Charger Debug"
    default n
    ---help---
        Enable battery charger driver debug messages.

endif

comment "Debug Features"

config CXD56_BACKUPLOG
	bool "Backup Log driver"
	default y

config CXD56_RESET_ON_CRASH
	bool "Enable Board Reset on crash"
	default n
	---help---
		If selected the board_crashdump should reset the machine after
		saveing the state of the machine

endmenu

menu "Debug Log Level"

config SDK_DEBUG_EMERGE
	bool "Enable EMERG level"
	default n
	---help---
		Enables output from logemerg() statements.

config SDK_DEBUG_ALERT
	bool "Enable ALERT level"
	default n
	---help---
		Enables output from logalert() statements.

config SDK_DEBUG_CRIT
	bool "Enable CRIT level"
	default n
	---help---
		Enables output from logcrit() statements.

config SDK_DEBUG_ERR
	bool "Enable ERR level"
	default n
	---help---
		Enables output from logerr() statements.

config SDK_DEBUG_WARN
	bool "Enable WARNING level"
	default n
	---help---
		Enables output from logwarn() statements.

config SDK_DEBUG_NOTICE
	bool "Enable NOTICE level"
	default n
	---help---
		Enables output from lognotice() statements.

config SDK_DEBUG_INFO
	bool "Enable INFO level"
	default n
	---help---
		Enables output from loginfo() statements.

config SDK_DEBUG_DEBUG
	bool "Enable DEBUG level"
	default n
	---help---
		Enables output from logdebug() statements.

endmenu
```
