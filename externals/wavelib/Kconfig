## externals/websocket/Kconfig
```kconfig
#
# For a description of the syntax of this configuration file,
# see the file kconfig-language.txt in the NuttX tools repository.
#

config EXTERNALS_WEBSOCKET
	bool "WebSocket Client Library"
	default n
	select LIBC_SCANSET
	---help---
		Enable WebSocket Client Library.
		WebSocket Client Library is provided from https://github.com/jeremyhahn/cwebsocket
		and licensed under MIT.
```

## sdk/Kconfig
```kconfig
#
# For a description of the syntax of this configuration file,
# see the file kconfig-language.txt in the NuttX tools repository.
#

menu "Spresense SDK"

config SDK_USER_ENTRYPOINT
	string "SDK Application entry point"
	default "nsh_main"
	---help---
		The name of the SDK entry point for user applications.  For the example
		applications this is of the form 'app_main' where 'app' is the application
		name. If not defined, SDK_USER_ENTRYPOINT defaults to "nsh_main".

source "$APPSDIR/../modules/Kconfig"
source "$APPSDIR/../system/Kconfig"

endmenu
```
