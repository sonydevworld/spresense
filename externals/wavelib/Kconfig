## sdk/bsp/board/collet/Kconfig
```kconfig
#
# For a description of the syntax of this configuration file,
# see the file kconfig-language.txt in the NuttX tools repository.
#

if BOARD_COLLET

config CXD56_100PIN
	bool
	default y

config EINK_ET014TT1
	bool "EInk ET014TT1 ePaper"
	default n
	---help---
		Supports the E Ink ET014TT1 1.43" monochrome display.

if EINK_ET014TT1

config EINK_ET014TT1_ROTATE
	bool "rotate device"
	default y
	---help---
		Rotate ePaper device.

endif

endif
```

## sdk/bsp/board/spresense/Kconfig
```kconfig
#
# For a description of the syntax of this configuration file,
# see the file kconfig-language.txt in the NuttX tools repository.
#

if BOARD_SPRESENSE

config BOARD_CUSTOM_PINCONFIG
	bool
	default y

config BOARD_USB_DISABLE_IN_DEEP_SLEEPING
	bool
	default y
	---help---
		Due to the system specification, it's impossible to enter the deep
		sleeping mode for the power saving as long as USB is attached. As
		the workaround for this restriction, this configuration forces to be
		disable the USB function in deep sleeping.

config CXD56_SPIFLASHSIZE
	hex
	default 0x400000
	depends on CXD56_SFC
	---help---
		Specify the SPI flash total available size for the application.
		This value is generally set half of SPI flash device capacity.

config SDCARD_TXS02612
	bool "SD Card TXS02612 port expander with voltage level translation"
	default y
	---help---
		Enable TXS02612 Dual Voltage Level Translator for SD-Card interface.
		This device is used in SPD-003C board.

if SDCARD_TXS02612

choice
	prompt "TXS02612 port"
	default SDCARD_TXS02612_PORT0

config SDCARD_TXS02612_PORT0
	bool "Port 0"

config SDCARD_TXS02612_PORT1
	bool "Port 1"

endchoice # "TXS02612 port"

endif # SDCARD_TXS02612

endif
```

## sdk/configs/board/spresense-defconfig
```kconfig
CONFIG_BOARD_SPRESENSE=y
CONFIG_SDK_USER_ENTRYPOINT="spresense_main"
CONFIG_CXD56_EMMC=y
CONFIG_CXD56_SPI=y
CONFIG_CXD56_SPI3=y
# CONFIG_CXD56_SPI3_SCUSEQ is not set
CONFIG_CXD56_SPI4=y
CONFIG_CXD56_SPI5=y
CONFIG_CXD56_I2C=y
CONFIG_CXD56_I2C0=y
# CONFIG_CXD56_I2C0_SCUSEQ is not set
```

## sdk/configs/device/lcd-defconfig
```kconfig
CONFIG_CXD56_SPI=y
CONFIG_CXD56_SPI4=y
CONFIG_CXD56_DMAC_SPI4_TX=y
CONFIG_CXD56_DMAC_SPI4_RX=y
CONFIG_LCD=y
CONFIG_LCD_ILI9340=y
CONFIG_LCD_ILI9340_IFACE0=y
```
