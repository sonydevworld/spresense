## sdk/modules/sensing/barometer/Kconfig
```kconfig
#
# For a description of the syntax of this configuration file,
# see the file kconfig-language.txt in the NuttX tools repository.
#

config SENSING_BAROMETER
	bool "Barometer"
	default n
	---help---
		Enable support for barometer.
```

## sdk/modules/sensing/gnss/Kconfig
```kconfig
#
# For a description of the syntax of this configuration file,
# see the file kconfig-language.txt in the NuttX tools repository.
#

source "$APPSDIR/../modules/sensing/gnss/cxd56nmea/Kconfig"
source "$APPSDIR/../modules/sensing/gnss/cxd5610nmea/Kconfig"
```

## sdk/modules/sensing/gnss/cxd5610nmea/Kconfig
```kconfig
#
# For a description of the syntax of this configuration file,
# see the file kconfig-language.txt in the NuttX tools repository.
#

config GPSUTILS_CXD5610NMEA_LIB
	bool "Support CXD5610 gnss NMEA convert library"
	default n
	depends on SENSORS_CXD5610_GNSS
	---help---
		Enable CXD5610 gnss NMEA convert library.
		This converts from positioning data of CXD5610 GNSS to NMEA sentences.
```

## sdk/modules/sensing/gnss/cxd56nmea/Kconfig
```kconfig
#
# For a description of the syntax of this configuration file,
# see the file kconfig-language.txt in the NuttX tools repository.
#


config GPSUTILS_CXD56NMEA_LIB
	bool "Support CXD56xx gnss NMEA convert library"
	default n
	#depends on CXD56_GNSS && LIBM
	depends on CXD56_GNSS
	---help---
		Enable CXD56xx gnss NMEA convert library.
		This converts from GD positioning data of CXD56 GNSS to NMEA sentences.

		NOTE: This library is object archive depends on libm.a.
```

## sdk/modules/sensing/step_counter/Kconfig
```kconfig
#
# For a description of the syntax of this configuration file,
# see the file kconfig-language.txt in the NuttX tools repository.
#

config SENSING_STEPCOUNTER
	bool "Step counter"
	default n
	---help---
		Enable support for stepcounter.

if SENSING_STEPCOUNTER
config SENSING_STEPCOUNTER_DEBUG_FEATURE
	bool "Step counter debug feature"
	default n

if SENSING_STEPCOUNTER_DEBUG_FEATURE

config SENSING_STEPCOUNTER_DEBUG_ERROR
	bool "Step counter debug error"
	default n

config SENSING_STEPCOUNTER_DEBUG_INFO
	bool "Step counter debug info"
	default n

endif # SENSING_STEPCOUNTER_DEBUG_FEATURE

endif # SENSING_STEPCOUNTER
```

## sdk/modules/sensing/tap/Kconfig
```kconfig
#
# For a description of the syntax of this configuration file,
# see the file kconfig-language.txt in the NuttX tools repository.
#

config TAP
	bool "Tap detection"

if TAP

config TAP_MANAGER
	bool "Support tap manager library"
	default n
	---help---
		Enable support for tap manager library.

endif
```

## sdk/modules/sensing/transport_mode/Kconfig
```kconfig
#
# For a description of the syntax of this configuration file,
# see the file kconfig-language.txt in the NuttX tools repository.
#

config SENSING_TRAM
	bool "Transport mode"
	default n
	---help---
		Enable support for transport mode.

if SENSING_TRAM
config SENSING_TRAM_DEBUG_FEATURE
	bool "Tramsport mode debug feature"
	default n

if SENSING_TRAM_DEBUG_FEATURE

config SENSING_TRAM_DEBUG_ERROR
	bool "Tramsport mode debug error"
	default n

config SENSING_TRAM_DEBUG_INFO
	bool "Tramsport mode debug info"
	default n

endif # SENSING_TRAM_DEBUG_FEATURE

endif # SENSING_TRAM
```

## sdk/modules/skeleton/Kconfig
```kconfig
menuconfig SKELETON
	bool "Skeleton"
	---help---
		This is a template for each modules.

if SKELETON
config SKELETON_OPTION
	bool "Options for module"
endif
```

## sdk/modules/sw_peripherals/Kconfig
```kconfig
#
# For a description of the syntax of this configuration file,
# see the file kconfig-language.txt in the NuttX tools repository.
#
#

menu "Software Peripherals"

config SW_PERIPHERALS
	bool "Software emulated peripheral libraries"
	default n
	select SPI_BITBANG

if SW_PERIPHERALS

config SW_PERIPHERALS_SPI
	bool "Software SPI"
	default y
	---help---
		Softwae emulated SPI driver.

endif

endmenu
```

## sdk/modules/tflmrt/Kconfig
```kconfig
#
# For a description of the syntax of this configuration file,
# see the file kconfig-language.txt in the NuttX tools repository.
#

menu "TensorFlow Lite Micro runtime library"
config TFLM_RT
	bool "TensorFlow Lite Micro runtime library"
	select EXTERNALS_TENSORFLOW
	default n
	---help---
		Enable or disable TensorFlow Lite Micro runtime library.

if TFLM_RT

config TFLM_RT_MPCOMM
	bool "Use multicore processing"
	select MPCOMM
	default n
	---help---
		Enable or disable multicore processing.

if TFLM_RT_MPCOMM

config TFLM_RT_MPCOMM_PATH
	string "MPCOMM TFLMRT-MP ELF file path"
	default "/mnt/sd0/BIN/TFLMRT-MP"
	---help---
		Set path to MPCOMM TFLMRT-MP worker program ELF file on the board.

endif

endif

endmenu # TFLM_RT
```

## sdk/modules/utils/uconv/Kconfig
```kconfig
#
# For a description of the syntax of this configuration file,
# see the file kconfig-language.txt in the NuttX tools repository.
#

config UTILS_UCONV
	bool "Unicode converter Library Support"
	default n
	---help---
		Enables support for the Unicode converter Library.

if UTILS_UCONV

config UTILS_UCONV_DEBUG
	bool "Enable unicode converter Debug logs"
	default n

endif
```

## sdk/modules/video/Kconfig
```kconfig
#
# For a description of the syntax of this configuration file,
# see the file kconfig-language.txt in the NuttX tools repository.
#

menu "Video Support"

config VIDEO 
	bool "Video Support"
	default n
	---help---
		Enable video

endmenu
```

## sdk/system/ambient/Kconfig
```kconfig
#
# For a description of the syntax of this configuration file,
# see the file kconfig-language.txt in the NuttX tools repository.
#

config SYSTEM_AMBIENT
	bool "Ambient"
	default n
	---help---
		Enable support for connecting to the Ambient server.
		Ambient is an IoT data visualization service.
		https://ambidata.io

if SYSTEM_AMBIENT

config AMBIENT_IPADDR
	string "Ambient IP address"
	default "54.65.206.59"
	---help---
		Ambient Server IP address.

config AMBIENT_PORT
	int "Ambient port number"
	default 80
	---help---
		Ambient Server port number.

endif
```

## sdk/system/boardid/Kconfig
```kconfig
#
# For a description of the syntax of this configuration file,
# see the file kconfig-language.txt in the NuttX tools repository.
#

config SYSTEM_BOARDID
	bool "Print board unique ID command"
	default n
	depends on BOARDCTL_UNIQUEID
	---help---
		Enable support for the NSH 'boardid' command which shows board unique ID.

if SYSTEM_BOARDID

config SYSTEM_BOARDID_PROGNAME
	string "Program name"
	default "boardid"
	---help---
		This is the name of the program that will be used when the NSH ELF
		program is installed.

config SYSTEM_BOARDID_PRIORITY
	int "boardid task priority"
	default 100

config SYSTEM_BOARDID_STACKSIZE
	int "boardid stack size"
	default DEFAULT_TASK_STACKSIZE

endif # SYSTEM_BOARDID
```

## sdk/system/gpio/Kconfig
```kconfig
#
# For a description of the syntax of this configuration file,
# see the file kconfig-language.txt in the NuttX tools repository.
#

config SYSTEM_GPIO
	bool "GPIO Command"
	default n
	---help---
		Enable support for the NSH 'gpio' command.

if SYSTEM_GPIO

config SYSTEM_GPIO_STATUS
	bool "GPIO status dump"
	default y
	depends on CXD56_GPIO_IRQ

endif # SYSTEM_GPIO
```

## sdk/system/gpioint/Kconfig
```kconfig
#
# For a description of the syntax of this configuration file,
# see the file kconfig-language.txt in the NuttX tools repository.
#

config SYSTEM_GPIOINT
	bool "GPIO Interrupt Command"
	default n
	depends on CXD56_GPIO_IRQ
	---help---
		Enable support for the NSH 'gpioint' command.
```

## sdk/system/logdump/Kconfig
```kconfig
#
# For a description of the syntax of this configuration file,
# see the file kconfig-language.txt in the NuttX tools repository.
#

config SYSTEM_LOGDUMP
	bool "Log Dump Command"
	default n
	depends on CXD56_BACKUPLOG
	---help---
		Enable support for the NSH 'logdump' command. This command outputs the
		specified logging data on both the backup sram and the saved file to
		the console for debug.

if SYSTEM_LOGDUMP

config SYSTEM_LOGDUMP_MOUNTPOINT
	string "Log file saved directory"
	default "/mnt/spif"

endif # SYSTEM_LOGDUMP
```

## sdk/system/logsave/Kconfig
```kconfig
#
# For a description of the syntax of this configuration file,
# see the file kconfig-language.txt in the NuttX tools repository.
#

config SYSTEM_LOGSAVE
	bool "Log Save Command"
	default n
	depends on CXD56_BACKUPLOG
	---help---
		Enable support for the NSH 'logsave' command. This command saves all of
		the logging data on the backup sram as each file into the non-volatile
		storage like as flash. If the logging data is saved as file, the data
		is removed from the backup sram.

if SYSTEM_LOGSAVE

config SYSTEM_LOGSAVE_MOUNTPOINT
	string "Log file saved directory"
	default "/mnt/spif"

endif # SYSTEM_LOGSAVE
```

## sdk/system/lte_daemon/Kconfig
```kconfig
#
# For a description of the syntax of this configuration file,
# see the file kconfig-language.txt in the NuttX tools repository.
#

config LTE_DAEMON
	bool "lte_daemon"
	default n
	---help---
		Enable support for the lte daemon

if LTE_DAEMON

config LTE_DAEMON_APN_NAME
	string "Access Point Name"
	default ""

choice
	prompt "IP type Selection"
	default LTE_DAEMON_APN_IPTYPE_IP

	config LTE_DAEMON_APN_IPTYPE_IP
		bool "IPv4"

	config LTE_DAEMON_APN_IPTYPE_IPV6
		bool "IPv6"

	config LTE_DAEMON_APN_IPTYPE_IPV4V6
		bool "IPv4/v6"
endchoice

choice
	prompt "Authentication type Selection"
	default LTE_DAEMON_APN_AUTHTYPE_NONE

	config LTE_DAEMON_APN_AUTHTYPE_NONE
		bool "None"

	config LTE_DAEMON_APN_AUTHTYPE_PAP
		bool "PAP"

	config LTE_DAEMON_APN_AUTHTYPE_CHAP
		bool "CHAP"
endchoice

config LTE_DAEMON_APN_USERNAME
	string "Username used for authentication"
	default ""

config LTE_DAEMON_APN_PASSWD
	string "Password used for authentication"
	default ""

endif
```

## sdk/system/lte_sysctl/Kconfig
```kconfig
#
# For a description of the syntax of this configuration file,
# see the file kconfig-language.txt in the NuttX tools repository.
#

config LTE_SYSCTL
	bool "lte_sysctl system command"
	default n
	---help---
		Enable lte_sysctl system command.
		This command can control alt1250 usrsock daemon.

if LTE_SYSCTL

config LTE_SYSCTL_CMDNAME
	string "Command name of lte_sysctl (default lte_sysctl)"
	default "lte_sysctl"
	---help---
		Command name of this command.
		Default is "lte_sysctl".
		In older SDK than v2.3, this command name was "lte_daemon".
		If you want to use this as the same as older, you can change
		this value to "lte_daemon", but keeping default value is
		recommended.

config LTE_SYSCTL_APN_NAME
	string "Default access Point Name"
	default ""
	---help---
		Set default access point name.
		This parameter can be changed by command line option of "-a".
		This default value is used when the command line option
		was not set.

choice
	prompt "Default IP type Selection"
	default LTE_SYSCTL_APN_IPTYPE_IP
	---help---
		Set default IP type.
		This parameter can be changed by command line option of "-i".
		This default value is used when the command line option
		was not set.

	config LTE_SYSCTL_APN_IPTYPE_IP
		bool "IPv4"

	config LTE_SYSCTL_APN_IPTYPE_IPV6
		bool "IPv6"

	config LTE_SYSCTL_APN_IPTYPE_IPV4V6
		bool "IPv4/v6"

	config LTE_SYSCTL_APN_IPTYPE_NON
		bool "Non-IP"
endchoice

choice
	prompt "Default authentication type Selection"
	default LTE_SYSCTL_APN_AUTHTYPE_NONE
	---help---
		Set default authentication type.
		This parameter can be changed by command line option of "-v".
		This default value is used when the command line option
		was not set.

	config LTE_SYSCTL_APN_AUTHTYPE_NONE
		bool "None"

	config LTE_SYSCTL_APN_AUTHTYPE_PAP
		bool "PAP"

	config LTE_SYSCTL_APN_AUTHTYPE_CHAP
		bool "CHAP"
endchoice

config LTE_SYSCTL_APN_USERNAME
	string "Default username used for authentication"
	default ""
	---help---
		Set default username.
		This parameter can be cnahged by command line option of "-u".
		This default value is used when the command line option
		was not set.

config LTE_SYSCTL_APN_PASSWD
	string "Password used for authentication"
	default ""
	---help---
		Set default password.
		This parameter can be changed by command line option of "-p".
		This default value is used when the command line option
		was not set.

config LTE_SYSCTL_FACTORY_RESET
	bool "Enable factoryreset sub-command"
	default n
	select SDK_LTE_EXT
	select LTE_FACTORY_RESET_API
	---help---
		Enable the factory reset function in the lte_sysctl command.
endif
```

## sdk/system/startup_script/Kconfig
```kconfig
#
# For a description of the syntax of this configuration file,
# see the file kconfig-language.txt in the NuttX tools repository.
#

config SYSTEM_STARTUP_SCRIPT
	bool "Spresense Startup Script"
	default n
	select NSH_ROMFSETC
	select NSH_CUSTOMROMFS
	---help---
		Enable startup script. If this is enabled, /mnt/spif/init.rc will
		be executed as standalone task at first when the system is booting up.
		And if the init.rc does not exist, start NuttShell as usual.
```

## sdk/system/sysutil/Kconfig
```kconfig
#
# For a description of the syntax of this configuration file,
# see the file kconfig-language.txt in the NuttX tools repository.
#

config SYSTEM_SYSUTIL
	bool "Create firmware for the system utility"
	default n
	---help---
		Create a firmware for the system utility called as sysutil.spk.
```

## sdk/system/xmodem/Kconfig
```kconfig
#
# For a description of the syntax of this configuration file,
# see the file kconfig-language.txt in the NuttX tools repository.
#

config SYSTEM_XMODEM
	bool "Support XMODEM"
	default n
	---help---
		Enable support for XMODEM.

if SYSTEM_XMODEM

config DEBUG_XMODEM
	bool "Xmodem debug"
	default n
	---help---
		Enable Xmodem debug output.  This debug is unrelated to the internal
		NuttX debug option; it does not use the SYSLOG channel but, instead,
		outputs debug information on stderr.  Obviously, enabling this
		option will likely cause you all kinds of problems if you intend to
		use /dev/console to transfer files!

config SYSTEM_XMODEM_APP
	bool "Xmodem transfer application"
	default n
	---help---
		Enable the xmodem file transfer application for xmodem_writer

if SYSTEM_XMODEM_APP

config SYSTEM_XMODEM_APP_PROGNAME
	string "Program name"
	default "xmodem"
	---help---
		This is the name of the program that will be use when the NSH ELF
		program is installed.

config SYSTEM_XMODEM_APP_PRIORITY
	int "Xmodem task priority"
	default 100

config SYSTEM_XMODEM_APP_STACKSIZE
	int "Xmodem stack size"
	default 246272

endif
endif
```
