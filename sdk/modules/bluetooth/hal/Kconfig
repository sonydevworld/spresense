## sdk/modules/bluetooth/hal/Kconfig
```kconfig
#
# For a description of the syntax of this configuration file,
# see the file kconfig-language.txt in the NuttX tools repository.
#

menu "Device support"
source "$APPSDIR/../modules/bluetooth/hal/bcm20706/Kconfig"
source "$APPSDIR/../modules/bluetooth/hal/nrf52/Kconfig"
endmenu
```

## sdk/modules/bluetooth/hal/bcm20706/Kconfig
```kconfig
#
# For a description of the syntax of this configuration file,
# see the file kconfig-language.txt in the NuttX tools repository.
#


config BCM20706
	bool "Cypress BCM20706 bluetooth"
	default n
	---help---
		Enable Cypress BCM20706 HALs.

if BCM20706
choice
	prompt "Firmware location"
	default BCM20706_FIRMWARE_IN_FILESYSTEM
	config BCM20706_FIRMWARE_IN_FILESYSTEM
		bool "File system"
		---help---
			Firmware is store in file system.

	config BCM20706_FIRMWARE_IN_EXT_ROM
		bool "External ROM"
		---help---
			Firmware is store in external ROM.
endchoice

if BCM20706_FIRMWARE_IN_FILESYSTEM
config BCM20706_FIRMWARE_PATH
	string "BCM20706 firmware binary file path"
	default "/mnt/spif/bcm20706fw"
	---help---
		This option is for using file system to load firmware.
endif

config BCM20706_UART_DEV_PATH
	string "BCM20706 UART device file path"
	default "/dev/ttyS2"
	---help---
		This is UART device file path for communicate BCM20706 with Host.

config BCM20706_A2DP
	bool
	default BLUETOOTH_A2DP
	---help---
		This option enabling Cypress BCM20706 A2DP HAL.

config BCM20706_AVRCP
	bool
	default BLUETOOTH_AVRCP
	---help---
		This option enabling Cypress BCM20706 AVRCP HAL.

config BCM20706_HFP
	bool
	default BLUETOOTH_HFP
	---help---
		This option enabling Cypress BCM20706 HFP HAL.

config BCM20706_SPP
	bool
	default BLUETOOTH_SPP
	---help---
		This option enabling Cypress BCM20706 SPP HAL.

config BCM20706_LE
	bool
	default BLUETOOTH_LE
	---help---
		This option enabling Cypress BCM20706 Low Energy HAL.

if BCM20706_LE
config BCM20706_LE_GATT
	bool
	default BLUETOOTH_LE_GATT
	---help---
		This option enabling Cypress BCM20706 LE GATT HAL.
endif
endif
```

## sdk/modules/bluetooth/hal/nrf52/Kconfig
```kconfig
#
# For a description of the syntax of this configuration file,
# see the file kconfig-language.txt in the NuttX tools repository.
#


config BLUETOOTH_NRF52
	bool "Nordic nRF52 series"
	default n
	---help---
		Nordic nRF52 provides BLE interfaces for application.

if BLUETOOTH_NRF52

config NRF52_LE
	bool
	default BLUETOOTH_LE
	---help---
		This option enabling Nordic nRF52 Low Energy HAL.

if NRF52_LE
config NRF52_LE_GATT
	bool
	default BLUETOOTH_LE_GATT
	---help---
		This option enabling Nordic nRF52 LE GATT HAL.

config NRF52_LESC
	bool "LE secure connection support"
	default y
	---help---
		This option enables LE secure connection feature of nRF52.
		LE secure connection is the safer pairing method,
		but nrf52 needs more memory because mbedtls or micro-ecc is required.

config NRF52_SCAN_COMPAT_MODE
	bool "Enable scan compatible mode"
	default n
	---help---
		Enable interoperability with devices that do not support a value of
		0 for the WinOffset parameter in the Link Layer CONNECT_IND packet.
		This applies to a limited set of legacy peripheral devices.

endif # NRF52_LE

endif # BLUETOOTH_NRF52
```

## sdk/modules/digital_filter/Kconfig
```kconfig
#
# For a description of the syntax of this configuration file,
# see the file kconfig-language.txt in the NuttX tools repository.
#
#

menu "Digital Filters"

config DIGITAL_FILTER
	bool "Digital Filter library"
	default n

if DIGITAL_FILTER

config DIGITAL_FILTER_FIR
	bool "FIR Digital Filter"
	default y
	---help---
		Enable to use FIR digiral filters.
		You need to enable ARM CMSIS DSP library because This filter is based on it.

config DIGITAL_FILTER_DECIMATOR
	bool "FIR Decimation Filter"
	default y
	---help---
		Enable to use FIR Decimation filters.
		You need to enable ARM CMSIS DSP library because This filter is based on it.

config DIFITAL_FILTER_EDGE_DETECT
	bool "Edge Detection Filter"
	default y
	---help---
		Enable to use Edge detection filter.
		You need to enable ARM CMSIS DSP library because This filter is based on it.

endif

endmenu
```

## sdk/modules/dnnrt/Kconfig
```kconfig
#
# For a description of the syntax of this configuration file,
# see the file kconfig-language.txt in the NuttX tools repository.
#

menu "DNN runtime library"
config DNN_RT
	bool "DNN runtime library"
	depends on EXTERNALS_CMSIS_NN
	select EXTERNALS_NNABLART
	default n
	---help---
		Enable or disable deep neural network library.

if DNN_RT

config DNN_RT_MP
	bool "Use multicore processing"
	default n
	---help---
		Enable or disable multicore processing.

if DNN_RT_MP

config DNN_RT_MPCOMM
	bool "Use MPCOMM framework"
	select MPCOMM
	default n
	---help---
		Enable to use module based on MPCOMM framework.

if DNN_RT_MPCOMM

config DNN_RT_MPCOMM_PATH
	string "MPCOMM DNNRT-MP ELF file path"
	default "/mnt/sd0/BIN/DNNRT-MP"
	---help---
		Set path to MPCOMM DNNRT-MP worker program ELF file on the board.

endif

endif

endif

endmenu # DNN_RT
```

## sdk/modules/fwuputils/clients/Kconfig
```kconfig
#
# For a description of the syntax of this configuration file,
# see the file kconfig-language.txt in the NuttX tools repository.
#

menuconfig FWUPUTILS_CLIENTS
	bool "FirmWare Update Clients"
	default n
	---help---
		Enable support for FirmWare Update.
```

## sdk/modules/fwuputils/manager/Kconfig
```kconfig
#
# For a description of the syntax of this configuration file,
# see the file kconfig-language.txt in the NuttX tools repository.
#

menuconfig FWUPUTILS_MANAGER
	bool "FirmWare Update Manager"
	default n
	---help---
		Enable support for FirmWare Update.

if FWUPUTILS_MANAGER

endif # FWUPUTILS_MANAGER
```

## sdk/modules/imageproc/Kconfig
```kconfig
#
# For a description of the syntax of this configuration file,
# see the file kconfig-language.txt in the NuttX tools repository.
#

menu "Image Processing Libraries"

config IMAGEPROC
	bool "Spresense Image Processing Libraries"
	default n
	---help---
		Some utility libraries will be enabled such as pixcel format convertor, rotation and so on.
		CXD5602 "Sony Sensing Processor for Spresense" has some image processing accelerator.
		This option can also enable that.

endmenu
```

## sdk/modules/lte/Kconfig
```kconfig
#
# For a description of the syntax of this configuration file,
# see the file kconfig-language.txt in the NuttX tools repository.
#

menu "LTE"

config LTE
	bool "LTE Library Support"
	default n
	---help---
		Enables support for the LTE library.

if LTE

source "$APPSDIR/../modules/lte/altcom/Kconfig"
source "$APPSDIR/../modules/lte/net/Kconfig"
endif

endmenu # LTE
```

## sdk/modules/lte/altcom/Kconfig
```kconfig
#
# For a description of the syntax of this configuration file,
# see the file kconfig-language.txt in the NuttX tools repository.
#

if LTE

config LTE_USE_BUFFPOOL
	bool "LTE API uses buffpool"
	default y
	---help---
		When this config is enabled, the memory used by the LTE functions is supplied from buffpool.
		If disabled, memory is allocated from the heap area.

endif

config LTE_DEBUG_FEATURES
	bool "Enable LTE Debug Features"
	default n

if LTE_DEBUG_FEATURES

config LTE_DEBUG_ERROR
	bool "Enable Error Output"
	default n

config LTE_DEBUG_WARN
	bool "Enable Warnings Output"
	default n
	depends on LTE_DEBUG_ERROR

config LTE_DEBUG_NOTICE
	bool "Enable Notice Output"
	default n
	depends on LTE_DEBUG_WARN

config LTE_DEBUG_INFO
	bool "Enable Informational Debug Output"
	default n
	depends on LTE_DEBUG_NOTICE

config LTE_DEBUG_DEBUG
	bool "Enable Debug Output"
	default n
	depends on LTE_DEBUG_INFO

endif

config LTE_CALLBACK_TASK_PRIORITY
	int "callback task priority"
	default 100
	range 1 255

if MODEM

config MODEM_DEVICE_PATH
	string "Path to the modem driver"
	default "/dev/altmdm"
	---help---
		Path to the modem driver to register.

endif

if LTE_NET

config LTE_NET_MBEDTLS
	bool "Stub mbedTLS Support"
	default n
	---help---
		This function is to use the function of mbedTLS on LTE Modem side.
		If you want to use mbedTLS itself on CXD5602, please use CONFIG_EXTERNALS_MBEDTLS.
		And when you select this, make sure CONFIG_EXTERNALS_MBEDTLS is disabled. Those are exclusive items.

endif
```

## sdk/modules/lte/net/Kconfig
```kconfig
#
# For a description of the syntax of this configuration file,
# see the file kconfig-language.txt in the NuttX tools repository.
#

menuconfig LTE_NET
	bool "Networking Support"
	---help---
		Enable or disable network features.

if LTE_NET
source "$APPSDIR/../modules/lte/net/inet/Kconfig"
source "$APPSDIR/../modules/lte/net/netdb/Kconfig"
endif
```

## sdk/modules/lte/net/inet/Kconfig
```kconfig
#
# For a description of the syntax of this configuration file,
# see the file kconfig-language.txt in the NuttX tools repository.
#

menuconfig LTE_INET
	bool "INET Support"
	---help---
		INET Support.

if LTE_INET

config LTE_INET_ADDR
	bool "inet_addr library support"
	default n
	---help---
		none

config LTE_INET_ATON
	bool "inet_aton library support"
	default n
	---help---
		none

config LTE_INET_NTOA
	bool "inet_ntoa library support"
	default n
	---help---
		none

config LTE_INET_NTOP
	bool "inet_ntop library support"
	default n
	---help---
		none

config LTE_INET_PTON
	bool "inet_pton library support"
	default n
	---help---
		none

endif
```

## sdk/modules/lte_ext/Kconfig
```kconfig
#
# For a description of the syntax of this configuration file,
# see the file kconfig-language.txt in the NuttX tools repository.
#

menu "SDK LTE Extension"

config SDK_LTE_EXT
	bool "SDK LTE Extension library"
	default n
	select MODEM_ALT1250_ADDITIONAL_FUNC
	---help---
		Enable support for LTE extension libraries

if SDK_LTE_EXT

menu "LTE extension libraries"

source "$APPSDIR/../modules/lte_ext/lapiext/Kconfig"

endmenu # LTE extension libraries

endif

endmenu
```

## sdk/modules/lte_ext/lapiext/Kconfig
```kconfig
#
# For a description of the syntax of this configuration file,
# see the file kconfig-language.txt in the NuttX tools repository.
#

config LTE_FACTORY_RESET_API
	bool "LTE Factory Reset API"
	default n
	select LTE_ALT1250_EXTEND_IOCTL
	---help---
		Enable Factory Reset API for ALT1250 module.
```

## sdk/modules/mbedtls_stub/Kconfig
```kconfig
#
# For a description of the syntax of this configuration file,
# see the file kconfig-language.txt in the NuttX tools repository.
#

menu "mbedTLS stub"

config LTE_NET_MBEDTLS
	bool "mbedTLS stub Library Support"
	default n
	select SDK_LTE_EXT
	---help---
		This option enables to use mbed TLS library in alt1250 modem.
		And when you select this, make sure CONFIG_EXTERNALS_MBEDTLS is disabled.
		Those are exclusive items.

if LTE_NET_MBEDTLS

config HAVE_EXTHANDLER
	bool "Enable user extension alt1250 command handler"
	default n
	---help---
		Enable compose/parse packet handler of alt1250 for user extension.

endif

if LTE_NET_MBEDTLS

config LTE_NET_MBEDTLS_ERROR_MSG
	bool "Enable error output messages"
	default n

if LTE_NET_MBEDTLS_ERROR_MSG

config LTE_NET_MBEDTLS_DEBUG_MSG
	bool "Enable debug output messages"
	default n

endif

endif

endmenu # MBEDTLS_STUB
```

## sdk/modules/memutils/Kconfig
```kconfig
#
# For a description of the syntax of this configuration file,
# see the file kconfig-language.txt in the NuttX tools repository.
#

menu "Memory Manager"

config MEMUTILS
	bool "Memory manager"
	default n
	---help---
		Enable support for memory manager.

if MEMUTILS
menu "Memory Utilities"

source "$APPSDIR/../modules/memutils/memory_manager/Kconfig"
source "$APPSDIR/../modules/memutils/message/Kconfig"
source "$APPSDIR/../modules/memutils/s_stl/Kconfig"
source "$APPSDIR/../modules/memutils/simple_fifo/Kconfig"

endmenu # Memory Utilities
endif

endmenu
```

## sdk/modules/memutils/memory_manager/Kconfig
```kconfig
#
# For a description of the syntax of this configuration file,
# see the file kconfig-language.txt in the NuttX tools repository.
#

config MEMUTILS_MEMORY_MANAGER
	bool "Memory manager"
	default n
	---help---
		Enable support for memory manager.

if MEMUTILS_MEMORY_MANAGER

config MEMUTILS_MEMORY_MANAGER_USE_FENCE
	bool "Fence(memory area over) detect function enable"
	default y
	---help---
		When exceeding the set memory area,
		an exception occurs when Pool is deleted

config MEMUTILS_MEMORY_MANAGER_NUM_FIXED_AREA_FENCES
	int "Area fence num"
	depends on MEMUTILS_MEMORY_MANAGER_USE_FENCE
	default 0

endif
```

## sdk/modules/memutils/message/Kconfig
```kconfig
#
# For a description of the syntax of this configuration file,
# see the file kconfig-language.txt in the NuttX tools repository.
#

config MEMUTILS_MESSAGE
	bool "Message"
	default n
	---help---
		Enable support for message.

if MEMUTILS_MESSAGE
endif
```

## sdk/modules/memutils/s_stl/Kconfig
```kconfig
#
# For a description of the syntax of this configuration file,
# see the file kconfig-language.txt in the NuttX tools repository.
#

config MEMUTILS_S_STL
	bool "MEMUTILS_S_STL"
	default n
	---help---
		Enable support for S_STL.

if MEMUTILS_S_STL
endif
```

## sdk/modules/memutils/simple_fifo/Kconfig
```kconfig
#
# For a description of the syntax of this configuration file,
# see the file kconfig-language.txt in the NuttX tools repository.
#

config MEMUTILS_SIMPLE_FIFO
	bool "Simple FIFO"
	default n
	---help---
		Enable support for Simple FIFO.

if MEMUTILS_SIMPLE_FIFO
endif
```

## sdk/modules/mpcomm/Kconfig
```kconfig
menu "MPCOMM"

config MPCOMM
	bool "MPCOMM"
	select ASMP
	---help---
		A multi processor communication framework

if MPCOMM

config MPCOMM_DEBUG_FEATURE
	bool "MPCOMM Framework debug feature"

if MPCOMM_DEBUG_FEATURE

config MPCOMM_DEBUG_ERROR
	bool "MPCOMM Framework debug error"

config MPCOMM_DEBUG_WARN
	bool "MPCOMM Framework debug warn"

config MPCOMM_DEBUG_INFO
	bool "MPCOMM Framework debug info"

endif # MPCOMM_DEBUG_FEATURE

endif # MPCOMM

endmenu
```

## sdk/modules/ringbuffer/Kconfig
```kconfig
#
# For a description of the syntax of this configuration file,
# see the file kconfig-language.txt in the NuttX tools repository.
#

menu "Ring Buffer"

config RINGBUFFER
	bool "Ring Buffer Support"
	default n
	---help---
		Enables support for the Ring Buffer library.

endmenu # Ring Buffer
```

## sdk/modules/sensing/Kconfig
```kconfig
#
# For a description of the syntax of this configuration file,
# see the file kconfig-language.txt in the NuttX tools repository.
#

menu "Sensing"

config SENSING_MANAGER
	bool "Sensing manager"
	default n
	---help---
		Enable support for sensor manager.

if SENSING_MANAGER

config SENSING_MANAGER_POWERCTRL
	bool "Sensing manager power control enable"
	default n
	---help---
		To use SS_SendSensorSetPower() API, enable this.

config SENSING_MANAGER_DEBUG_FEATURE
	bool "Sensing manager debug feature"
	default n

if SENSING_MANAGER_DEBUG_FEATURE

config SENSING_MANAGER_DEBUG_ERROR
	bool "Sensing manager debug error"
	default n

config SENSING_MANAGER_DEBUG_INFO
	bool "Sensing manager debug info"
	default n

endif # SENSING_MANAGER_DEBUG_FEATURE
endif # SENSING_MANAGER

source "$APPSDIR/../modules/sensing/gnss/Kconfig"
source "$APPSDIR/../modules/sensing/barometer/Kconfig"
source "$APPSDIR/../modules/sensing/tap/Kconfig"
source "$APPSDIR/../modules/sensing/step_counter/Kconfig"
source "$APPSDIR/../modules/sensing/transport_mode/Kconfig"

endmenu # Sensing Utilities
```
