## sdk/configs/examples/accel-defconfig
```kconfig
CONFIG_CXD56_I2C0=y
CONFIG_SENSORS=y
CONFIG_KX022=y
CONFIG_KX122=y
CONFIG_EXAMPLES_ACCEL=y
```

## sdk/configs/examples/adc-defconfig
```kconfig
CONFIG_CXD56_ADC=y
CONFIG_CXD56_HPADC0=y
CONFIG_CXD56_HPADC1=y
CONFIG_CXD56_LPADC=y
CONFIG_CXD56_LPADC_ALL=y
CONFIG_CXD56_LPADC0_FREQ=7
CONFIG_CXD56_LPADC0_FSIZE=64
CONFIG_CXD56_LPADC1_FREQ=7
CONFIG_CXD56_LPADC1_FSIZE=64
CONFIG_CXD56_LPADC2_FREQ=7
CONFIG_CXD56_LPADC2_FSIZE=64
CONFIG_CXD56_LPADC3_FREQ=7
CONFIG_CXD56_LPADC3_FSIZE=64
CONFIG_EXAMPLES_ADC=y
```

## sdk/configs/examples/audio_dual_players-defconfig
```kconfig
CONFIG_CXD56_SDIO=y
CONFIG_CXD56_AUDIO=y
CONFIG_SDK_AUDIO=y
CONFIG_AUDIOUTILS_PLAYER=y
CONFIG_MEMUTILS=y
CONFIG_ASMP=y
CONFIG_EXAMPLES_AUDIO_DUAL_PLAYERS=y
```

## sdk/configs/examples/audio_pcm_capture-defconfig
```kconfig
CONFIG_CXD56_SDIO=y
CONFIG_CXD56_AUDIO=y
CONFIG_SDK_AUDIO=y
CONFIG_AUDIOUTILS_RECORDER=y
CONFIG_AUDIOUTILS_DSP_MOUNTPT="/mnt/sd0/BIN"
CONFIG_MEMUTILS=y
CONFIG_ASMP=y
CONFIG_EXAMPLES_AUDIO_PCM_CAPTURE=y
```

## sdk/configs/examples/audio_player-defconfig
```kconfig
CONFIG_CXD56_SDIO=y
CONFIG_CXD56_AUDIO=y
CONFIG_SDK_AUDIO=y
CONFIG_AUDIOUTILS_PLAYER=y
CONFIG_AUDIOUTILS_PLAYLIST=y
CONFIG_MEMUTILS=y
CONFIG_ASMP=y
CONFIG_EXAMPLES_AUDIO_PLAYER=y
```
