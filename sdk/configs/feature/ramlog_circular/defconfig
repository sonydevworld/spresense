## sdk/configs/feature/step_counter-defconfig
```kconfig
CONFIG_SENSING_MANAGER=y
CONFIG_SENSING_STEPCOUNTER=y
CONFIG_MEMUTILS=y
CONFIG_MEMUTILS_MEMORY_MANAGER=y
CONFIG_MEMUTILS_MESSAGE=y
CONFIG_ASMP=y
```

## sdk/configs/feature/subcore-defconfig
```kconfig
CONFIG_CXD56_SUBCORE=y
# CONFIG_CXD56_UDMAC is not set
# CONFIG_NSH_ARGCAT is not set
CONFIG_NSH_DISABLE_CAT=y
CONFIG_NSH_DISABLE_CD=y
CONFIG_NSH_DISABLE_CP=y
CONFIG_NSH_DISABLE_CMP=y
CONFIG_NSH_DISABLE_DD=y
CONFIG_NSH_DISABLE_DF=y
CONFIG_NSH_DISABLE_ECHO=y
CONFIG_NSH_DISABLE_EXEC=y
CONFIG_NSH_DISABLE_EXIT=y
CONFIG_NSH_DISABLE_HEXDUMP=y
CONFIG_NSH_DISABLE_KILL=y
CONFIG_NSH_DISABLE_LOSETUP=y
CONFIG_NSH_DISABLE_LS=y
CONFIG_NSH_DISABLE_MKDIR=y
CONFIG_NSH_DISABLE_MKRD=y
CONFIG_NSH_DISABLE_MOUNT=y
CONFIG_NSH_DISABLE_MV=y
CONFIG_NSH_DISABLE_PRINTF=y
CONFIG_NSH_DISABLE_PS=y
CONFIG_NSH_DISABLE_PWD=y
CONFIG_NSH_DISABLE_RM=y
CONFIG_NSH_DISABLE_RMDIR=y
CONFIG_NSH_DISABLE_SET=y
CONFIG_NSH_DISABLE_SH=y
CONFIG_NSH_DISABLE_TEST=y
CONFIG_NSH_DISABLE_UMOUNT=y
CONFIG_NSH_DISABLE_UNAME=y
CONFIG_NSH_DISABLE_UNSET=y
CONFIG_NSH_DISABLE_USLEEP=y
CONFIG_NSH_DISABLESCRIPT=y
```

## sdk/configs/feature/voice_call-defconfig
```kconfig
CONFIG_CXD56_AUDIO=y
CONFIG_SDK_AUDIO=y
CONFIG_AUDIOUTILS_VOICE_CALL=y
CONFIG_MEMUTILS=y
CONFIG_ASMP=y
```

## sdk/configs/feature/voice_command-defconfig
```kconfig
CONFIG_CXD56_AUDIO=y
CONFIG_SDK_AUDIO=y
CONFIG_AUDIOUTILS_VOICE_COMMAND=y
CONFIG_MEMUTILS=y
CONFIG_ASMP=y
```
