## sdk/configs/feature/zmodem-defconfig
```kconfig
CONFIG_SYSTEM_ZMODEM=y
CONFIG_SYSTEM_ZMODEM_RCVBUFSIZE=1024
CONFIG_SYSTEM_ZMODEM_PKTBUFSIZE=1024
CONFIG_SYSTEM_ZMODEM_SNDFILEBUF=y
CONFIG_SYSTEM_ZMODEM_MOUNTPOINT="/mnt/spif"
```

## sdk/configs/kernel/subcore-release-defconfig
```kconfig
# CONFIG_ARCH_LEDS is not set
# CONFIG_STANDARD_SERIAL is not set
CONFIG_ARCH="arm"
CONFIG_ARCH_BOARD="cxd56evb"
CONFIG_ARCH_BOARD_CXD56EVB=y
CONFIG_ARCH_CHIP_CXD56XX=y
CONFIG_ARCH_INTERRUPTSTACK=2048
CONFIG_ARCH_STACKDUMP=y
CONFIG_ARMV7M_USEBASEPRI=y
CONFIG_BOARDCTL_IOCTL=y
CONFIG_BOARDCTL_POWEROFF=y
CONFIG_BOARDCTL_RESET=y
CONFIG_BOARDCTL_UNIQUEID=y
CONFIG_BOARDCTL_UNIQUEID_SIZE=5
CONFIG_BOARD_CRASHDUMP=y
CONFIG_BOARD_LOOPSPERMSEC=5434
CONFIG_BOOT_RUNFROMISRAM=y
CONFIG_BUILTIN=y
CONFIG_CLOCK_MONOTONIC=y
CONFIG_CXD56_UART2=y
CONFIG_DEBUG_FULLOPT=y
CONFIG_DEBUG_SYMBOLS=y
CONFIG_ELF=y
CONFIG_FS_PROCFS=y
CONFIG_FS_PROCFS_REGISTER=y
CONFIG_FS_WRITABLE=y
CONFIG_HAVE_CXX=y
CONFIG_I2C=y
CONFIG_I2C_DRIVER=y
CONFIG_LCD=y
CONFIG_LCD_NOGETRUN=y
CONFIG_LIBC_FLOATINGPOINT=y
CONFIG_LIBC_IPv4_ADDRCONV=y
CONFIG_LIBC_IPv6_ADDRCONV=y
CONFIG_LIB_BOARDCTL=y
CONFIG_LIB_KBDCODEC=y
CONFIG_MAX_WDOGPARMS=2
CONFIG_NAME_MAX=64
CONFIG_NFILE_STREAMS=8
CONFIG_PIPES=y
CONFIG_PREALLOC_MQ_MSGS=4
CONFIG_PREALLOC_TIMERS=4
CONFIG_PREALLOC_WDOGS=16
CONFIG_PWM=y
CONFIG_RAM_SIZE=1572864
CONFIG_RAM_START=0x0d000000
CONFIG_RR_INTERVAL=200
CONFIG_RTC=y
CONFIG_RTC_ALARM=y
CONFIG_RTC_DRIVER=y
CONFIG_RTC_FREQUENCY=32768
CONFIG_RTC_HIRES=y
CONFIG_SCHED_CHILD_STATUS=y
CONFIG_SCHED_HAVE_PARENT=y
CONFIG_SCHED_HPWORK=y
CONFIG_SCHED_HPWORKPERIOD=0
CONFIG_SCHED_LPNTHREADS=3
CONFIG_SCHED_LPWORK=y
CONFIG_SCHED_LPWORKPERIOD=0
CONFIG_SCHED_WAITPID=y
CONFIG_SDCLONE_DISABLE=y
CONFIG_SERIAL_TERMIOS=y
CONFIG_SPI=y
CONFIG_STACK_COLORATION=y
CONFIG_START_DAY=6
CONFIG_START_MONTH=12
CONFIG_START_YEAR=2011
CONFIG_TIMER=y
CONFIG_UART1_RXBUFSIZE=1024
CONFIG_UART1_SERIAL_CONSOLE=y
CONFIG_UART1_TXBUFSIZE=1024
CONFIG_UART2_IFLOWCONTROL=y
CONFIG_UART2_OFLOWCONTROL=y
CONFIG_USERMAIN_STACKSIZE=8192
CONFIG_USER_ENTRYPOINT="sdk_entry"
CONFIG_WATCHDOG=y
CONFIG_APPS_DIR="../sdk/tools/empty_apps"
```

## sdk/drivers/Kconfig
```kconfig
menu "Drivers"

source "$SDKDIR/drivers/sensors/Kconfig"
source "$SDKDIR/drivers/lcd/Kconfig"
source "$SDKDIR/drivers/video/Kconfig"
source "$SDKDIR/drivers/modem/Kconfig"

endmenu
```

## sdk/drivers/lcd/Kconfig
```kconfig
#
# For a description of the syntax of this configuration file,
# see the file kconfig-language.txt in the NuttX tools repository.
#

menuconfig LCD
	bool "LCD Drivers"
	---help---
		LCD and EInk display device drivers.

if LCD

config LCD_LPM013M091A
	bool "JDI LPM013M091A LCD Driver"
	default n
	---help---
		JDI LPM013M091A LCD Driver.
		This driver doesn't support reading data.
		Recommended to use DMA to transfer data or displayed image would be
		broken.

config LCD_ET014TT1
	bool "EInk ET014TT1 ePaper"
	default n
	---help---
		E Ink ET014TT1 1.43 inch monochrome display.

if LCD_ET014TT1
choice
	prompt "LCD Orientation"
	default LCD_ET014TT1_LANDSCAPE
	---help---
		Configure display orientation.

config LCD_ET014TT1_LANDSCAPE
	bool "Landscape orientation"
	---help---
		Define for "landscape" orientation support.

config LCD_ET014TT1_PORTRAIT
	bool "Portrait orientation"
	---help---
		Define for "portrait" orientation support.

config LCD_ET014TT1_RLANDSCAPE
	bool "Reverse landscape orientation"
	---help---
		Define for "reverse landscape" orientation support.

config LCD_ET014TT1_RPORTRAIT
	bool "Reverse portrait display"
	---help---
		Define for "reverse portrait" orientation support.

endchoice
endif

config LCD_ILI9340
	bool "ILI9340 LCD Single Chip Driver"
	default n
	---help---
		LCD Single Chip Driver, ILI9340, ILI Technology Corp.

		Required LCD driver settings:
		LCD_MAXCONTRAST should be 255, but any value >0 and <=255 will be accepted.
		LCD_MAXPOWER should be 1:  0=off, 1=on

config LCD_ILI9340_NINTERFACES
	int "Number of supported display driver"
	range 1 2
	default 1
    depends on LCD_ILI9340
	---help---
		Define the number of supported  displays driven by a ili9340 LCD Single
		Chip Driver.

config LCD_ILI9340_IFACE0
	bool "(1) LCD Display"
	depends on LCD_ILI9340_NINTERFACES = 1 || LCD_ILI9340_NINTERFACES = 2
	---help---
		Configure first LCD Display.

if LCD_ILI9340_IFACE0
choice
	prompt "LCD Orientation"
	default LCD_ILI9340_IFACE0_LANDSCAPE
	---help---
		Configure display orientation.

config LCD_ILI9340_IFACE0_LANDSCAPE
	bool "Landscape orientation"
	---help---
		Define for "landscape" orientation support.

config LCD_ILI9340_IFACE0_PORTRAIT
	bool "Portrait orientation"
	---help---
		Define for "portrait" orientation support.

config LCD_ILI9340_IFACE0_RLANDSCAPE
	bool "Reverse landscape orientation"
	---help---
		Define for "reverse landscape" orientation support.

config LCD_ILI9340_IFACE0_RPORTRAIT
	bool "Reverse portrait display"
	---help---
		Define for "reverse portrait" orientation support.

endchoice

choice
	prompt "Color format"
	default LCD_ILI9340_IFACE0_RGB565
	---help---
		LCD color format.

config LCD_ILI9340_IFACE0_RGB565
	bool "16 bpp RGB565 color format"
	---help---
		16 bpp RGB565 color format

endchoice
endif

config LCD_ILI9340_IFACE1
	bool "(2) LCD Display"
	depends on LCD_ILI9340_NINTERFACES = 2
	---help---
		Configure second LCD Display.

if LCD_ILI9340_IFACE1
choice
	prompt "LCD Orientation"
	default LCD_ILI9340_IFACE1_LANDSCAPE
	---help---
		Configure display orientation.

config LCD_ILI9340_IFACE1_LANDSCAPE
	bool "Landscape orientation"
	---help---
		Define for "landscape" orientation support.

config LCD_ILI9340_IFACE1_PORTRAIT
	bool "Portrait orientation"
	---help---
		Define for "portrait" orientation support.

config LCD_ILI9340_IFACE1_RLANDSCAPE
	bool "Reverse landscape orientation"
	---help---
		Define for "reverse landscape" orientation support.

config LCD_ILI9340_IFACE1_RPORTRAIT
	bool "Reverse portrait display"
	---help---
		Define for "reverse portrait" orientation support.

endchoice

choice
	prompt "Color format"
	default LCD_ILI9340_IFACE1_RGB565
	---help---
		LCD color format.

config LCD_ILI9340_IFACE1_RGB565
	bool "16 bpp RGB565 color format"
	---help---
		16 bpp RGB565 color format

endchoice
endif

endif
```

## sdk/drivers/sensors/Kconfig
```kconfig
#
# For a description of the syntax of this configuration file,
# see the file kconfig-language.txt in the NuttX tools repository.
#

menuconfig SENSORS
	bool "Sensor Drivers"

if SENSORS

config BMI160
	bool "Bosch BMI160 Sensor support"
	default n
	---help---
		Enable driver support for the Bosch BMI160 sensor.

if BMI160

choice
	prompt "BMI160 Interface"
	default BMI160_SPI

config BMI160_SPI
	bool "BMI160 SPI Interface"
	select CXD56_SPI
	---help---
		Enables support for the SPI interface.

config BMI160_I2C
	bool "BMI160 I2C Interface"
	select CXD56_I2C
	---help---
		Enables support for the I2C interface

endchoice

config BMI160_SCU
	bool "SCU Sequencer"
	default y
	depends on CXD56_SCU
	---help---
		Use the sensor control unit (SCU) sequencer.

endif # BMI160

config BMP280
	bool "Bosch BMP280 Barometic Pressure Sensor"
	default n
	select CXD56_I2C
	---help---
		Enable driver for the Bosch BMP280 barometic pressure sensor.

if BMP280

config BMP280_SCU
	bool "SCU Sequencer"
	default y
	depends on CXD56_SCU
	---help---
		Use the sensor control unit (SCU) sequencer.

endif # BMP280

config AK09912
	bool "Asahi AK09911/AK09912 Compass Sensor"
	default n
	select CXD56_I2C
	---help---
		Enable driver for AK09911/AK09912 Compass sensor.

if AK09912

config AK09912_SCU
	bool "SCU Sequencer"
	default y
	depends on CXD56_SCU
	---help---
		Use the sensor control unit (SCU) sequencer.

endif # AK09912

config APDS9930
	bool "Avago APDS9930 Proximity and Ambient light Sensor"
	default n
	select CXD56_I2C
	---help---
		Enable driver for APDS9930 proximity and ambient light sensor.

if APDS9930

config APDS9930_SCU
	bool "SCU Sequencer"
	default y
	depends on CXD56_SCU
	---help---
		Use the sensor control unit (SCU) sequencer.

config APDS9930_PROXIMITY_INTERRUPT
	bool "Use Proximity interrupt"
	default y
	---help---
		Use Interrupt when the threshold is exceeded.
		In this case, SCU sequencer is not used.

endif

config APDS9960
	bool "Avago APDS9960 Proximity, Ambient light, RGB and Gesture Sensor support"
	default n
	select CXD56_I2C
	---help---
		Enable driver support for APDS9960 proximity, ambient light, RGB and gesture sensor.

config LT1PA01
	bool "Murata LT1PA01 Proximity and Ambient light Sensor"
	default n
	select CXD56_I2C
	---help---
		Enable driver for LT1PA01 proximity and ambient light sensor.

if LT1PA01

config LT1PA01_SCU
	bool "SCU Sequencer"
	default y
	depends on CXD56_SCU
	---help---
		Use the sensor control unit (SCU) sequencer.

config LT1PA01_PROXIMITY_INTERRUPT
	bool "Use Proximity interrupt"
	default y
	---help---
		Use Interrupt when the threshold is exceeded.
		In this case, SCU sequencer is not used.

endif

config BH1721FVC
	bool "Rohm BH1721FVC Ambient Light Sensor"
	default n
	select CXD56_I2C
	---help---
		Enable driver for the Rohm BH1721FVC light sensor.

if BH1721FVC

config BH1721FVC_SCU
	bool "SCU Sequencer"
	default y
	depends on CXD56_SCU
	---help---
		Use the sensor control unit (SCU) sequencer.

endif # BH1721FVC

config KX022
	bool "Kionix KX022/KX122 Acceleration Sensor"
	default n
	select CXD56_I2C
	---help---
		Enable driver for the Kionix KX022/KX122 acceleration sensor.

if KX022

config KX022_SCU
	bool "SCU Sequencer"
	default y
	depends on CXD56_SCU
	---help---
		Use the sensor control unit (SCU) sequencer.
		Support only driver with the sensor control unit (SCU) sequencer.

config KX122
	bool "KX122"
	default n
	---help---
		Use KX122 which has the register upper compatibility with KX022.

endif # KX022

config BM1422GMV
	bool "Rohm BM1422GMV/BM1422AGMV Magnetic Sensor"
	default n
	select CXD56_I2C
	---help---
		Enable driver for BM1422GMV/BM1422AGMV magnetic sensor.

if BM1422GMV

choice
	prompt "Slave Address"
	default BM1422GMV_SLAVE_ADDRESS_0F

config BM1422GMV_SLAVE_ADDRESS_0E
	bool "0x0E"

config BM1422GMV_SLAVE_ADDRESS_0F
	bool "0x0F"

endchoice

config BM1422GMV_SCU
	bool "SCU Sequencer"
	default y
	depends on CXD56_SCU
	---help---
		Use the sensor control unit (SCU) sequencer.

endif # BM1422GMV

config BM1383GLV
	bool "Rohm BM1383GLV/BM1383AGLV Pressure Sensor"
	default n
	select CXD56_I2C
	---help---
		Enable driver for BM1383GLV/BM1383AGLV pressure sensor.

if BM1383GLV

config BM1383GLV_SCU
	bool "SCU Sequencer"
	default y
	depends on CXD56_SCU
	---help---
		Use the sensor control unit (SCU) sequencer.

config BM1383AGLV
	bool "BM1383AGLV"
	default n
	---help---
		Use BM1383AGLV registers.

endif # BM1383GLV

config BH1745NUC
	bool "Rohm BH1745NUC Color Sensor"
	default n
	select CXD56_I2C
	---help---
		Enable driver for BH1745NUC color sensor.

if BH1745NUC

config BH1745NUC_SCU
	bool "SCU Sequencer"
	default y
	depends on CXD56_SCU
	---help---
		Use the sensor control unit (SCU) sequencer.

endif # BH1745NUC

config RPR0521RS
	bool "Rohm RPR0521RS Proximity and Ambient light Sensor"
	default n
	select CXD56_I2C
	---help---
		Enable driver for RPR0521RS proximity and ambient light sensor.

if RPR0521RS

config RPR0521RS_SCU
	bool "SCU Sequencer"
	default y
	depends on CXD56_SCU
	---help---
		Use the sensor control unit (SCU) sequencer.

config RPR0521RS_PROXIMITY_INTERRUPT
	bool "Use Proximity interrupt"
	default y
	---help---
		Use Interrupt when the threshold is exceeded.
		In this case, SCU sequencer is not used.

endif

endif # SENSORS
```

## sdk/drivers/video/Kconfig
```kconfig
#
# For a description of the syntax of this configuration file,
# see the file kconfig-language.txt in the NuttX tools repository.
#

menu "Video Device Support"

if VIDEO

config VIDEO_ISX012
	bool "ISX012 Image sensor"
	default n

endif # VIDEO
endmenu
```

## sdk/modules/Kconfig
```kconfig
#
# For a description of the syntax of this configuration file,
# see the file kconfig-language.txt in the NuttX tools repository.
#

source "$APPSDIR/../modules/sensing/Kconfig"
source "$APPSDIR/../modules/audio/Kconfig"
source "$APPSDIR/../modules/memutils/Kconfig"
source "$APPSDIR/../modules/asmp/Kconfig"
source "$APPSDIR/../modules/fwuputils/Kconfig"
source "$APPSDIR/../modules/lte/Kconfig"
source "$APPSDIR/../modules/video/Kconfig"
source "$APPSDIR/../modules/bluetooth/Kconfig"
source "$APPSDIR/../modules/dnnrt/Kconfig"
source "$APPSDIR/../modules/imageproc/Kconfig"
```

## sdk/modules/asmp/Kconfig
```kconfig
menu "ASMP"

config ASMP
	bool "ASMP"
	---help---
		A hybrid multi processor framework

if ASMP

config MM_TILE
	bool
	default y

config ASMP_MEMSIZE
	hex "ASMP shared memory size"
	default 0xc0000
	---help---
		Memory size for shared memory area in ASMP Framework.

config ASMP_SMALL_BLOCK
	bool "Small memory block"
	default n
	---help---
		Use small block size (64 KiB) to memory management.
		This option is for improve memory usage, but it tends to fragmentation.

menu "ASMP Worker libraries"

config ASMP_WORKER_LIBC
	bool "Support some libc functions in worker"
	default n
	---help---
		Support some libraries such as ctype, string, queue, fixedmath and etc. in worker.

config ASMP_WORKER_CMSIS
	bool "Support ARM CMSIS math library in worker"
	default n
	---help---
		Support ARM CMSIS math library in worker. For enabling this, you must set 
		CONFIG_EXTERNALS_CMSIS to build the library itself.

config ASMP_WORKER_FMSYNTH
	bool "Support fmsynth library in worker"
	default n
	---help---
		Support fmsynth library. The code is in sdk/apps/audioutils/fmsynth

endmenu

config ASMP_DEBUG_FEATURE
	bool "ASMP Framework debug feature"

if ASMP_DEBUG_FEATURE

config ASMP_DEBUG_ERROR
	bool "ASMP Framework debug error"

config ASMP_DEBUG_WARN
	bool "ASMP Framework debug warn"

config ASMP_DEBUG_INFO
	bool "ASMP Framework debug info"

endif # ASMP_DEBUG_FEATURE

endif # ASMP

endmenu
```
