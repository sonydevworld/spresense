## sdk/modules/audio/Kconfig
```kconfig
#
# For a description of the syntax of this configuration file,
# see the file kconfig-language.txt in the NuttX tools repository.
#

menu "SDK Audio"

config SDK_AUDIO
	bool "SDK audio"
	default n
	---help---
		Enable support for sdk audio

if SDK_AUDIO

menu "Audio Utilities"

source "$APPSDIR/../modules/audio/manager/Kconfig"

config AUDIOUTILS_PLAYER
	bool "Audio Player"
	default n
	select MEMUTILS_MEMORY_MANAGER
	select MEMUTILS_MESSAGE
	select MEMUTILS_S_STL
	select MEMUTILS_SIMPLE_FIFO
	select AUDIOUTILS_OUTPUTMIXER
	select AUDIOUTILS_DECODER
	select AUDIOUTILS_FILTER
	select AUDIOUTILS_RENDERER
	select AUDIOUTILS_DSP_DRIVER
	---help---
		Support Player Feature

if AUDIOUTILS_PLAYER
source "$APPSDIR/../modules/audio/playlist/Kconfig"

menu "Audio Player Supported Formats"
config AUDIOUTILS_PLAYER_CODEC_PCM
	bool "PCM Audio"
	default y
	---help---
		Supported only headerless PCM data

config AUDIOUTILS_PLAYER_CODEC_MP3
	bool "MP3"
	default y
	---help---
		Supported MPEG1 Audio Layer-3, MPEG2 Audio Layer-3

config AUDIOUTILS_PLAYER_CODEC_AAC
	bool "AAC"
	default y
	---help---
		Supported MPEG2 Advanced Audio Coding

config AUDIOUTILS_PLAYER_CODEC_OPUS
	bool "Opus"
	default y
	---help---
		Supported VoIP codec in Opus format

endmenu # Audio Player Codec Type

endif

config AUDIOUTILS_RECORDER
	bool "Audio Recorder"
	default n
	select AUDIOUTILS_SRC
	select AUDIOUTILS_MFE
	select MEMUTILS_MEMORY_MANAGER
	select MEMUTILS_MESSAGE
	select MEMUTILS_S_STL
	select MEMUTILS_SIMPLE_FIFO
	select AUDIOUTILS_ENCODER
	select AUDIOUTILS_FILTER
	select AUDIOUTILS_CAPTURE
	select AUDIOUTILS_DSP_DRIVER
	---help---
		Support Recorder Feature

config AUDIOUTILS_DIAG
	bool "Audio Diag"
	depends on CXD56_I2S0
	default n
	select MEMUTILS_MEMORY_MANAGER
	select MEMUTILS_MESSAGE
	select MEMUTILS_S_STL
	select MEMUTILS_SIMPLE_FIFO
	---help---
		Support Diag Feature

config AUDIOUTILS_VOICE_CALL
	bool "Voice Call"
	depends on CXD56_I2S0
	default n
	select AUDIOUTILS_MFE
	select AUDIOUTILS_MPP
	select MEMUTILS_MEMORY_MANAGER
	select MEMUTILS_MESSAGE
	select MEMUTILS_S_STL
	select MEMUTILS_SIMPLE_FIFO
	select AUDIOUTILS_RENDERER
	select AUDIOUTILS_FILTER
	select AUDIOUTILS_CAPTURE
	select AUDIOUTILS_DSP_DRIVER
	select AUDIOUTILS_SOUND_EFFECTOR
	---help---
		Support Voice Call Feature

config AUDIOUTILS_SOUND_RECOGNIZER
	bool "Sound Recognizer"
	default n
	select MEMUTILS_MEMORY_MANAGER
	select MEMUTILS_MESSAGE
	select MEMUTILS_S_STL
	select MEMUTILS_SIMPLE_FIFO
	select AUDIOUTILS_FILTER
	select AUDIOUTILS_CAPTURE
	select AUDIOUTILS_RECOGNITION
	select AUDIOUTILS_DSP_DRIVER
	---help---
		Support Voice Command Feature

config AUDIOUTILS_SYNTHESIZER
	bool "Audio Synthesizer"
	default n
	select MEMUTILS_MEMORY_MANAGER
	select MEMUTILS_MESSAGE
	select MEMUTILS_S_STL
	select MEMUTILS_SIMPLE_FIFO
	select AUDIOUTILS_FILTER
	select AUDIOUTILS_RENDERER
	select AUDIOUTILS_DSP_DRIVER
	---help---
		Support Synthesizer Feature

if AUDIOUTILS_RECORDER

config AUDIOUTILS_SRC
	bool "Sampling Rate Converter"
	default n
	---help---
		Enable Sampling Rate Converter filter
endif

config AUDIOUTILS_MFE
	bool "Mic Front End"
	default n
	---help---
		Enable Mic Front End Filter

config AUDIOUTILS_OUTPUTMIXER
	bool "Output Mixer"
	default n
	---help---
		Enable Output Mixer

config AUDIOUTILS_MPP
	bool "Media Player Post"
	default n
	---help---
		Enable Media Player Post Filter

if AUDIOUTILS_RECORDER || AUDIOUTILS_VOICE_CALL || AUDIOUTILS_SOUND_RECOGNIZER
config AUDIOUTILS_CAPTURE_CH_NUM
	int "Audio capture channel number"
	default 2
	---help---
		Set number of using resorce for DMA input channel
endif

if AUDIOUTILS_PLAYER || AUDIOUTILS_VOICE_CALL || AUDIOUTILS_SOUND_RECOGNIZER
config AUDIOUTILS_RENDERER_CH_NUM
	int "Audio renderer channel number"
	default 2
	---help---
		Set number of using resorce for DMA output channel
endif

config AUDIOUTILS_DSP_MOUNTPT
	string "DSP image mount path"
	default "/mnt/spif/BIN"
	---help---
		The path to the DSP mount point. Default: /mnt/spif/BIN"

config AUDIOUTILS_EVENTLOG
	bool "Print event log to console"
	default n
	---help---
		Print logs of audioutils. Event logs only, periodical log is not.

config AUDIOUTILS_STATELOG
	bool "Print state log to console"
	default n
	---help---
		Print logs of audioutils. State transition log will be printed.

config AUDIOUTILS_DETAILLOG
	bool "Print detail log to console"
	default n
	---help---
		Print logs of audioutils. Detail log will be printed.

config AUDIOUTILS_ATTENTIONLOG_DISABLE
	bool "Disable print attention log to console"
	default n
	---help---
		Disable attention log to print in console. default is [n].

menu "Audio component menu"
source "$APPSDIR/../modules/audio/components/Kconfig"
endmenu

config AUDIOUTILS_UNUSE_ORIGINAL_OPUS_FORMAT
	bool "Unuse original opus format"
	default n
	depends on AUDIOUTILS_PLAYER || AUDIOUTILS_RECORDER
	---help---
		Enable Unuse Original Opus Format

config AUDIOUTILS_DSP_DRIVER
	bool "DSP driver"
	default n
	---help---
		Enable DSP driver

config AUDIOUTILS_SOUND_EFFECTOR
	bool

endmenu # Audio Utilities

endif

endmenu
```

## sdk/modules/audio/components/Kconfig
```kconfig
#
# For a description of the syntax of this configuration file,
# see the file kconfig-language.txt in the NuttX tools repository.
#

config AUDIOUTILS_CAPTURE
	bool "Capture"
	default n
	---help---
		Enable Capture Feature

config AUDIOUTILS_DECODER
	bool "Decoder"
	default n
	---help---
		Enable Decode Feature

if AUDIOUTILS_DECODER
config AUDIOUTILS_DECODER_TIME_MEASUREMENT
	bool "Measure the decoding time and display the result"
	default n
	---help---
		Enable measure the decoding time
endif

config AUDIOUTILS_ENCODER
	bool "Encoder"
	default n
	---help---
		Enable Encode Feature

config AUDIOUTILS_FILTER
	bool "Filter"
	default n
	select AUDIOUTILS_CUSTOMPROC
	---help---
		Enable (Pre/Post) Filtering Feature

config AUDIOUTILS_RECOGNITION
	bool "Recognition"
	default n
	select AUDIOUTILS_CUSTOMPROC
	---help---
		Enable Recognition Feature

config AUDIOUTILS_RENDERER
	bool "Renderer"
	default n
	---help---
		Enable Renderer Feature
		
if AUDIOUTILS_RENDERER
config AUDIOUTILS_RENDERER_UNDERFLOW
	bool "Insert silence data at underflow"
	default n
	---help---
		Enable Insert silence data

endif

config AUDIOUTILS_CUSTOMPROC
	bool "User custom signal processing on DSP"
	default n
	---help---
		Enable Insert silence data

config AUDIOUTILS_DSP_DEBUG_DUMP
	bool "dsp debug dump"
	default n
	depends on CXD56_BACKUPLOG
	---help---
		Enable Dsp Debug Dump
```

## sdk/modules/audio/manager/Kconfig
```kconfig
#
# For a description of the syntax of this configuration file,
# see the file kconfig-language.txt in the NuttX tools repository.
#

config AUDIOUTILS_MANAGER
	bool "Audio manager"
	default n
	---help---
		Enable support for audio manager.

if AUDIOUTILS_MANAGER
endif
```

## sdk/modules/audio/playlist/Kconfig
```kconfig
#
# For a description of the syntax of this configuration file,
# see the file kconfig-language.txt in the NuttX tools repository.
#

config AUDIOUTILS_PLAYLIST
	bool "Playlist manager"
	default n
	---help---
		Enable support for playlist manager.
```

## sdk/modules/audiolite/Kconfig
```kconfig
#
# For a description of the syntax of this configuration file,
# see the file kconfig-language.txt in the NuttX tools repository.
#
#

menu "Audio Lite"

config AUDIO_LITE
	bool "Simple audio framework"
	default n
	---help---
		This is a simpler audio framework. Provides several audio component,
		such as audio input, audio output, mp3decorder, which can connect to
		each others and configure user original audio signal flow easier.

if AUDIO_LITE

menu "Debug feature"

config AL_DEBUG_ERR
	bool "Enable ERROR debug message"
	default n

config AL_DEBUG_WRN
	bool "Enable WARNNING debug message"
	default n

config AL_DEBUG_DBG
	bool "Enable DEBUG debug message"
	default n

config AL_DEBUG_INF
	bool "Enable INFO debug message"
	default n

endmenu # Debug feature

menu "Event Handler Thread"

config AL_EVTHDLR_PRIORITY
	int "Audio Lite Event Handler thread priority"
	default 105
	---help---
		Thread priority of Audio Lite event handler.

config AL_EVTHDLR_STACKSIZE
	int "Audio Lite Event Handler thread stack size"
	default 2048
	---help---
		Thread stack size of Audio Lite event handler.
		This value should adjust depending on how much stack
		is used in user function.

endmenu # Event Handler Thread

menu "Driver Settings"

config ALDRV_OUTDEVNAME
	string "Output Audio Device file path"
	default "/dev/audio/pcm1"
	---help---
		Audio output device file path of target audio device.

config ALDRV_INDEVNAME
	string "Output Audio Device file path"
	default "/dev/audio/pcm_in1"
	---help---
		Audio input device file path of target audio device.

config ALDRV_MSGQNAME
	string "Audio Lite Driver Message queue name"
	default "/tmp/aldrv_mq"
	---help---
		Message queue name (file path) to communicate with audio message loop.

config ALDRV_MQDEPTH
	int "Audio Lite Driver Message queue depth"
	default 4
	---help---
		Message queue depth.

config ALDRV_TRIGER_ENQCOUNT
	int "Audio Lite Driver threshold of enqueue count to start dma"
	default 3
	---help---
		Threshold of enqueue count. Driver DMA is not started until
		apbuffer is enqueued over this value.

config ALDRV_PRIO
	int "Audio Lite Driver thread priority"
	default 105
	---help---
		Thread priority of Audio Lite driver.

config ALDRV_STACKSZ
	int "Audio Lite Driver thread Stcack size"
	default 768
	---help---
		Thread stack size of Audio Lite driver.

endmenu # Driver settings

menu "Input Device Thread"

config ALINPUTCOMP_PRIO
	int "Audio Lite Input thread priority"
	default 105
	---help---
		Thread priority of Audio Lite Input component.

config ALINPUTCOMP_STACKSZ
	int "Audio Lite Input thread Stcack size"
	default 2048
	---help---
		Thread stack size of Audio Lite Input component.

endmenu # Input Device Thread

menu "Output Device Thread"

config ALOUTCOMP_PRIO
	int "Audio Lite Output thread priority"
	default 105
	---help---
		Thread priority of Audio Lite Output component.

config ALOUTCOMP_STACKSZ
	int "Audio Lite Output thread Stcack size"
	default 1024
	---help---
		Thread stack size of Audio Lite Output component.

endmenu # Output Device Thread

menu "Worker Supervisor Thread"

config AUDIOLITE_WSVR_DEFPRIO
	int "Audio Lite ASMP Supervisor thread default priority"
	default 105
	---help---
		Default thread priority of Audio Lite ASMP worker.

config AUDIOLITE_WSVR_DEFSTACK
	int "Audio Lite ASMP Supervisor thread default stack size"
	default 2048
	---help---
		Default thread stack size of Audio Lite ASMP worker.

endmenu # Worker Supervisor Thread

menu "MP3 Decorder Component"

config ALMP3DEC_INJECTPRIO
	int "Audio Lite MP3DEC component stream loader thread priority"
	default 105
	---help---
		Thread priority of Audio Lite MP3DEC component for stream loader.

config ALMP3DEC_INJECTSTACK
	int "Audio Lite MP3DEC component stream loader thread Stcack size"
	default 768
	---help---
		Thread stack size of Audio Lite MP3DEC component for stream loader.

config MP3DECSVR_PRIO
	int "Audio Lite MP3DEC component event handler thread priority"
	default 105
	---help---
		Thread priority of Audio Lite MP3DEC component for event handling.

config MP3DECSVR_STACKSZ
	int "Audio Lite MP3DEC component event handler thread Stcack size"
	default 768
	---help---
		Thread stack size of Audio Lite MP3DEC component for event handler.

config AUDIO_LITE_MP3DEC
	bool "MP3 Decoder component"
	default y
	---help---
		Enable MP3 decoder component which can decode MP3 frames to PCM data.
		The decorder core uses minimp3 with customized for Spresense.
		minimp3 is provided under Creative Common 0 License.
		Please see https://github.com/lieff/minimp3 for detais.

if AUDIO_LITE_MP3DEC

choice
	prompt "MP3 Subcore binary selection"
	default AUDIO_LITE_MP3DEC_SUBCORE_SPK
	---help---
		There are 2 options to provide for MP3 sub-core binary.
		One is a "spk" binary which is contained in firmware.bin. If choose
		this, user don't need to install other binaries as MP3 decorder,
		except your own nuttx.spk.
		The other is an "ELF" file, which is built as sub-core elf in build
		stage. If choose this, user can modify MP3 decoder by yoreself.
		But in the mean time, user needs to install the elf file in to flash
		memory.

config AUDIO_LITE_MP3DEC_SUBCORE_SPK
	bool "mp3dec.spk"

config AUDIO_LITE_MP3DEC_SUBCORE_ELF
	bool "mp3dec (ELF file)"

endchoice

if AUDIO_LITE_MP3DEC_SUBCORE_ELF

config AIDO_LITE_MP3DEC_SUBCORE_ELFNAME
	string "mp3dec ELF file path"
	default "/mnt/spif/mp3dec"
	---help---
		ELF file path on Spresense. To set mp3dec ELF file path to install, when
		you choose "mp3dec (ELF file)".
		If you want to install it in SPI-Flash on spresense main board, set "/mnt/spif/mp3dec".
		If you want to install it in top directory of SDCard on an extention board,
		set "/mnt/sd0/mp3dec".
		To enable this option, needs to enable EXTERNALS_CMSIS, ASMP and ASMP_WORKER_LIBC

endif # AUDIO_LITE_MP3DEC_SUBCORE_ELF

if AUDIO_LITE_MP3DEC_SUBCORE_SPK

config AUDIO_LITE_MP3DEC_SUBCORE_SPK_BUILD
	bool "Build mp3dec spk"
	default n
	---help---
		Enable build SPK file named "mp3dec.spk" in sdk/modules/audiolite/worker/mp3dec directory.
		If you want to use your built mp3dec.spk, you need flash it like
		  $ ./tools/flash.sh modules/audiolite/worker/mp3dec/mp3dec.spk

endif # AUDIO_LITE_MP3DEC_SUBCORE_SPK

if AUDIO_LITE_MP3DEC_SUBCORE_ELF || AUDIO_LITE_MP3DEC_SUBCORE_SPK_BUILD

config AUDIO_LITE_MP3DEC_SUBCORE_DEBUG
	bool "Enable Debug print in mo3dec Worker"
	default n
	---help---
		Enable display debug message from mp3dec worker. This debug message pass to UART1.
		And it is expected that the HW initialization has finished by main core.
		If you want to change it from UART1 to others, modify it in a source code.
		This makes that the worker takes long time to print information. So realtime playing
		will be stopped.

if AUDIO_LITE_MP3DEC_SUBCORE_DEBUG

config AUDIO_LITE_MP3DEC_SUBCORE_DEBUG_DETAIL
	bool "Enable print detail information of mo3dec Worker"
	default n
	---help---
		Enable display buffer status and pointer.

endif # AUDIO_LITE_MP3DEC_SUBCORE_DEBUG

endif # AUDIO_LITE_MP3DEC_SUBCORE_ELF || AUDIO_LITE_MP3DEC_SUBCORE_SPK_BUILD

endif # end of if AUDIO_LITE_MP3DEC

endmenu # MP3 Decorder Component

endif # end of if AUDIO_LITE

endmenu
```
