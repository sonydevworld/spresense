## sdk/configs/feature/lte-defconfig
```kconfig
CONFIG_CXD56_SPI=y
CONFIG_CXD56_DMAC_SPI4_TX_MAXSIZE=2064
CONFIG_CXD56_DMAC_SPI4_RX_MAXSIZE=2064
CONFIG_CXD56_LTE=y
CONFIG_MODEM=y
CONFIG_LTE=y
CONFIG_LTE_NET=y
CONFIG_LTE_INET=y
CONFIG_LTE_INET_ATON=y
CONFIG_LTE_NETDB=y
```

## sdk/configs/feature/lte_stub_mbedtls-defconfig
```kconfig
CONFIG_CXD56_SPI=y
CONFIG_CXD56_LTE=y
CONFIG_MODEM=y
CONFIG_LTE=y
CONFIG_LTE_NET=y
CONFIG_LTE_INET=y
CONFIG_LTE_INET_ATON=y
CONFIG_LTE_NETDB=y
CONFIG_LTE_NET_MBEDTLS=y
```
