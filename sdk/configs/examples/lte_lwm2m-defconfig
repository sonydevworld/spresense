## sdk/configs/examples/lte_lwm2m-defconfig
```kconfig
CONFIG_CXD56_SPI=y
CONFIG_CXD56_LTE=y
CONFIG_MODEM=y
CONFIG_LTE=y
CONFIG_LTE_NET=y
CONFIG_LTE_INET=y
CONFIG_LTE_INET_ATON=y
CONFIG_LTE_NETDB=y
CONFIG_NETUTILS_NETLIB=y
CONFIG_EXAMPLES_LTE_LWM2M=y
```

## sdk/configs/examples/lte_websocket-defconfig
```kconfig
CONFIG_CXD56_SPI=y
CONFIG_CXD56_DMAC_SPI4_TX_MAXSIZE=2064
CONFIG_CXD56_DMAC_SPI4_RX_MAXSIZE=2064
CONFIG_CXD56_LTE=y
CONFIG_MODEM=y
CONFIG_LTE=y
CONFIG_LTE_NET=y
CONFIG_LTE_INET=y
CONFIG_LTE_INET_ATON=y
CONFIG_LTE_NETDB=y
CONFIG_NETUTILS_NETLIB=y
CONFIG_EXAMPLES_LTE_WEBSOCKET=y
CONFIG_EXTERNALS_MBEDTLS=y
CONFIG_EXTERNALS_WEBSOCKET=y
```
