## sdk/configs/examples/audio_player_post-defconfig
```kconfig
CONFIG_CXD56_SDIO=y
CONFIG_CXD56_AUDIO=y
CONFIG_SDK_AUDIO=y
CONFIG_AUDIOUTILS_PLAYER=y
CONFIG_AUDIOUTILS_PLAYLIST=y
CONFIG_AUDIOUTILS_DSP_MOUNTPT="/mnt/sd0/BIN"
CONFIG_AUDIOUTILS_POSTPROC=y
CONFIG_MEMUTILS=y
CONFIG_ASMP=y
CONFIG_EXAMPLES_AUDIO_PLAYER_POST=y
```

## sdk/configs/examples/audio_recognizer-defconfig
```kconfig
CONFIG_CXD56_SDIO=y
CONFIG_CXD56_AUDIO=y
CONFIG_SDK_AUDIO=y
CONFIG_AUDIOUTILS_SOUND_RECOGNIZER=y
CONFIG_AUDIOUTILS_MFE=y
CONFIG_AUDIOUTILS_DSP_MOUNTPT="/mnt/sd0/BIN"
CONFIG_AUDIOUTILS_POSTPROC=y
CONFIG_MEMUTILS=y
CONFIG_ASMP=y
CONFIG_EXAMPLES_AUDIO_RECOGNIZER=y
```

## sdk/configs/examples/audio_sound_effector-defconfig
```kconfig
CONFIG_CXD56_AUDIO=y
CONFIG_SDK_AUDIO=y
CONFIG_AUDIOUTILS_MANAGER=y
CONFIG_AUDIOUTILS_MFE=y
CONFIG_AUDIOUTILS_OUTPUTMIXER=y
CONFIG_AUDIOUTILS_CAPTURE=y
CONFIG_AUDIOUTILS_FILTER=y
CONFIG_AUDIOUTILS_POSTPROC=y
CONFIG_AUDIOUTILS_RENDERER=y
CONFIG_AUDIOUTILS_DSP_DRIVER=y
CONFIG_MEMUTILS=y
CONFIG_MEMUTILS_MEMORY_MANAGER=y
CONFIG_MEMUTILS_MESSAGE=y
CONFIG_MEMUTILS_S_STL=y
CONFIG_MEMUTILS_SIMPLE_FIFO=y
CONFIG_ASMP=y
CONFIG_EXAMPLES_AUDIO_SOUND_EFFECTOR=y
```

## sdk/configs/examples/audio_through-defconfig
```kconfig
CONFIG_CXD56_AUDIO=y
CONFIG_SDK_AUDIO=y
CONFIG_AUDIOUTILS_MANAGER=y
CONFIG_MEMUTILS=y
CONFIG_MEMUTILS_MEMORY_MANAGER=y
CONFIG_MEMUTILS_MESSAGE=y
CONFIG_ASMP=y
CONFIG_EXAMPLES_AUDIO_THROUGH=y
```
