## sdk/configs/examples/camera-defconfig
```kconfig
CONFIG_CXD56_I2C=y
CONFIG_CXD56_I2C2=y
CONFIG_CXD56_CISIF=y
CONFIG_VIDEO=y
CONFIG_VIDEO_ISX012=y
CONFIG_CXD56_SDIO=y
CONFIG_EXAMPLES_CAMERA=y
```

## sdk/configs/examples/colorsensor-defconfig
```kconfig
CONFIG_CXD56_I2C=y
CONFIG_CXD56_I2C0=y
CONFIG_SENSORS=y
CONFIG_BH1745NUC=y
CONFIG_EXAMPLES_COLORSENSOR=y
```

## sdk/configs/examples/decimator-defconfig
```kconfig
CONFIG_CXD56_I2C0=y
CONFIG_CXD56_DECI_ACCEL=y
CONFIG_SENSORS=y
CONFIG_BMI160=y
CONFIG_BMI160_I2C=y
CONFIG_EXAMPLES_DECIMATOR=y
```

## sdk/configs/examples/dnnrt_lenet-defconfig
```kconfig
CONFIG_CXD56_SDIO=y
CONFIG_DNN_RT=y
CONFIG_EXTERNALS_CMSIS=y
CONFIG_EXAMPLES_DNNRT_LENET=y
```

## sdk/configs/examples/fft-defconfig
```kconfig
CONFIG_CXD56_SDIO=y
CONFIG_ASMP=y
CONFIG_EXAMPLES_FFT=y
CONFIG_EXTERNALS_CMSIS=y
# CONFIG_EXTERNALS_CMSIS_NN is not set
```
