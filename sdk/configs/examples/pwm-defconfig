## sdk/configs/examples/pwm-defconfig
```kconfig
CONFIG_CXD56_PWM=y
CONFIG_CXD56_PWM0=y
CONFIG_CXD56_PWM1=y
CONFIG_CXD56_PWM2=y
CONFIG_CXD56_PWM3=y
CONFIG_EXAMPLES_PWM=y
```

## sdk/configs/examples/sixaxis-defconfig
```kconfig
CONFIG_CXD56_I2C0=y
# CONFIG_CXD56_I2C0_SCUSEQ is not set
CONFIG_SENSORS=y
CONFIG_BMI160=y
CONFIG_BMI160_I2C=y
# CONFIG_BMI160_SCU is not set
CONFIG_EXAMPLES_SIXAXIS=y
```

## sdk/configs/examples/step_counter-defconfig
```kconfig
CONFIG_CXD56_I2C0=y
CONFIG_SENSORS=y
CONFIG_BMI160=y
CONFIG_BMI160_I2C=y
CONFIG_SENSING_MANAGER=y
CONFIG_SENSING_STEPCOUNTER=y
CONFIG_MEMUTILS=y
CONFIG_MEMUTILS_MEMORY_MANAGER=y
CONFIG_MEMUTILS_MESSAGE=y
CONFIG_ASMP=y
CONFIG_EXAMPLES_SENSOR_STEP_COUNTER=y
```

## sdk/configs/examples/tilt-defconfig
```kconfig
CONFIG_CXD56_I2C0=y
CONFIG_SENSORS=y
CONFIG_BMI160=y
CONFIG_BMI160_I2C=y
CONFIG_EXAMPLES_TILT=y
```

## sdk/configs/examples/transport_mode-defconfig
```kconfig
CONFIG_CXD56_I2C0=y
CONFIG_SENSORS=y
CONFIG_BMI160=y
CONFIG_BMI160_I2C=y
CONFIG_BMP280=y
CONFIG_AK09912=y
CONFIG_SENSING_MANAGER=y
CONFIG_SENSING_MANAGER_POWERCTRL=y
CONFIG_SENSING_BAROMETER=y
CONFIG_SENSING_TRAM=y
CONFIG_MEMUTILS=y
CONFIG_MEMUTILS_MEMORY_MANAGER=y
CONFIG_MEMUTILS_MESSAGE=y
CONFIG_ASMP=y
CONFIG_EXAMPLES_SENSOR_TRAM=y
```
