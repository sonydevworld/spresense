## sdk/configs/feature/audio_recognizer-defconfig
```kconfig
CONFIG_CXD56_SDIO=y
CONFIG_CXD56_AUDIO=y
CONFIG_SDK_AUDIO=y
CONFIG_AUDIOUTILS_SOUND_RECOGNIZER=y
CONFIG_AUDIOUTILS_MFE=y
CONFIG_AUDIOUTILS_POSTPROC=y
CONFIG_MEMUTILS=y
CONFIG_ASMP=y
```

## sdk/configs/feature/audio_recorder-defconfig
```kconfig
CONFIG_CXD56_SDIO=y
CONFIG_CXD56_AUDIO=y
CONFIG_SDK_AUDIO=y
CONFIG_AUDIOUTILS_RECORDER=y
CONFIG_MEMUTILS=y
CONFIG_ASMP=y
```

## sdk/configs/feature/audio_synthesizer-defconfig
```kconfig
CONFIG_CXD56_SDIO=y
CONFIG_CXD56_AUDIO=y
CONFIG_SDK_AUDIO=y
CONFIG_AUDIOUTILS_SYNTHESIZER=y
CONFIG_AUDIOUTILS_DSP_MOUNTPT="/mnt/sd0/BIN"
CONFIG_MEMUTILS=y
CONFIG_ASMP=y
CONFIG_EXTERNALS_CMSIS=y
# CONFIG_EXTERNALS_CMSIS_NN is not set
```
