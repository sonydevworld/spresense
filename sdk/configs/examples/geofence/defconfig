## sdk/configs/examples/gnss_atcmd-defconfig
```kconfig
CONFIG_CXD56_GNSS=y
CONFIG_GPSUTILS_CXD56NMEA_LIB=y
CONFIG_EXAMPLES_GNSS_ATCMD=y
```

## sdk/configs/examples/jpeg_decode-defconfig
```kconfig
CONFIG_CXD56_SDIO=y
CONFIG_EXTERNALS_LIBJPEG=y
CONFIG_EXAMPLES_JPEG_DECODE=y
CONFIG_EXAMPLES_JPEG_DECODE_STACKSIZE=2048
```

## sdk/configs/examples/light-defconfig
```kconfig
CONFIG_CXD56_I2C0=y
CONFIG_SENSORS=y
CONFIG_RPR0521RS=y
# CONFIG_RPR0521RS_PROXIMITY_INTERRUPT is not set
CONFIG_EXAMPLES_LIGHT=y
```

## sdk/configs/examples/lte_http_get-defconfig
```kconfig
CONFIG_CXD56_SPI=y
CONFIG_CXD56_LTE=y
CONFIG_MODEM=y
CONFIG_LTE=y
CONFIG_LTE_NET=y
CONFIG_LTE_INET=y
CONFIG_LTE_INET_ATON=y
CONFIG_LTE_NETDB=y
CONFIG_NETUTILS_NETLIB=y
CONFIG_NETUTILS_WEBCLIENT=y
CONFIG_EXAMPLES_LTE_HTTP_GET=y
```
