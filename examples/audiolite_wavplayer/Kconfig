## examples/direct_audio_micinput/Kconfig
```kconfig
config EXAMPLES_DIRECT_AUDIO_MICINPUT
	tristate "Audio Driver Direct sample : audio_micinput"
	default n
	---help---
		Enable the audio_micinput app
		This app input sound from the microphone.

if EXAMPLES_DIRECT_AUDIO_MICINPUT

config EXAMPLES_DIRECT_AUDIO_MICINPUT_PROGNAME
	string "Program name"
	default "audio_micinput"
	---help---
		This is the name of the program that will be use when the NSH ELF
		program is installed.

config EXAMPLES_DIRECT_AUDIO_MICINPUT_PRIORITY
	int "audio_micinput task priority"
	default 100

config EXAMPLES_DIRECT_AUDIO_MICINPUT_STACKSIZE
	int "audio_micinput stack size"
	default 2048

endif
```

## examples/direct_audio_sin/Kconfig
```kconfig
config EXAMPLES_DIRECT_AUDIO_SIN
	tristate "Audio Driver Direct sample : audio_sin"
	default n
	---help---
		Enable the simple_audio_sin app
		This app generate sin wave and play it to a speaker.

if EXAMPLES_DIRECT_AUDIO_SIN

config EXAMPLES_DIRECT_AUDIO_SIN_PROGNAME
	string "Program name"
	default "audio_sin"
	---help---
		This is the name of the program that will be use when the NSH ELF
		program is installed.

config EXAMPLES_DIRECT_AUDIO_SIN_PRIORITY
	int "audio_sin task priority"
	default 100

config EXAMPLES_DIRECT_AUDIO_SIN_STACKSIZE
	int "audio_sin stack size"
	default 2048

endif
```

## examples/direct_audio_through/Kconfig
```kconfig
config EXAMPLES_DIRECT_AUDIO_THROUGH
	tristate "Audio Driver Direct sample : audio_through"
	default n
	---help---
		Enable the audio_through app.
		This app outputs the sound input from the microphone
		directly to the speaker.

if EXAMPLES_DIRECT_AUDIO_THROUGH

config EXAMPLES_DIRECT_AUDIO_THROUGH_PROGNAME
	string "Program name"
	default "audio_through"
	---help---
		This is the name of the program that will be use when the NSH ELF
		program is installed.

config EXAMPLES_DIRECT_AUDIO_THROUGH_PRIORITY
	int "audio_through task priority"
	default 100

config EXAMPLES_DIRECT_AUDIO_THROUGH_STACKSIZE
	int "audio_through stack size"
	default 2048

endif
```

## examples/dnnrt_lenet/Kconfig
```kconfig
#
# For a description of the syntax of this configuration file,
# see the file kconfig-language.txt in the NuttX tools repository.
#

config EXAMPLES_DNNRT_LENET
	tristate "dnnrt example of LeNet-5"
	depends on DNN_RT
	default n
	---help---
		classify MNIST digits by LeNet-5

if EXAMPLES_DNNRT_LENET

config EXAMPLES_DNNRT_LENET_PROGNAME
	string "Program name"
	default "dnnrt_lenet"
	---help---
		This is the name of the program that will be use when the NSH ELF
		program is installed.

config EXAMPLES_DNNRT_LENET_PRIORITY
	int "dnnrt_lenet task priority"
	default 100

config EXAMPLES_DNNRT_LENET_STACKSIZE
	int "dnnrt_lenet stack size"
	default 2048

endif
```

## examples/dsc/Kconfig
```kconfig
config EXAMPLES_DSC
	tristate "Digital Still Camera(DSC) application"
	default n
	---help---
		Enable the dsc app

if EXAMPLES_DSC

config EXAMPLES_DSC_PROGNAME
	string "Program name"
	default "dsc"
	---help---
		This is the name of the program that will be use when the NSH ELF
		program is installed.

config EXAMPLES_DSC_PRIORITY
	int "DSC task priority"
	default 100

config EXAMPLES_DSC_STACKSIZE
	int "DSC stack size"
	default 2048

choice
	prompt "DSC Input Device"
	default EXAMPLES_DSC_BUTTON_INPUT

config EXAMPLES_DSC_BUTTON_INPUT
	bool "Button Input"

config EXAMPLES_DSC_KEYBOARD_INPUT
	bool "Keyboard Input"

endchoice

endif
```

## examples/eltres_eeprom/Kconfig
```kconfig
#
# For a description of the syntax of this configuration file,
# see the file kconfig-language.txt in the NuttX tools repository.
#

config EXAMPLES_ELTRES_EEPROM
	tristate "ELTRES EEPROM read/write sample application"
	depends on EXTERNALS_ELTRES
	default n
	---help---
		Enable the ELTRES EEPROM sample application

if EXAMPLES_ELTRES_EEPROM

config EXAMPLES_ELTRES_EEPROM_PROGNAME
	string "Program name"
	default "eltres_eeprom"
	---help---
		This is the name of the program that will be used when the NSH ELF
		program is installed.

config EXAMPLES_ELTRES_EEPROM_PRIORITY
	int "ELTRES EEPROM sample application task priority"
	default 100

config EXAMPLES_ELTRES_EEPROM_STACKSIZE
	int "ELTRES eeprom sample application stack size"
	default DEFAULT_TASK_STACKSIZE

endif
```

## examples/eltres_lpwa/Kconfig
```kconfig
#
# For a description of the syntax of this configuration file,
# see the file kconfig-language.txt in the NuttX tools repository.
#

config EXAMPLES_ELTRES_LPWA
	tristate "ELTRES LPWA sample application"
	depends on EXTERNALS_ELTRES
	default n
	---help---
		Enable the ELTRES LPWA sample application

if EXAMPLES_ELTRES_LPWA

config EXAMPLES_ELTRES_LPWA_PROGNAME
	string "Program name"
	default "eltres_lpwa"
	---help---
		This is the name of the program that will be used when the NSH ELF
		program is installed.

config EXAMPLES_ELTRES_LPWA_PRIORITY
	int "ELTRES LPWA sample application task priority"
	default 100

config EXAMPLES_ELTRES_LPWA_STACKSIZE
	int "ELTRES LPWA sample application stack size"
	default DEFAULT_TASK_STACKSIZE

endif
```
