## examples/audiolite_wavplayer/Kconfig
```kconfig
config EXAMPLES_AUDIOLITE_WAVPLAYER
	tristate "AudioLite sample : audiolite_wavplayer app"
	default n
	---help---
		Enable the audiolite_wavplayer app

if EXAMPLES_AUDIOLITE_WAVPLAYER

config EXAMPLES_AUDIOLITE_WAVPLAYER_PROGNAME
	string "Program name"
	default "audiolite_wavplayer"
	---help---
		This is the name of the program that will be use when the NSH ELF
		program is installed.

config EXAMPLES_AUDIOLITE_WAVPLAYER_PRIORITY
	int "audiolite_wavplayer task priority"
	default 100

config EXAMPLES_AUDIOLITE_WAVPLAYER_STACKSIZE
	int "audiolite_wavplayer stack size"
	default 2048

endif
```

## examples/audiolite_wavrecorder/Kconfig
```kconfig
config EXAMPLES_AUDIOLITE_RECORDER
	tristate "AudioLite sample : audiolite_wavrecorder app"
	default n
	---help---
		Enable the audiolite_wavrecorder app

if EXAMPLES_AUDIOLITE_RECORDER

config EXAMPLES_AUDIOLITE_RECORDER_PROGNAME
	string "Program name"
	default "audiolite_wavrecorder"
	---help---
		This is the name of the program that will be use when the NSH ELF
		program is installed.

config EXAMPLES_AUDIOLITE_RECORDER_PRIORITY
	int "audiolite_wavrecorder task priority"
	default 100

config EXAMPLES_AUDIOLITE_RECORDER_STACKSIZE
	int "audiolite_wavrecorder stack size"
	default 2048

endif
```

## examples/awsiot_gnsslogger/Kconfig
```kconfig
config EXAMPLES_AWSIOT_GNSSLOGGER
	tristate "GNSS logger to AWS IoT"
	default n
	---help---
		Sample application of publishing GNSS location to AWS IoT

if EXAMPLES_AWSIOT_GNSSLOGGER

config EXAMPLES_AWSIOT_GNSSLOGGER_PROGNAME
	string "Program name"
	default "awsiot_gnsslogger"
	---help---
		This is the name of the program that will be use when the NSH ELF
		program is installed.

config EXAMPLES_AWSIOT_GNSSLOGGER_PRIORITY
	int "awsiot_gnsslogger task priority"
	default 100

config EXAMPLES_AWSIOT_GNSSLOGGER_STACKSIZE
	int "awsiot_gnsslogger stack size"
	default 8192

config EXAMPLES_AWSIOT_GNSSLOGGER_PUBSUB_TEST
	bool "Test publish and subscribe to/from AWS IoT Core"
	default n
	---help---
		Simple test of publish and subscribe to/from AWS IoT Core.

config EXAMPLES_AWSIOT_GNSSLOGGER_GPS_DEVNAME
	string "GNSS device name"
	default "/dev/gps2" if CXD56_GNSS_ADDON
	default "/dev/gps"

endif
```

## examples/ble_midi_central/Kconfig
```kconfig
config EXAMPLES_BLE_MIDI_CENTRAL
	tristate "Bluetooth LE MIDI Central example"
	default n
	---help---
		Enable the ble_midi_central app

if EXAMPLES_BLE_MIDI_CENTRAL

config EXAMPLES_BLE_MIDI_CENTRAL_PROGNAME
	string "Program name"
	default "ble_midi_central"
	---help---
		This is the name of the program that will be use when the NSH ELF
		program is installed.

config EXAMPLES_BLE_MIDI_CENTRAL_PRIORITY
	int "ble_midi_central task priority"
	default 100

config EXAMPLES_BLE_MIDI_CENTRAL_STACKSIZE
	int "ble_midi_central stack size"
	default 2048

endif
```

## examples/ble_mouse_central/Kconfig
```kconfig
#
# For a description of the syntax of this configuration file,
# see the file kconfig-language.txt in the NuttX tools repository.
#

config EXAMPLES_BLE_MOUSE_CENTRAL
	tristate "BLE Mouse Central example"
	default n
	---help---
		Enable the ble_mouse_central app

if EXAMPLES_BLE_MOUSE_CENTRAL

config EXAMPLES_BLE_MOUSE_CENTRAL_PROGNAME
	string "Program name"
	default "ble_mouse_central"
	---help---
		This is the name of the program that will be use when the NSH ELF
		program is installed.

config EXAMPLES_BLE_MOUSE_CENTRAL_PRIORITY
	int "ble_mouse_central task priority"
	default 100

config EXAMPLES_BLE_MOUSE_CENTRAL_STACKSIZE
	int "ble_mouse_central stack size"
	default DEFAULT_TASK_STACKSIZE

config EXAMPLES_BLE_MOUSE_INPUT_DEVICE
	bool "Enable BLE mouse input device"
	select INPUT
	select INPUT_MOUSE
	default n
	---help---
		Use BLE mouse as an input device.

if EXAMPLES_BLE_MOUSE_INPUT_DEVICE

config EXAMPLES_BLE_MOUSE_INPUT_DEVPATH
	string "BLE mouse device path"
	default "/dev/mouse0"
	---help---
		The path to the BLE mouse device. Default: "/dev/mouse0"

config EXAMPLES_BLE_MOUSE_READER_PROGNAME
	string "Program name"
	default "mouse_reader"
	---help---
		This is the name of the program that will be use when the NSH ELF
		program is installed.

config EXAMPLES_BLE_MOUSE_READER_PRIORITY
	int "mouse_reader task priority"
	default 100

config EXAMPLES_BLE_MOUSE_READER_STACKSIZE
	int "mouse_reader stack size"
	default DEFAULT_TASK_STACKSIZE

endif # EXAMPLES_BLE_MOUSE_INPUT_DEVICE

endif # EXAMPLES_BLE_MOUSE_CENTRAL
```

## examples/ble_toio_central/Kconfig
```kconfig
#
# For a description of the syntax of this configuration file,
# see the file kconfig-language.txt in the NuttX tools repository.
#

config EXAMPLES_BLE_TOIO_CENTRAL
	tristate "BLE toio Central example"
	default n
	---help---
		Enable the ble_toio_central app

if EXAMPLES_BLE_TOIO_CENTRAL

config EXAMPLES_BLE_TOIO_CENTRAL_PROGNAME
	string "Program name"
	default "ble_toio_central"
	---help---
		This is the name of the program that will be use when the NSH ELF
		program is installed.

config EXAMPLES_BLE_TOIO_CENTRAL_PRIORITY
	int "ble_toio_central task priority"
	default 100

config EXAMPLES_BLE_TOIO_CENTRAL_STACKSIZE
	int "ble_toio_central stack size"
	default DEFAULT_TASK_STACKSIZE

endif # EXAMPLES_BLE_TOIO_CENTRAL
```

## examples/bluetooth_a2dp_snk/Kconfig
```kconfig
#
# For a description of the syntax of this configuration file,
# see the file kconfig-language.txt in the NuttX tools repository.
#

config EXAMPLES_BLUETOOTH_A2DP_SNK
	tristate "Bluetooth A2DP Sink example"
	default n
	---help---
		Enable the bluetooth A2DP Sink example

if EXAMPLES_BLUETOOTH_A2DP_SNK

config EXAMPLES_BLUETOOTH_A2DP_SNK_PROGNAME
	string "Program name"
	default "bt_a2dp_snk"
	---help---
		This is the name of the program that will be use when the NSH ELF
		program is installed.

config EXAMPLES_BLUETOOTH_A2DP_SNK_PRIORITY
	int "Task priority"
	default 100

config EXAMPLES_BLUETOOTH_A2DP_SNK_STACKSIZE
	int "Stack size"
	default 2048

endif
```

## examples/bluetooth_hfp_hf/Kconfig
```kconfig
#
# For a description of the syntax of this configuration file,
# see the file kconfig-language.txt in the NuttX tools repository.
#

config EXAMPLES_BLUETOOTH_HFP_HF
	tristate "Bluetooth Hands Free Profile example"
	default n
	---help---
		Enable the bluetooth HFP_HF example

if EXAMPLES_BLUETOOTH_HFP_HF

config EXAMPLES_BLUETOOTH_HFP_HF_PROGNAME
	string "Program name"
	default "bt_hfp_hf"
	---help---
		This is the name of the program that will be use when the NSH ELF
		program is installed.

config EXAMPLES_BLUETOOTH_HFP_HF_PRIORITY
	int "Task priority"
	default 100

config EXAMPLES_BLUETOOTH_HFP_HF_STACKSIZE
	int "Stack size"
	default 2048

endif
```

## examples/bluetooth_le_central/Kconfig
```kconfig
#
# For a description of the syntax of this configuration file,
# see the file kconfig-language.txt in the NuttX tools repository.
#

config EXAMPLES_BLUETOOTH_LE_CENTRAL
	tristate "Bluetooth low energy GATT central example"
	default n
	---help---
		Enable the bluetooth LE central example

if EXAMPLES_BLUETOOTH_LE_CENTRAL

config EXAMPLES_BLUETOOTH_LE_CENTRAL_PROGNAME
	string "Program name"
	default "ble_central"
	---help---
		This is the name of the program that will be use when the NSH ELF
		program is installed.

config EXAMPLES_BLUETOOTH_LE_CENTRAL_PRIORITY
	int "Task priority"
	default 100

config EXAMPLES_BLUETOOTH_LE_CENTRAL_STACKSIZE
	int "Stack size"
	default 2048

endif
```

## examples/bluetooth_le_peripheral/Kconfig
```kconfig
#
# For a description of the syntax of this configuration file,
# see the file kconfig-language.txt in the NuttX tools repository.
#

config EXAMPLES_BLUETOOTH_LE_PERIPHERAL
	tristate "Bluetooth low energy GATT peripheral example"
	default n
	---help---
		Enable the bluetooth LE peripheral example

if EXAMPLES_BLUETOOTH_LE_PERIPHERAL

config EXAMPLES_BLUETOOTH_LE_PERIPHERAL_PROGNAME
	string "Program name"
	default "ble_peripheral"
	---help---
		This is the name of the program that will be use when the NSH ELF
		program is installed.

config EXAMPLES_BLUETOOTH_LE_PERIPHERAL_SNK_PRIORITY
	int "Task priority"
	default 100

config EXAMPLES_BLUETOOTH_LE_PERIPHERAL_STACKSIZE
	int "Stack size"
	default 2560

endif
```

## examples/bluetooth_spp/Kconfig
```kconfig
#
# For a description of the syntax of this configuration file,
# see the file kconfig-language.txt in the NuttX tools repository.
#

config EXAMPLES_BLUETOOTH_SPP
	tristate "Bluetooth Serial port profile example"
	default n
	---help---
		Enable the bluetooth SPP example

if EXAMPLES_BLUETOOTH_SPP

config EXAMPLES_BLUETOOTH_SPP_PROGNAME
	string "Program name"
	default "bt_spp"
	---help---
		This is the name of the program that will be use when the NSH ELF
		program is installed.

config EXAMPLES_BLUETOOTH_SPP_PRIORITY
	int "Task priority"
	default 100

config EXAMPLES_BLUETOOTH_SPP_STACKSIZE
	int "Stack size"
	default 2560

endif
```

## examples/camera/Kconfig
```kconfig
#
# For a description of the syntax of this configuration file,
# see the file kconfig-language.txt in the NuttX tools repository.
#

config EXAMPLES_CAMERA
	bool "Camera example"
	default n
	---help---
		Enable the camera example

if EXAMPLES_CAMERA

config EXAMPLES_CAMERA_PROGNAME
	string "Program name"
	default "camera"
	depends on BUILD_KERNEL
	---help---
		This is the name of the program that will be use when the NSH ELF
		program is installed.

config EXAMPLES_CAMERA_PRIORITY
	int "Camera task priority"
	default 100

config EXAMPLES_CAMERA_STACKSIZE
	int "Camera stack size"
	default 2048

config EXAMPLES_CAMERA_OUTPUT_LCD
	bool "Output LCD"

endif
```

## examples/cobs/Kconfig
```kconfig
config EXAMPLES_COBS
	tristate "COBS-C Sample Code"
	default n
	---help---
		Enable the cobs app

if EXAMPLES_COBS

config EXAMPLES_COBS_PROGNAME
	string "Program name"
	default "cobs"
	---help---
		This is the name of the program that will be use when the NSH ELF
		program is installed.

config EXAMPLES_COBS_PRIORITY
	int "cobs task priority"
	default 100

config EXAMPLES_COBS_STACKSIZE
	int "cobs stack size"
	default 2048

endif
```

## examples/colorsensor/Kconfig
```kconfig
#
# For a description of the syntax of this configuration file,
# see the file kconfig-language.txt in the NuttX tools repository.
#

config EXAMPLES_COLORSENSOR
	tristate "Color sensor example"
	default n
	depends on SENSORS_BH1745NUC_SCU
	---help---
		Enable the sensor via SCU example

if EXAMPLES_COLORSENSOR

config EXAMPLES_COLORSENSOR_PROGNAME
	string "Program name"
	default "colorsensor"
	---help---
		This is the name of the program that will be use when the NSH ELF
		program is installed.

config EXAMPLES_COLORSENSOR_PRIORITY
	int "Sensor task priority"
	default 100

config EXAMPLES_COLORSENSOR_STACKSIZE
	int "Sensor stack size"
	default 2048

config EXAMPLES_COLORSENSOR_DEVNAME
	string "Color sensor device name"
	default "/dev/color0"

config EXAMPLES_COLORSENSOR_SIGNO
	int "Color sensor signal"
	default 14

endif
```

## examples/cxd5602pwbimu/Kconfig
```kconfig
config EXAMPLES_CXD5602PWBIMU
	tristate "CXD5602PWBIMU example"
	default n
	---help---
		Enable the pwbimu app

if EXAMPLES_CXD5602PWBIMU

config EXAMPLES_CXD5602PWBIMU_PROGNAME
	string "Program name"
	default "pwbimu"
	---help---
		This is the name of the program that will be use when the NSH ELF
		program is installed.

config EXAMPLES_CXD5602PWBIMU_PRIORITY
	int "pwbimu task priority"
	default 100

config EXAMPLES_CXD5602PWBIMU_STACKSIZE
	int "pwbimu stack size"
	default 2048

endif
```

## examples/cxd5602pwbimu_logger/Kconfig
```kconfig
config EXAMPLES_CXD5602PWBIMU_LOGGER
	tristate "CXD5602PWBIMU : Sample code to log the IMU raw data"
	default n
	---help---
		Enable the cxd5602pwbimu_logger app

if EXAMPLES_CXD5602PWBIMU_LOGGER

config EXAMPLES_CXD5602PWBIMU_LOGGER_PROGNAME
	string "Program name"
	default "pwbimu_logger"
	---help---
		This is the name of the program that will be use when the NSH ELF
		program is installed.

config EXAMPLES_CXD5602PWBIMU_LOGGER_PRIORITY
	int "pwbimu_logger task priority"
	default 100

config EXAMPLES_CXD5602PWBIMU_LOGGER_STACKSIZE
	int "pwbimu_logger stack size"
	default 2048

endif
```

## examples/decimator/Kconfig
```kconfig
#
# For a description of the syntax of this configuration file,
# see the file kconfig-language.txt in the NuttX tools repository.
#

config EXAMPLES_DECIMATOR
	tristate "SCU decimator example"
	default n
	---help---
		This is a example of SCU decimator. This example needs the sensor
		is assigned to decimator. See SCU Decimator assignments option.

if EXAMPLES_DECIMATOR

config EXAMPLES_DECIMATOR_PROGNAME
	string "Program name"
	default "decimator"
	---help---
		This is the name of the program that will be use when the NSH ELF
		program is installed.

config EXAMPLES_DECIMATOR_PRIORITY
	int "Example task priority"
	default 100

config EXAMPLES_DECIMATOR_STACKSIZE
	int "Example stack size"
	default 2048

config EXAMPLES_DECIMATOR0_DEVNAME
    string "Sensor 0 device name"
    default "/dev/accel0"

config EXAMPLES_DECIMATOR0_SIGNO
    int "Sensor signal"
    default 13

config EXAMPLES_DECIMATOR1_DEVNAME
    string "Sensor 1 device name"
    default "/dev/accel1"

config EXAMPLES_DECIMATOR1_SIGNO
    int "Sensor signal"
    default 14

endif
```

## examples/digital_filter/Kconfig
```kconfig
config EXAMPLES_DIGITAL_FILTER
	tristate "Digital filters example"
	default n
	---help---
		Enable the several apps base on digital_filter module.

if EXAMPLES_DIGITAL_FILTER

menu "FIR filter example app"

config EXAMPLES_FIR_FIR_PROGNAME
	string "Program name"
	default "fir"
	---help---
		This is the name of the program that will be use when the NSH ELF
		program is installed. This "fir" creates a wav file filtered from input wav file.

config EXAMPLES_FIR_FIR_PRIORITY
	int "fir task priority"
	default 100

config EXAMPLES_FIR_FIR_STACKSIZE
	int "fir stack size"
	default 2048

endmenu # "FIR filter example app"

menu "Decimation filter example app"

config EXAMPLES_FIR_DECIMATOR_PROGNAME
	string "Program name"
	default "decimate"
	---help---
		This is the name of the program that will be use when the NSH ELF
		program is installed. This "decimate" creates a wav file decimated from input wav file.

config EXAMPLES_FIR_DECIMATOR_PRIORITY
	int "decimate task priority"
	default 100

config EXAMPLES_FIR_DECIMATOR_STACKSIZE
	int "decimate stack size"
	default 2048

endmenu # "Decimation filter example app"

menu "Envelope example app"

config EXAMPLES_ENVELOPE_PROGNAME
	string "Program name"
	default "envelope"
	---help---
		This is the name of the program that will be use when the NSH ELF
		program is installed.

config EXAMPLES_ENVELOPE_PRIORITY
	int "envelope task priority"
	default 100

config EXAMPLES_ENVELOPE_STACKSIZE
	int "envelope stack size"
	default 2048

endmenu # "Decimation filter example app"

menu "Edge example app"

config EXAMPLES_EDGE_PROGNAME
	string "Program name"
	default "edge"
	---help---
		This is the name of the program that will be use when the NSH ELF
		program is installed.

config EXAMPLES_EDGE_PRIORITY
	int "edge task priority"
	default 100

config EXAMPLES_EDGE_STACKSIZE
	int "edge stack size"
	default 2048

endmenu # "Edge example app"

menu "Edge16 example app"

config EXAMPLES_EDGE16_PROGNAME
	string "Program name"
	default "edge16"
	---help---
		This is the name of the program that will be use when the NSH ELF
		program is installed.

config EXAMPLES_EDGE16_PRIORITY
	int "edge16 task priority"
	default 100

config EXAMPLES_EDGE16_STACKSIZE
	int "edge16 stack size"
	default 2048

endmenu # "Edge example app"

endif
```
