## examples/hostif/Kconfig
```kconfig
#
# For a description of the syntax of this configuration file,
# see the file kconfig-language.txt in the NuttX tools repository.
#

config EXAMPLES_HOSTIF
	tristate "Host Interface example"
	default n
	depends on CXD56_HOSTIF
	---help---
		Enable the Host Interface example application with I2C and SPI slave
		communication. It supports to communicate with a host device which
		has the I2C or SPI master function.

if EXAMPLES_HOSTIF

config EXAMPLES_HOSTIF_PROGNAME
	string "Program name"
	default "hostif"
	---help---
		This is the name of the program that will be use when the NSH ELF
		program is installed.

config EXAMPLES_HOSTIF_PRIORITY
	int "hostif task priority"
	default 100

config EXAMPLES_HOSTIF_STACKSIZE
	int "hostif stack size"
	default 2048

choice
	prompt "HostIF peripheral"
	default EXAMPLES_HOSTIF_I2C

config EXAMPLES_HOSTIF_I2C
	bool "I2C"

config EXAMPLES_HOSTIF_SPI
	bool "SPI"

endchoice

config EXAMPLES_HOSTIF_HOST_I2C
	bool "Test Host I2C example"
	depends on EXAMPLES_HOSTIF && EXAMPLES_HOSTIF_I2C
	default n
	---help---
		Enable the example application for the host to communicate with the
		device which has the host interface of I2C.

if EXAMPLES_HOSTIF_HOST_I2C

config EXAMPLES_HOSTIF_HOST_I2C_PROGNAME
	string "Program name"
	default "host_i2c"
	---help---
		This is the name of the program that will be use when the NSH ELF
		program is installed.

config EXAMPLES_HOSTIF_HOST_I2C_PRIORITY
	int "host_i2c task priority"
	default 100

config EXAMPLES_HOSTIF_HOST_I2C_STACKSIZE
	int "host_i2c stack size"
	default 2048

endif # EXAMPLES_HOSTIF_HOST_I2C

config EXAMPLES_HOSTIF_HOST_SPI
	bool "Test Host SPI example"
	depends on EXAMPLES_HOSTIF && EXAMPLES_HOSTIF_SPI
	default n
	---help---
		Enable the example application for the host to communicate with the
		device which has the host interface of SPI.

if EXAMPLES_HOSTIF_HOST_SPI

config EXAMPLES_HOSTIF_HOST_SPI_PROGNAME
	string "Program name"
	default "host_spi"
	---help---
		This is the name of the program that will be use when the NSH ELF
		program is installed.

config EXAMPLES_HOSTIF_HOST_SPI_PRIORITY
	int "host_spi task priority"
	default 100

config EXAMPLES_HOSTIF_HOST_SPI_STACKSIZE
	int "host_spi stack size"
	default 2048

endif # EXAMPLES_HOSTIF_HOST_SPI

endif # EXAMPLES_HOSTIF
```

## examples/i2c_direct/Kconfig
```kconfig
#
# For a description of the syntax of this configuration file,
# see the file kconfig-language.txt in the NuttX tools repository.
#

config EXAMPLES_I2C_DIRECT
	tristate "I2C direct to control sensor (like BMI270 6axis-IMU)"
	default n
	---help---
		Enable the i2c_direct without SCU function

if EXAMPLES_I2C_DIRECT

config EXAMPLES_I2C_DIRECT_PROGNAME
	string "Program name"
	default "i2c_direct"
	---help---
		This is the name of the program that will be use when the NSH ELF
		program is installed.

config EXAMPLES_I2C_DIRECT_PRIORITY
	int "i2c_direct task priority"
	default 100

config EXAMPLES_I2C_DIRECT_STACKSIZE
	int "i2c_direct stack size"
	default 2048

config EXAMPLES_I2C_DIRECT_DEBUG_ON
	bool "Enable Debug Print"
	default n
	---help---
		Enable the Debug print in i2c_direct
	
if EXAMPLES_I2C_DIRECT_DEBUG_ON

config EXAMPLES_I2C_DIRECT_DPRINT_DEBUG
	bool "Enable Debug Print (DEBUG) in i2c_direct"
	default n
	---help---
		Enable the DEBUG Debug print in i2c_direct

config EXAMPLES_I2C_DIRECT_DPRINT_TRACE
	bool "Enable Debug Print (TRACE) in i2c_direct"
	default n
	---help---
		Enable the TRACE Debug print in i2c_direct

config EXAMPLES_I2C_DIRECT_DPRINT_INFO
	bool "Enable Debug Print (INFO) in i2c_direct"
	default n
	---help---
		Enable the INFO Debug print in i2c_direct

config EXAMPLES_I2C_DIRECT_DPRINT_WARN
	bool "Enable Debug Print (WARN) in i2c_direct"
	default n
	---help---
		Enable the WARN Debug print in i2c_direct

config EXAMPLES_I2C_DIRECT_DPRINT_ERROR
	bool "Enable Debug Print (ERROR) in i2c_direct"
	default n
	---help---
		Enable the ERROR Debug print in i2c_direct
endif

endif
```

## examples/jpeg_decode/Kconfig
```kconfig
#
# For a description of the syntax of this configuration file,
# see the file kconfig-language.txt in the NuttX tools repository.
#

config EXAMPLES_JPEG_DECODE
	tristate "JPEG decode example"
	default n
	---help---
		Enable the JPEG decode example

if EXAMPLES_JPEG_DECODE

config EXAMPLES_JPEG_DECODE_PROGNAME
	string "Program name"
	default "jpeg_decode"
	---help---
		This is the name of the program that will be use when the NSH ELF
		program is installed.

config EXAMPLES_JPEG_DECODE_PRIORITY
	int "JPEG decode task priority"
	default 100

config EXAMPLES_JPEG_DECODE_STACKSIZE
	int "JPEG decode stack size"
	default 2048

config EXAMPLES_JPEG_DECODE_OUTPUT_LCD
	bool "Output LCD"

endif
```

## examples/led_blink/Kconfig
```kconfig
config EXAMPLES_LED_BLINK
	tristate "LED drive example"
	default n
	---help---
		Enable the led_blink app

if EXAMPLES_LED_BLINK

config EXAMPLES_LED_BLINK_PROGNAME
	string "Program name"
	default "led_blink"
	---help---
		This is the name of the program that will be use when the NSH ELF
		program is installed.

config EXAMPLES_LED_BLINK_PRIORITY
	int "led_blink task priority"
	default 100

config EXAMPLES_LED_BLINK_STACKSIZE
	int "led_blink stack size"
	default 2048

endif
```

## examples/led_ctrl/Kconfig
```kconfig
config EXAMPLES_LED_CTRL
	tristate "LED Control command"
	default n
	---help---
		Enable the led_ctrl app.
		This can achive to control LEDs on Spresense Main board.

if EXAMPLES_LED_CTRL

config EXAMPLES_LED_CTRL_PROGNAME
	string "Program name"
	default "led_ctrl"
	---help---
		This is the name of the program that will be use when the NSH ELF
		program is installed.

config EXAMPLES_LED_CTRL_PRIORITY
	int "led_ctrl task priority"
	default 100

config EXAMPLES_LED_CTRL_STACKSIZE
	int "led_ctrl stack size"
	default 2048

endif
```

## examples/light/Kconfig
```kconfig
#
# For a description of the syntax of this configuration file,
# see the file kconfig-language.txt in the NuttX tools repository.
#

config EXAMPLES_LIGHT
	tristate "Light sensor example"
	default n
	depends on SENSORS_APDS9930_SCU || SENSORS_LT1PA01_SCU || SENSORS_BH1721FVC_SCU || SENSORS_RPR0521RS_SCU
	---help---
		Enable the sensor via SCU example

if EXAMPLES_LIGHT

config EXAMPLES_LIGHT_PROGNAME
	string "Program name"
	default "light"
	---help---
		This is the name of the program that will be use when the NSH ELF
		program is installed.

config EXAMPLES_LIGHT_PRIORITY
	int "Sensor task priority"
	default 100

config EXAMPLES_LIGHT_STACKSIZE
	int "Sensor stack size"
	default 2048

config EXAMPLES_LIGHT_DEVNAME
	string "Light sensor device name"
	default "/dev/light0"

config EXAMPLES_LIGHT_SIGNO
	int "Light sensor signal"
	default 14

endif
```

## examples/lte_awsiot/Kconfig
```kconfig
#
# For a description of the syntax of this configuration file,
# see the file kconfig-language.txt in the NuttX tools repository.
#

config EXAMPLES_LTE_AWSIOT
	tristate "AWS IoT using LTE example"
	default n
	---help---
		Enable the AWS IoT using LTE example

if EXAMPLES_LTE_AWSIOT

config EXAMPLES_LTE_AWSIOT_PROGNAME
	string "Program name"
	default "lte_awsiot"
	---help---
		This is the name of the program that will be use when the NSH ELF
		program is installed.

config EXAMPLES_LTE_AWSIOT_PRIORITY
	int "lte_awsiot task priority"
	default 100

config EXAMPLES_LTE_AWSIOT_STACKSIZE
	int "lte_awsiot stack size"
	default 7168

config EXAMPLES_LTE_AWSIOT_STACKSIZE_IN_USING_MBEDTLS
	int "lte_awsiot stack size in using mbedTLS"
	default 10240

config EXAMPLES_LTE_AWSIOT_CERT
	string "AWS IoT cert folder"
	default "/mnt/sd0/CERTS"

config EXAMPLES_LTE_AWSIOT_APN_NAME
	string "Access Point Name"
	default ""

config EXAMPLES_LTE_AWSIOT_APN_IPTYPE
	int "IP type"
	default 0
	range 0 2
	---help---
		IP type is selected from IP, IPv6 and IPv4/v6.
		Values are IP=0, IPv6=1 and IPv4/v6=2.

config EXAMPLES_LTE_AWSIOT_APN_AUTHTYPE
	int "Authentication type"
	default 0
	range 0 2
	---help---
		Authentication type is selected from NONE, PAP and CHAP.
		Values are NONE=0, PAP=1, CHAP=2.

config EXAMPLES_LTE_AWSIOT_APN_USERNAME
	string "Username used for authentication"
	default ""

config EXAMPLES_LTE_AWSIOT_APN_PASSWD
	string "Password used for authentication"
	default ""

endif
```

## examples/lte_azureiot/Kconfig
```kconfig
#
# For a description of the syntax of this configuration file,
# see the file kconfig-language.txt in the NuttX tools repository.
#

config EXAMPLES_LTE_AZUREIOT
	tristate "Azure IoT using LTE example"
	default n
	---help---
		Enable the Azure IoT using LTE example

if EXAMPLES_LTE_AZUREIOT

config EXAMPLES_LTE_AZUREIOT_PROGNAME
	string "Program name"
	default "lte_azureiot"

config EXAMPLES_LTE_AZUREIOT_PRIORITY
	int "Task priority"
	default 100

config EXAMPLES_LTE_AZUREIOT_STACKSIZE
	int "Stack size"
	default 8192

config EXAMPLES_LTE_AZUREIOT_APN_NAME
	string "Access Point Name(same as lte_http_get example)"
	default ""

choice
	prompt "IP type Selection"
	default EXAMPLES_LTE_AZUREIOT_APN_IPTYPE_IP

	config EXAMPLES_LTE_AZUREIOT_APN_IPTYPE_IP
		bool "IPv4"

	config EXAMPLES_LTE_AZUREIOT_APN_IPTYPE_IPV6
		bool "IPv6"

	config EXAMPLES_LTE_AZUREIOT_APN_IPTYPE_IPV4V6
		bool "IPv4/v6"
endchoice

choice
	prompt "Authentication type Selection"
	default EXAMPLES_LTE_AZUREIOT_APN_AUTHTYPE_NONE

	config EXAMPLES_LTE_AZUREIOT_APN_AUTHTYPE_NONE
		bool "None"

	config EXAMPLES_LTE_AZUREIOT_APN_AUTHTYPE_PAP
		bool "PAP"

	config EXAMPLES_LTE_AZUREIOT_APN_AUTHTYPE_CHAP
		bool "CHAP"
endchoice

config EXAMPLES_LTE_AZUREIOT_APN_USERNAME
	string "Username used for authentication"
	default ""

config EXAMPLES_LTE_AZUREIOT_APN_PASSWD
	string "Password used for authentication"
	default ""

endif
```

## examples/lte_fwupdate/Kconfig
```kconfig
config EXAMPLES_LTE_FWUPDATE
	tristate "lte_fwupdate app"
	default n
	---help---
		Enable the lte_fwupdate app

if EXAMPLES_LTE_FWUPDATE

config EXAMPLES_LTE_FWUPDATE_PROGNAME
	string "Program name"
	default "lte_fwupdate"
	---help---
		This is the name of the program that will be use when the NSH ELF
		program is installed.

config EXAMPLES_LTE_FWUPDATE_PRIORITY
	int "lte_fwupdate task priority"
	default 100

config EXAMPLES_LTE_FWUPDATE_STACKSIZE
	int "lte_fwupdate stack size"
	default 2048

endif
```

## examples/lte_hibernation/Kconfig
```kconfig
#
# For a description of the syntax of this configuration file,
# see the file kconfig-language.txt in the NuttX tools repository.
#

config EXAMPLES_LTE_HIBERNATION
	tristate "LTE Hibernation sample application"
	default n
	---help---
		Enable the LTE Hibernation sample application

if EXAMPLES_LTE_HIBERNATION

config EXAMPLES_LTE_HIBERNATION_PROGNAME
	string "Program name"
	default "lte_hibernation"
	---help---
		This is the name of the program that will be use when the NSH ELF
		program is installed.

config EXAMPLES_LTE_HIBERNATION_PRIORITY
	int "lte_hibernation task priority"
	default 100

config EXAMPLES_LTE_HIBERNATION_STACKSIZE
	int "lte_hibernation stack size"
	default 2048

config EXAMPLES_LTE_HIBERNATION_APN_NAME
	string "Access Point Name"
	default ""

choice
	prompt "IP type Selection"
	default EXAMPLES_LTE_HIBERNATION_APN_IPTYPE_IP

	config EXAMPLES_LTE_HIBERNATION_APN_IPTYPE_IP
		bool "IPv4"

	config EXAMPLES_LTE_HIBERNATION_APN_IPTYPE_IPV6
		bool "IPv6"

	config EXAMPLES_LTE_HIBERNATION_APN_IPTYPE_IPV4V6
		bool "IPv4/v6"
endchoice

choice
	prompt "Authentication type Selection"
	default EXAMPLES_LTE_HIBERNATION_APN_AUTHTYPE_NONE

	config EXAMPLES_LTE_HIBERNATION_APN_AUTHTYPE_NONE
		bool "None"

	config EXAMPLES_LTE_HIBERNATION_APN_AUTHTYPE_PAP
		bool "PAP"

	config EXAMPLES_LTE_HIBERNATION_APN_AUTHTYPE_CHAP
		bool "CHAP"
endchoice

config EXAMPLES_LTE_HIBERNATION_APN_USERNAME
	string "Username used for authentication"
	default ""

config EXAMPLES_LTE_HIBERNATION_APN_PASSWD
	string "Password used for authentication"
	default ""
endif
```

## examples/lte_hibernation_wake_socket/Kconfig
```kconfig
#
# For a description of the syntax of this configuration file,
# see the file kconfig-language.txt in the NuttX tools repository.
#

config EXAMPLES_LTE_HIBERNATION_WAKE_SOCKET
	tristate "Example of waking up from LTE hibernation by socket"
	default n
	---help---
		Enable the LTE Hibernation sample application

if EXAMPLES_LTE_HIBERNATION_WAKE_SOCKET

config EXAMPLES_LTE_HIBERNATION_WAKE_SOCKET_PROGNAME
	string "Program name"
	default "lte_hibernation_wake_socket"
	---help---
		This is the name of the program that will be use when the NSH ELF
		program is installed.

config EXAMPLES_LTE_HIBERNATION_WAKE_SOCKET_PRIORITY
	int "lte_hibernation_wake_socket task priority"
	default 100

config EXAMPLES_LTE_HIBERNATION_WAKE_SOCKET_STACKSIZE
	int "lte_hibernation_wake_socket stack size"
	default 2048

config EXAMPLES_LTE_HIBERNATION_WAKE_SOCKET_CERTS_PATH
	string "Directory for server certification files"
	default "/mnt/sd0/CERTS"

config EXAMPLES_LTE_HIBERNATION_WAKE_SOCKET_SAVECONTEXT_PATH
	string "Directory for save context files"
	default "/mnt/sd0"

config EXAMPLES_LTE_HIBERNATION_WAKE_SOCKET_APN_NAME
	string "Access Point Name"
	default ""

choice
	prompt "IP type Selection"
	default EXAMPLES_LTE_HIBERNATION_WAKE_SOCKET_APN_IPTYPE_IP

	config EXAMPLES_LTE_HIBERNATION_WAKE_SOCKET_APN_IPTYPE_IP
		bool "IPv4"

	config EXAMPLES_LTE_HIBERNATION_WAKE_SOCKET_APN_IPTYPE_IPV6
		bool "IPv6"

	config EXAMPLES_LTE_HIBERNATION_WAKE_SOCKET_APN_IPTYPE_IPV4V6
		bool "IPv4/v6"
endchoice

choice
	prompt "Authentication type Selection"
	default EXAMPLES_LTE_HIBERNATION_WAKE_SOCKET_APN_AUTHTYPE_NONE

	config EXAMPLES_LTE_HIBERNATION_WAKE_SOCKET_APN_AUTHTYPE_NONE
		bool "None"

	config EXAMPLES_LTE_HIBERNATION_WAKE_SOCKET_APN_AUTHTYPE_PAP
		bool "PAP"

	config EXAMPLES_LTE_HIBERNATION_WAKE_SOCKET_APN_AUTHTYPE_CHAP
		bool "CHAP"
endchoice

config EXAMPLES_LTE_HIBERNATION_WAKE_SOCKET_APN_USERNAME
	string "Username used for authentication"
	default ""

config EXAMPLES_LTE_HIBERNATION_WAKE_SOCKET_APN_PASSWD
	string "Password used for authentication"
	default ""


endif
```
