## examples/eltres_standalone/Kconfig
```kconfig
#
# For a description of the syntax of this configuration file,
# see the file kconfig-language.txt in the NuttX tools repository.
#

config EXAMPLES_ELTRES_STANDALONE
	tristate "ELTRES standalone sample application"
	depends on EXTERNALS_ELTRES
	default n
	---help---
		Enable the ELTRES standalone sample application example

if EXAMPLES_ELTRES_STANDALONE

config EXAMPLES_ELTRES_STANDALONE_PROGNAME
	string "Program name"
	default "eltres_standalone"
	---help---
		This is the name of the program that will be used when the NSH ELF
		program is installed.

config EXAMPLES_ELTRES_STANDALONE_PRIORITY
	int "ELTRES standalone sample application task priority"
	default 100

config EXAMPLES_ELTRES_STANDALONE_STACKSIZE
	int "ELTRES standalone sample application stack size"
	default DEFAULT_TASK_STACKSIZE

endif
```

## examples/fft/Kconfig
```kconfig
#
# For a description of the syntax of this configuration file,
# see the file kconfig-language.txt in the NuttX tools repository.
#

config EXAMPLES_FFT
	tristate "FFT Example"
	default n
	depends on ASMP && EXTERNALS_CMSIS_DSP
	---help---
		Fast Fourier Transform offload to DSP

if EXAMPLES_FFT

config EXAMPLES_FFT_PROGNAME
	string "Program name"
	default "fft"
	---help---
		This is the name of the program that will be use when the NSH ELF
		program is installed.

config EXAMPLES_FFT_PRIORITY
	int "fft task priority"
	default 100

config EXAMPLES_FFT_STACKSIZE
	int "fft stack size"
	default 4096

choice
	prompt "FFT Input Data"
	default EXAMPLES_FFT_REAL_DATA

config EXAMPLES_FFT_REAL_DATA
	bool "Real data"

config EXAMPLES_FFT_COMPLEX_DATA
	bool "Complex data"

endchoice

config EXAMPLES_FFT_DSP_PATH
	string "DSP ELF file path"
	default "/mnt/sd0/BIN/DSPFFT"
	---help---
		Set path to DSPFFT worker program ELF file on the board.

config EXAMPLES_FFT_SAMPLES_WORK_BUFFER_SIZE
	hex "Work buffer size"
	default 0x2000
	---help---
		The work buffer for FFT calculation. The actual memory size
		is CONFIG_EXAMPLES_FFT_SAMPLES_WORK_BUFFER_SIZE x 4 bytes.

config EXAMPLES_FFT_SAMPLES_INPUT_BUFFER_SIZE
	hex "Input buffer size"
	default 0x1000
	---help---
		The input buffer for FFT calculation. The actual memory size
		is CONFIG_EXAMPLES_FFT_SAMPLES_INPUT_BUFFER_SIZE x 4 bytes.

endif # EXAMPLES_FFT
```

## examples/fft_pwbimu/Kconfig
```kconfig
config EXAMPLES_FFT_PWBIMU
	tristate "fft_pwbimu app"
	default n
	---help---
		Enable the fft_pwbimu app

if EXAMPLES_FFT_PWBIMU

config EXAMPLES_FFT_PWBIMU_PROGNAME
	string "Program name"
	default "fft_pwbimu"
	---help---
		This is the name of the program that will be use when the NSH ELF
		program is installed.

config EXAMPLES_FFT_PWBIMU_PRIORITY
	int "fft_pwbimu task priority"
	default 100

config EXAMPLES_FFT_PWBIMU_STACKSIZE
	int "fft_pwbimu stack size"
	default 2048

endif
```

## examples/fir_filter/Kconfig
```kconfig
config EXAMPLES_FIR_FILTER
	tristate "FIR base filters example"
	default n
	---help---
		Enable the "fir" and "decimate" apps.

if EXAMPLES_FIR_FILTER

menu "FIR filter example app"

config EXAMPLES_FIR_FIR_PROGNAME
	string "Program name"
	default "fir"
	---help---
		This is the name of the program that will be use when the NSH ELF
		program is installed. This "fir" creates a wav file filtered from input wav file.

config EXAMPLES_FIR_FIR_PRIORITY
	int "fir task priority"
	default 100

config EXAMPLES_FIR_FIR_STACKSIZE
	int "fir stack size"
	default 2048

endmenu # "FIR filter example app"

menu "Decimation filter example app"

config EXAMPLES_FIR_DECIMATOR_PROGNAME
	string "Program name"
	default "decimate"
	---help---
		This is the name of the program that will be use when the NSH ELF
		program is installed. This "decimate" creates a wav file decimated from input wav file.

config EXAMPLES_FIR_DECIMATOR_PRIORITY
	int "decimate task priority"
	default 100

config EXAMPLES_FIR_DECIMATOR_STACKSIZE
	int "decimate stack size"
	default 2048

endmenu # "Decimation filter example app"

menu "Envelope example app"

config EXAMPLES_ENVELOPE_PROGNAME
	string "Program name"
	default "envelope"
	---help---
		This is the name of the program that will be use when the NSH ELF
		program is installed.

config EXAMPLES_ENVELOPE_PRIORITY
	int "envelope task priority"
	default 100

config EXAMPLES_ENVELOPE_STACKSIZE
	int "envelope stack size"
	default 2048

endmenu # "Decimation filter example app"

endif
```

## examples/fsperf/Kconfig
```kconfig
#
# For a description of the syntax of this configuration file,
# see the file kconfig-language.txt in the NuttX tools repository.
#

config EXAMPLES_FSPERF
	tristate "File system performance measurement example"
	default n
	---help---
		Enable the file system performance measurement application

if EXAMPLES_FSPERF

config EXAMPLES_FSPERF_PROGNAME
	string "Program name"
	default "fsperf"
	---help---
		This is the name of the program that will be use when the NSH ELF
		program is installed.

config EXAMPLES_FSPERF_PRIORITY
	int "fsperf task priority"
	default 100

config EXAMPLES_FSPERF_STACKSIZE
	int "fsperf stack size"
	default DEFAULT_TASK_STACKSIZE

config EXAMPLES_FSPERF_FWRITEREAD
	bool "fwrite/fread performance"
	default y

config EXAMPLES_FSPERF_WRITEREAD
	bool "write/read performance"
	default n

config EXAMPLES_FSPERF_REPEAT_COUNT
	int "repeat count"
	default 10

endif
```

## examples/fwupdate/Kconfig
```kconfig
#
# For a description of the syntax of this configuration file,
# see the file kconfig-language.txt in the NuttX tools repository.
#

config EXAMPLES_FWUPDATE
	tristate "FW Update example"
	default n
	depends on FWUPUTILS_CLIENTS
	---help---
		Enable the FW Update example

if EXAMPLES_FWUPDATE

config EXAMPLES_FWUPDATE_PROGNAME
	string "Program name"
	default "fwupdate"
	---help---
		This is the name of the program that will be use when the NSH ELF
		program is installed.

config EXAMPLES_FWUPDATE_PRIORITY
	int "fwupdate task priority"
	default 100

config EXAMPLES_FWUPDATE_STACKSIZE
	int "fwupdate stack size"
	default 2048

config EXAMPLES_FWUPDATE_DOWNLOAD_WORK_SIZE
	hex "FW download work memory size"
	default 0x10000
	---help---
		This is the size of continuous work memory to support for
		partial download which is allocated from heap memory.
		Adjust according to the free memory capacity.

config EXAMPLES_FWUPDATE_USBCDC_ZMODEM
	bool "FW update via USB CDC/ACM Zmodem"
	default y
	depends on SYSTEM_ZMODEM

if EXAMPLES_FWUPDATE_USBCDC_ZMODEM

config EXAMPLES_FWUPDATE_DOWNLOAD_DIR
	string "FW update work download directory"
	default "/mnt/spif"
	---help---
		This is the temporal download directory. If zmodem is enabled,
		zmodem mount point is used. Set the storage mounted directory
		name such as "/mnt/spif".

config EXAMPLES_FWUPDATE_USBCDC_DEVNAME
	string "FW update USB CDC/ACM device"
	default "/dev/ttyACM0"

config EXAMPLES_FWUPDATE_USBCDC_DEVMINOR
	int "FW update USB CDC/ACM Minor Device Number"
	default 0

endif

endif
```

## examples/geofence/Kconfig
```kconfig
#
# For a description of the syntax of this configuration file,
# see the file kconfig-language.txt in the NuttX tools repository.
#

config EXAMPLES_GEOFENCE
	tristate "Geofence transitions example"
	default n
	---help---
		Enable the Geofence transitions example

if EXAMPLES_GEOFENCE

config EXAMPLES_GEOFENCE_PROGNAME
	string "Program name"
	default "geofence"
	---help---
		This is the name of the program that will be use when the NSH ELF
		program is installed.

config EXAMPLES_GEOFENCE_PRIORITY
	int "GEOFENCE task priority"
	default 100

config EXAMPLES_GEOFENCE_STACKSIZE
	int "GEOFENCE stack size"
	default 2048

endif
```

## examples/gnss/Kconfig
```kconfig
#
# For a description of the syntax of this configuration file,
# see the file kconfig-language.txt in the NuttX tools repository.
#

config EXAMPLES_GNSS
	tristate "GNSS positioning example"
	default n
	depends on CXD56_GNSS
	---help---
		Enable the Simple GNSS positioning example

if EXAMPLES_GNSS

config EXAMPLES_GNSS_PROGNAME
	string "Program name"
	default "gnss"
	---help---
		This is the name of the program that will be use when the NSH ELF
		program is installed.

config EXAMPLES_GNSS_PRIORITY
	int "GNSS task priority"
	default 100

config EXAMPLES_GNSS_STACKSIZE
	int "GNSS stack size"
	default 2048

choice
	prompt "Event notification"
	default EXAMPLES_GNSS_USE_POLL

config EXAMPLES_GNSS_USE_POLL
	bool "Polling notification"

config EXAMPLES_GNSS_USE_SIGNAL
	bool "Signal notification"

endchoice # Event notification

endif
```

## examples/gnss_addon/Kconfig
```kconfig
#
# For a description of the syntax of this configuration file,
# see the file kconfig-language.txt in the NuttX tools repository.
#

config EXAMPLES_GNSS_ADDON
	tristate "GNSS Add-on example"
	default n
	depends on CXD56_GNSS_ADDON
	---help---
		Enable the GNSS Add-on application

if EXAMPLES_GNSS_ADDON

config EXAMPLES_GNSS_ADDON_PROGNAME
	string "Program name"
	default "gnss_addon"
	---help---
		This is the name of the program that will be use when the NSH ELF
		program is installed.

config EXAMPLES_GNSS_ADDON_PRIORITY
	int "GNSS Add-on task priority"
	default 100

config EXAMPLES_GNSS_ADDON_STACKSIZE
	int "GNSS Add-on stack size"
	default DEFAULT_TASK_STACKSIZE

config EXAMPLES_GNSS_ADDON_FSYNC_LOGGING
	bool "GNSS Add-on fsync logging"
	default n
	---help---
		Enable fsync after writing the logging data to a file each time.

endif
```

## examples/gnss_atcmd/Kconfig
```kconfig
#
# For a description of the syntax of this configuration file,
# see the file kconfig-language.txt in the NuttX tools repository.
#

config EXAMPLES_GNSS_ATCMD
	tristate "GNSS CXD5603 @command emulator example"
	default n
	select LIBC_FLOATINGPOINT
	depends on CXD56_GNSS
	---help---
		Enable GNSS CXD5603 @command emulator example

if EXAMPLES_GNSS_ATCMD

config EXAMPLES_GNSS_ATCMD_PROGNAME
	string "Program name"
	default "gnss_atcmd"
	---help---
		This is the name of the program that will be use when the NSH ELF
		program is installed.

choice
	prompt "GNSS Command IO"
	default EXAMPLES_GNSS_ATCMD_USB

config EXAMPLES_GNSS_ATCMD_USB
	bool "Example uses USB CDC tty"

config EXAMPLES_GNSS_ATCMD_STDINOUT
	bool "Example uses STDINOUT for nsh debug UART"

config EXAMPLES_GNSS_ATCMD_TTYS0
	bool "Example uses UART ttyS0"

config EXAMPLES_GNSS_ATCMD_TTYS1
	bool "Example uses UART ttyS1"

config EXAMPLES_GNSS_ATCMD_TTYS2
	bool "Example uses UART ttyS2"

endchoice

config EXAMPLES_GNSS_ATCMD_SUPPORT_DCREPORT
	bool "Example supports QZ DC report output"
	default y

config EXAMPLES_GNSS_ATCMD_SUPPORT_SARRLM
	bool "Example supports GAL SAR/RLM output"
	default y

config EXAMPLES_GNSS_ATCMD_SUPPORT_SPECRUM
	bool "Example supports spectrum output"
	default y

config EXAMPLES_GNSS_ATCMD_PRIORITY
	int "GNSS task priority"
	default 100

config EXAMPLES_GNSS_ATCMD_STACKSIZE
	int "GNSS stack size"
	default 2048

endif
```

## examples/gnss_factory/Kconfig
```kconfig
#
# For a description of the syntax of this configuration file,
# see the file kconfig-language.txt in the NuttX tools repository.
#

config EXAMPLES_GNSS_FACTORY
	tristate "GNSS FACTORY test"
	default n
	depends on CXD56_GNSS

if EXAMPLES_GNSS_FACTORY

config EXAMPLES_GNSS_FACTORY_PROGNAME
	string "Program name"
	default "gnss_factory"
	---help---
		This is the name of the program that will be use when the NSH ELF
		program is installed.

config EXAMPLES_GNSS_FACTORY_PRIORITY
	int "FACTORY TEST priority"
	default 100

config EXAMPLES_GNSS_FACTORY_STACKSIZE
	int "FACTORY TEST stack size"
	default 2048

config EXAMPLES_GNSS_FACTORY_SVID
	int "FACTORY TEST svid"
	default 1

endif
```

## examples/gnss_pvtlog/Kconfig
```kconfig
#
# For a description of the syntax of this configuration file,
# see the file kconfig-language.txt in the NuttX tools repository.
#

config EXAMPLES_GNSS_PVTLOG
	tristate "GNSS PVTLOG example"
	default n
	depends on CXD56_GNSS

if EXAMPLES_GNSS_PVTLOG

config EXAMPLES_GNSS_PVTLOG_PROGNAME
	string "Program name"
	default "gnss_pvtlog"
	---help---
		This is the name of the program that will be use when the NSH ELF
		program is installed.

config EXAMPLES_GNSS_PVTLOG_PRIORITY
	int "PVTLOG task priority"
	default 100

config EXAMPLES_GNSS_PVTLOG_STACKSIZE
	int "PVTLOG stack size"
	default 2048

config EXAMPLES_GNSS_PVTLOG_FILEPATH
	string "path to save the log file"
	default "/mnt/spif/PVTLOG"
	---help---
		Specify the path to save the log file.
endif
```

## examples/gyro/Kconfig
```kconfig
#
# For a description of the syntax of this configuration file,
# see the file kconfig-language.txt in the NuttX tools repository.
#

config EXAMPLES_GYRO
	tristate "Gyroscope sensor example"
	default n
	---help---
		Enable the sensor via SCU example

if EXAMPLES_GYRO

config EXAMPLES_GYRO_PROGNAME
	string "Program name"
	default "gyro"
	---help---
		This is the name of the program that will be use when the NSH ELF
		program is installed.

config EXAMPLES_GYRO_PRIORITY
	int "Sensor task priority"
	default 100

config EXAMPLES_GYRO_STACKSIZE
	int "Sensor stack size"
	default 2048

config EXAMPLES_GYRO_DEVNAME
	string "Gyroscope sensor device name"
	default "/dev/gyro0"

config EXAMPLES_GYRO_SIGNO
	int "Gyroscope sensor signal"
	default 13

endif
```

## examples/gyrocompass_pwbimu/Kconfig
```kconfig
config EXAMPLES_GYROCOMPASS_PWBIMU
	tristate "Gyrocompass example with high precision IMU(CXD5602PWBIMU)"
	default n
	---help---
		Enable the gyrocompass app

if EXAMPLES_GYROCOMPASS_PWBIMU

config EXAMPLES_GYROCOMPASS_PWBIMU_PROGNAME
	string "Program name"
	default "gyrocompass"
	---help---
		This is the name of the program that will be use when the NSH ELF
		program is installed.

config EXAMPLES_GYROCOMPASS_PWBIMU_PRIORITY
	int "gyrocompass task priority"
	default 100

config EXAMPLES_GYROCOMPASS_PWBIMU_STACKSIZE
	int "gyrocompass stack size"
	default 2048

config EXAMPLES_GYROCOMPASS_COLLECTTIME
	int "Data collecting time for each posture (in sec)"
	default 10

config EXAMPLES_GYROCOMPASS_TEST
	bool "Enable test mode calculate azimuth from logged files"
	default n
	---help---
		Enabling this will cause it to perform a function similar to gyrocompass.py.
		It will calcurate azimuth from logged files.

endif
```
