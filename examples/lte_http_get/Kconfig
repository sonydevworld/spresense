## examples/press/Kconfig
```kconfig
#
# For a description of the syntax of this configuration file,
# see the file kconfig-language.txt in the NuttX tools repository.
#

config EXAMPLES_PRESS
	tristate "Pressure sensor example"
	default n
	depends on SENSORS_BMP280 || SENSORS_BMP280_SCU || SENSORS_BM1383GLV_SCU
	---help---
		Enable the sensor via SCU example

if EXAMPLES_PRESS

config EXAMPLES_PRESS_PROGNAME
	string "Program name"
	default "press"
	---help---
		This is the name of the program that will be use when the NSH ELF
		program is installed.

config EXAMPLES_PRESS_PRIORITY
	int "Sensor task priority"
	default 100

config EXAMPLES_PRESS_STACKSIZE
	int "Sensor stack size"
	default 2048

config EXAMPLES_PRESS_DEVNAME
	string "Pressure sensor device name"
	default "/dev/press0"

config EXAMPLES_PRESS_SIGNO
	int "Pressure sensor signal"
	default 14

config EXAMPLES_TEMP_DEVNAME
	string "Temperature sensor device name"
	default "/dev/temp0"
	depends on BMP280

config EXAMPLES_TEMP_SIGNO
	int "Temperature sensor signal"
	default 15
	depends on BMP280

config EXAMPLES_PRESS_NTIMES
	int "Number of sensing times"
	default 10
	depends on BMP280

config EXAMPLES_PRESS_INTERVAL
	int "Period of time to each sensing (ms)"
	default 100
	depends on BMP280

endif
```

## examples/prime/Kconfig
```kconfig
#
# For a description of the syntax of this configuration file,
# see the file kconfig-language.txt in the NuttX tools repository.
#

config EXAMPLES_PRIME
	tristate "Multicore prime number calculator"
	depends on ASMP
	default n
	---help---
		Enable the ELF loader example

if EXAMPLES_PRIME

config EXAMPLES_PRIME_WORKER_STACKSIZE
	int "Example worker stack size"
	default 1024

endif
```

## examples/proximity/Kconfig
```kconfig
#
# For a description of the syntax of this configuration file,
# see the file kconfig-language.txt in the NuttX tools repository.
#

config EXAMPLES_PROXIMITY
	bool "Proximity sensor example"
	default n
    depends on APDS9930 || LT1PA01 || RPR0521RS
	---help---
		Enable the sensor via SCU example

if EXAMPLES_PROXIMITY

config EXAMPLES_PROXIMITY_PROGNAME
	string "Program name"
	default "proximity"
	---help---
		This is the name of the program that will be use when the NSH ELF
		program is installed.

config EXAMPLES_PROXIMITY_PRIORITY
	int "Sensor task priority"
	default 100

config EXAMPLES_PROXIMITY_STACKSIZE
	int "Sensor stack size"
	default 2048

config EXAMPLES_PROXIMITY_DEVNAME
    string "Proximity sensor device name"
    default "/dev/proximity0"

config EXAMPLES_PROXIMITY_SIGNO
    int "Proximity sensor signal"
    default 14

endif
```

## examples/recording_player/Kconfig
```kconfig
#
# For a description of the syntax of this configuration file,
# see the file kconfig-language.txt in the NuttX tools repository.
#

config EXAMPLES_RECORDING_PLAYER
	bool "Recording player (Record audio and play immediately)"
	default n
	depends on CXD56_AUDIO
	---help---
		Enable the audio player example

if EXAMPLES_RECORDING_PLAYER

config EXAMPLES_RECORDING_PLAYER_PROGNAME
	string "Program name"
	default "recording_player"

config EXAMPLES_RECORDING_PLAYER_PRIORITY
	int "Recording player task priority"
	default 150

config EXAMPLES_RECORDING_PLAYER_STACKSIZE
	int "Recording player stack size"
	default 2048
endif
```

## examples/rs422/Kconfig
```kconfig
#
# For a description of the syntax of this configuration file,
# see the file kconfig-language.txt in the NuttX tools repository.
#

config EXAMPLES_RS422
	tristate "RS422 master/slave example"
	default n
	---help---
		Enable the RS422 master/slave communication sample

if EXAMPLES_RS422

choice
	prompt "Read Enable Pin Assign"
	default EXAMPLES_RS422_RE_PIN_I2S_DIN

	config EXAMPLES_RS422_RE_PIN_EMMC_DATA3
		bool "EMMC_DATA3"

	config EXAMPLES_RS422_RE_PIN_I2S_DIN
		bool "I2S_DIN"
endchoice

choice
	prompt "Data Enable Pin Assign"
	default EXAMPLES_RS422_DE_PIN_I2S_DOUT

	config EXAMPLES_RS422_DE_PIN_EMMC_DATA2
		bool "EMMC_DATA3"

	config EXAMPLES_RS422_DE_PIN_I2S_DOUT
		bool "I2S_DOUT"
endchoice

config EXAMPLES_RS422_PROGNAME
	string "Program name"
	default "rs422"
	---help---
		This is the name of the program that will be use when the NSH ELF
		program is installed.

config EXAMPLES_RS422_PRIORITY
	int "rs422 task priority"
	default 100

config EXAMPLES_RS422_STACKSIZE
	int "rs422 stack size"
	default 2048

endif
```

## examples/setjmp/Kconfig
```kconfig
config EXAMPLES_SETJMP
	tristate "Example to use setjmp/longjmp"
	default n
	---help---
		Enable the setjmp app

if EXAMPLES_SETJMP

config EXAMPLES_SETJMP_PROGNAME
	string "Program name"
	default "setjmp"
	---help---
		This is the name of the program that will be use when the NSH ELF
		program is installed.

config EXAMPLES_SETJMP_PRIORITY
	int "setjmp task priority"
	default 100

config EXAMPLES_SETJMP_STACKSIZE
	int "setjmp stack size"
	default 2048

endif
```

## examples/sms_recv/Kconfig
```kconfig
#
# For a description of the syntax of this configuration file,
# see the file kconfig-language.txt in the NuttX tools repository.
#

config EXAMPLES_SMS_RECV
	tristate "Receive Short Message Service example"
	default n
	select UTILS_UCONV
	---help---
		Enable the Receive Short Message Service example.
		This application requires an SMS capable SIM to work properly.

if EXAMPLES_SMS_RECV

config EXAMPLES_SMS_RECV_PROGNAME
	string "Program name"
	default "sms_recv"
	---help---
		This is the name of the program that will be use when the NSH ELF
		program is installed.

config EXAMPLES_SMS_RECV_PRIORITY
	int "sms_recv task priority"
	default 100

config EXAMPLES_SMS_RECV_STACKSIZE
	int "sms_recv stack size"
	default 2048

endif
```

## examples/sms_send/Kconfig
```kconfig
#
# For a description of the syntax of this configuration file,
# see the file kconfig-language.txt in the NuttX tools repository.
#

config EXAMPLES_SMS_SEND
	tristate "Send Short Message Service example"
	default n
	select UTILS_UCONV
	---help---
		Enable the Send Short Message Service example.
		This application requires an SMS capable SIM to work properly.

if EXAMPLES_SMS_SEND

config EXAMPLES_SMS_SEND_PROGNAME
	string "Program name"
	default "sms_send"
	---help---
		This is the name of the program that will be use when the NSH ELF
		program is installed.

config EXAMPLES_SMS_SEND_PRIORITY
	int "sms_send task priority"
	default 100

config EXAMPLES_SMS_SEND_STACKSIZE
	int "sms_send stack size"
	default 2048

endif
```

## examples/step_counter/Kconfig
```kconfig
#
# For a description of the syntax of this configuration file,
# see the file kconfig-language.txt in the NuttX tools repository.
#

config EXAMPLES_SENSOR_STEP_COUNTER
	tristate "Step counter sensor example"
	default n
	---help---
		Enable the step_counter sensor example

if EXAMPLES_SENSOR_STEP_COUNTER

config EXAMPLES_STEP_COUNTER_PROGNAME
	string "Program name"
	default "step_counter"
	---help---
		This is the name of the program that will be use when the NSH ELF
		program is installed.

config EXAMPLES_STEP_COUNTER_PRIORITY
	int "Sensor task priority"
	default 100

config EXAMPLES_STEP_COUNTER_STACKSIZE
	int "Sensor stack size"
	default 2048

config EXAMPLES_SENSOR_STEP_COUNTER_ACCEL_WM_SIGNO
    int "Accelerator sensor watermark signal"
    default 14

config EXAMPLES_STEP_COUNTER_WALKING_STRIDE
	int "Stride length of walking state"
	default 60

config EXAMPLES_STEP_COUNTER_RUNNING_STRIDE
	int "Stride length of running state"
	default 80
endif
```

## examples/tf_example/Kconfig
```kconfig
config EXAMPLES_TF_EXAMPLE
	tristate "Tensorflow Example app"
	default n
	---help---
		Enable the NuttX command line application for executing example of
		Tensorflow lite micro.

if EXAMPLES_TF_EXAMPLE

config EXAMPLES_TF_EXAMPLE_PROGNAME
	string "Program name"
	default "tf_example"
	---help---
		This is the name of the program that will be use when the NSH ELF
		program is installed.

config EXAMPLES_TF_EXAMPLE_PRIORITY
	int "tf_example task priority"
	default 100

config EXAMPLES_TF_EXAMPLE_STACKSIZE
	int "tf_example stack size"
	default 32768

endif
```

## examples/tflmrt_lenet/Kconfig
```kconfig
#
# For a description of the syntax of this configuration file,
# see the file kconfig-language.txt in the NuttX tools repository.
#

config EXAMPLES_TFLMRT_LENET
	tristate "tflmrt example of LeNet-5"
	depends on TFLM_RT
	default n
	---help---
		classify MNIST digits by LeNet-5

if EXAMPLES_TFLMRT_LENET

config EXAMPLES_TFLMRT_LENET_PROGNAME
	string "Program name"
	default "tflmrt_lenet"
	---help---
		This is the name of the program that will be use when the NSH ELF
		program is installed.

config EXAMPLES_TFLMRT_LENET_PRIORITY
	int "tflmrt_lenet task priority"
	default 100

config EXAMPLES_TFLMRT_LENET_STACKSIZE
	int "tflmrt_lenet stack size"
	default 8192

endif
```

## examples/tilt/Kconfig
```kconfig
#
# For a description of the syntax of this configuration file,
# see the file kconfig-language.txt in the NuttX tools repository.
#

config EXAMPLES_TILT
	tristate "Tilt detection example"
	default n
	---help---
		Enable the sensor via SCU Mathfunc example

if EXAMPLES_TILT

config EXAMPLES_TILT_PROGNAME
	string "Program name"
	default "tilt"
	---help---
		This is the name of the program that will be use when the NSH ELF
		program is installed.

config EXAMPLES_TILT_PRIORITY
	int "Sensor task priority"
	default 100

config EXAMPLES_TILT_STACKSIZE
	int "Sensor stack size"
	default 2048

endif
```
