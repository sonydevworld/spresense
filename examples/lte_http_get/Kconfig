## examples/lte_http_get/Kconfig
```kconfig
#
# For a description of the syntax of this configuration file,
# see the file kconfig-language.txt in the NuttX tools repository.
#

config EXAMPLES_LTE_HTTP_GET
	tristate "HTTP GET method using LTE example"
	default n
	---help---
		Enable the HTTP GET method using LTE example

if EXAMPLES_LTE_HTTP_GET

config EXAMPLES_LTE_HTTP_GET_PROGNAME
	string "Program name"
	default "lte_http_get"
	---help---
		This is the name of the program that will be use when the NSH ELF
		program is installed.

choice
	prompt "API call type Selection"
	default EXAMPLES_LTE_HTTP_GET_USE_SYNC_API

	config EXAMPLES_LTE_HTTP_GET_USE_SYNC_API
		bool "Use Synchronous API"

	config EXAMPLES_LTE_HTTP_GET_USE_ASYNC_API
		bool "Use Asynchronous API"
endchoice

config EXAMPLES_LTE_HTTP_GET_PRIORITY
	int "lte_http_get task priority"
	default 100

config EXAMPLES_LTE_HTTP_GET_STACKSIZE
	int "lte_http_get stack size"
	default 4096

config EXAMPLES_LTE_HTTP_GET_STACKSIZE_IN_USING_MBEDTLS
	int "lte_http_get stack size in using mbedTLS"
	default 7168

config EXAMPLES_LTE_HTTP_GET_APN_NAME
	string "Access Point Name"
	default ""

choice
	prompt "IP type Selection"
	default EXAMPLES_LTE_HTTP_GET_APN_IPTYPE_IP

	config EXAMPLES_LTE_HTTP_GET_APN_IPTYPE_IP
		bool "IPv4"

	config EXAMPLES_LTE_HTTP_GET_APN_IPTYPE_IPV6
		bool "IPv6"

	config EXAMPLES_LTE_HTTP_GET_APN_IPTYPE_IPV4V6
		bool "IPv4/v6"
endchoice

choice
	prompt "Authentication type Selection"
	default EXAMPLES_LTE_HTTP_GET_APN_AUTHTYPE_NONE

	config EXAMPLES_LTE_HTTP_GET_APN_AUTHTYPE_NONE
		bool "None"

	config EXAMPLES_LTE_HTTP_GET_APN_AUTHTYPE_PAP
		bool "PAP"

	config EXAMPLES_LTE_HTTP_GET_APN_AUTHTYPE_CHAP
		bool "CHAP"
endchoice

config EXAMPLES_LTE_HTTP_GET_APN_USERNAME
	string "Username used for authentication"
	default ""

config EXAMPLES_LTE_HTTP_GET_APN_PASSWD
	string "Password used for authentication"
	default ""

endif
```

## examples/lte_http_post/Kconfig
```kconfig
#
# For a description of the syntax of this configuration file,
# see the file kconfig-language.txt in the NuttX tools repository.
#

config EXAMPLES_LTE_HTTP_POST
	tristate "HTTP POST method using LTE example"
	default n
	---help---
		Enable the HTTP POST method using LTE example

if EXAMPLES_LTE_HTTP_POST

config EXAMPLES_LTE_HTTP_POST_PROGNAME
	string "Program name"
	default "lte_http_post"
	---help---
		This is the name of the program that will be use when the NSH ELF
		program is installed.

choice
	prompt "API call type Selection"
	default EXAMPLES_LTE_HTTP_POST_USE_SYNC_API

	config EXAMPLES_LTE_HTTP_POST_USE_SYNC_API
		bool "Use Synchronous API"

	config EXAMPLES_LTE_HTTP_POST_USE_ASYNC_API
		bool "Use Asynchronous API"
endchoice

config EXAMPLES_LTE_HTTP_POST_PRIORITY
	int "lte_http_post task priority"
	default 100

config EXAMPLES_LTE_HTTP_POST_STACKSIZE
	int "lte_http_post stack size"
	default 4096

config EXAMPLES_LTE_HTTP_POST_STACKSIZE_IN_USING_MBEDTLS
	int "lte_http_post stack size in using mbedTLS"
	default 7168

config EXAMPLES_LTE_HTTP_POST_APN_NAME
	string "Access Point Name"
	default ""

choice
	prompt "IP type Selection"
	default EXAMPLES_LTE_HTTP_POST_APN_IPTYPE_IP

	config EXAMPLES_LTE_HTTP_POST_APN_IPTYPE_IP
		bool "IPv4"

	config EXAMPLES_LTE_HTTP_POST_APN_IPTYPE_IPV6
		bool "IPv6"

	config EXAMPLES_LTE_HTTP_POST_APN_IPTYPE_IPV4V6
		bool "IPv4/v6"
endchoice

choice
	prompt "Authentication type Selection"
	default EXAMPLES_LTE_HTTP_POST_APN_AUTHTYPE_NONE

	config EXAMPLES_LTE_HTTP_POST_APN_AUTHTYPE_NONE
		bool "None"

	config EXAMPLES_LTE_HTTP_POST_APN_AUTHTYPE_PAP
		bool "PAP"

	config EXAMPLES_LTE_HTTP_POST_APN_AUTHTYPE_CHAP
		bool "CHAP"
endchoice

config EXAMPLES_LTE_HTTP_POST_APN_USERNAME
	string "Username used for authentication"
	default ""

config EXAMPLES_LTE_HTTP_POST_APN_PASSWD
	string "Password used for authentication"
	default ""

endif
```

## examples/lte_lwm2m/Kconfig
```kconfig
#
# For a description of the syntax of this configuration file,
# see the file kconfig-language.txt in the NuttX tools repository.
#

config EXAMPLES_LTE_LWM2M
	tristate "LwM2M using LTE example"
	default n
	---help---
		Enable the LwM2M using LTE example

if EXAMPLES_LTE_LWM2M

config EXAMPLES_LTE_LWM2M_PROGNAME
	string "Program name"
	default "lte_lwm2m"
	---help---
		This is the name of the program that will be use when the NSH ELF
		program is installed.

config EXAMPLES_LTE_LWM2M_PRIORITY
	int "lte_lwm2m task priority"
	default 100

config EXAMPLES_LTE_LWM2M_STACKSIZE
	int "lte_lwm2m stack size"
	default 8192

config EXAMPLES_LTE_LWM2M_APN_NAME
	string "Access Point Name"
	default ""

config EXAMPLES_LTE_LWM2M_APN_IPTYPE
	int "IP type"
	default 0
	range 0 2
	---help---
		IP type is selected from IP, IPv6 and IPv4/v6.
		Values are IP=0, IPv6=1 and IPv4/v6=2.

config EXAMPLES_LTE_LWM2M_APN_AUTHTYPE
	int "Authentication type"
	default 0
	range 0 2
	---help---
		Authentication type is selected from NONE, PAP and CHAP.
		Values are NONE=0, PAP=1, CHAP=2.

config EXAMPLES_LTE_LWM2M_APN_USERNAME
	string "Username used for authentication"
	default ""

config EXAMPLES_LTE_LWM2M_APN_PASSWD
	string "Password used for authentication"
	default ""

endif
```

## examples/lte_lwm2mstub/Kconfig
```kconfig
config EXAMPLES_LTE_LWM2MSTUB
	tristate "LwM2M stub API example"
	default n
	---help---
		Enable the lte_lwm2mstub app. This example shows how to use LwM2M stub APIs.
		Those APIs uses LwM2M functionality on Alt1250 modem.

if EXAMPLES_LTE_LWM2MSTUB

config EXAMPLES_LTE_LWM2MSTUB_SUPPORT_RATCHANGE
	bool "Support RAT change to use lte_set_rat_sync()"
	default n
	---help---
		Support RAT change by using lte_set_rat_sync() in this sample.

config EXAMPLES_LTE_LWM2MSTUB_PROGNAME
	string "Program name"
	default "lte_lwm2mstub"
	---help---
		This is the name of the program that will be use when the NSH ELF
		program is installed.

config EXAMPLES_LTE_LWM2MSTUB_PRIORITY
	int "lte_lwm2mstub task priority"
	default 100

config EXAMPLES_LTE_LWM2MSTUB_STACKSIZE
	int "lte_lwm2mstub stack size"
	default 2048

endif
```

## examples/lte_modem_log_save/Kconfig
```kconfig
#
# For a description of the syntax of this configuration file,
# see the file kconfig-language.txt in the NuttX tools repository.
#

config EXAMPLES_LTE_MODEM_LOG_SAVE
	tristate "Save modem FW logs example"
	default n
	---help---
		Enable the Save Modem FW logs example

if EXAMPLES_LTE_MODEM_LOG_SAVE

config EXAMPLES_LTE_MODEM_LOG_SAVE_PROGNAME
	string "Program name"
	default "lte_modem_log_save"
	---help---
		This is the name of the program that will be use when the NSH ELF
		program is installed.

config EXAMPLES_LTE_MODEM_LOG_SAVE_PRIORITY
	int "LTE modem log save task priority"
	default 100

config EXAMPLES_LTE_MODEM_LOG_SAVE_STACKSIZE
	int "LTE modem log save stack size"
	default DEFAULT_TASK_STACKSIZE

endif
```

## examples/lte_mqtt/Kconfig
```kconfig
#
# For a description of the syntax of this configuration file,
# see the file kconfig-language.txt in the NuttX tools repository.
#

config EXAMPLES_LTE_MQTT
	tristate "MQTT using LTE example"
	default n
	---help---
		Enable the MQTT using LTE example

if EXAMPLES_LTE_MQTT

config EXAMPLES_LTE_MQTT_PROGNAME
	string "Program name"
	default "lte_mqtt"
	---help---
		This is the name of the program that will be use when the NSH ELF
		program is installed.

config EXAMPLES_LTE_MQTT_PRIORITY
	int "lte_mqtt task priority"
	default 100

config EXAMPLES_LTE_MQTT_STACKSIZE
	int "lte_mqtt stack size"
	default 2048

config EXAMPLES_LTE_MQTT_STACKSIZE_IN_USING_MBEDTLS
	int "lte_mqtt stack size in using mbedTLS"
	default 5120

config EXAMPLES_LTE_MQTT_APN_NAME
	string "Access Point Name"
	default ""

config EXAMPLES_LTE_MQTT_APN_IPTYPE
	int "IP type"
	default 0
	range 0 2
	---help---
		IP type is selected from IP, IPv6 and IPv4/v6.
		Values are IP=0, IPv6=1 and IPv4/v6=2.

config EXAMPLES_LTE_MQTT_APN_AUTHTYPE
	int "Authentication type"
	default 0
	range 0 2
	---help---
		Authentication type is selected from NONE, PAP and CHAP.
		Values are NONE=0, PAP=1, CHAP=2.

config EXAMPLES_LTE_MQTT_APN_USERNAME
	string "Username used for authentication"
	default ""

config EXAMPLES_LTE_MQTT_APN_PASSWD
	string "Password used for authentication"
	default ""

endif
```

## examples/lte_rat/Kconfig
```kconfig
#
# For a description of the syntax of this configuration file,
# see the file kconfig-language.txt in the NuttX tools repository.
#

config EXAMPLES_LTE_RAT
	tristate "RAT sets/checks example"
	default n
	---help---
		Enable the RAT sets/checks example

if EXAMPLES_LTE_RAT

config EXAMPLES_LTE_RAT_PROGNAME
	string "Program name"
	default "lte_rat"
	---help---
		This is the name of the program that will be use when the NSH ELF
		program is installed.

config EXAMPLES_LTE_RAT_PRIORITY
	int "lte_rat task priority"
	default 100

config EXAMPLES_LTE_RAT_STACKSIZE
	int "lte_rat stack size"
	default 2048

endif
```

## examples/lte_tls/Kconfig
```kconfig
#
# For a description of the syntax of this configuration file,
# see the file kconfig-language.txt in the NuttX tools repository.
#

config EXAMPLES_LTE_TLS
	tristate "TLS data communication over LTE network example"
	default n
	---help---
		Enable the tls data communication over LTE network example.
		This example needs config "EXTERNALS_MBEDTLS" or "LTE_NET_MBEDTLS".

if EXAMPLES_LTE_TLS

config EXAMPLES_LTE_TLS_PROGNAME
	string "Program name"
	default "lte_tls"
	---help---
		This is the name of the program that will be use when the NSH ELF
		program is installed.

config EXAMPLES_LTE_TLS_PRIORITY
	int "lte_tls task priority"
	default 100

config EXAMPLES_LTE_TLS_STACKSIZE
	int "lte_tls stack size"
	default 5120

config EXAMPLES_LTE_TLS_CERTS_PATH
	string "Directory for server certification files"
	default "/mnt/sd0/CERTS"

config EXAMPLES_LTE_TLS_APN_NAME
	string "Access Point Name(same as lte_http_get example)"
	default ""

choice
	prompt "IP type Selection"
	default EXAMPLES_LTE_TLS_APN_IPTYPE_IP

	config EXAMPLES_LTE_TLS_APN_IPTYPE_IP
		bool "IPv4"

	config EXAMPLES_LTE_TLS_APN_IPTYPE_IPV6
		bool "IPv6"

	config EXAMPLES_LTE_TLS_APN_IPTYPE_IPV4V6
		bool "IPv4/v6"
endchoice

choice
	prompt "Authentication type Selection"
	default EXAMPLES_LTE_TLS_APN_AUTHTYPE_NONE

	config EXAMPLES_LTE_TLS_APN_AUTHTYPE_NONE
		bool "None"

	config EXAMPLES_LTE_TLS_APN_AUTHTYPE_PAP
		bool "PAP"

	config EXAMPLES_LTE_TLS_APN_AUTHTYPE_CHAP
		bool "CHAP"
endchoice

config EXAMPLES_LTE_TLS_APN_USERNAME
	string "Username used for authentication(same as lte_http_get example)"
	default ""

config EXAMPLES_LTE_TLS_APN_PASSWD
	string "Password used for authentication(same as lte_http_get example)"
	default ""

endif
```

## examples/lte_websocket/Kconfig
```kconfig
#
# For a description of the syntax of this configuration file,
# see the file kconfig-language.txt in the NuttX tools repository.
#

config EXAMPLES_LTE_WEBSOCKET
	tristate "WebSocket using LTE example"
	default n
	---help---
		Enable the WebSocket using LTE example

if EXAMPLES_LTE_WEBSOCKET

config EXAMPLES_LTE_WEBSOCKET_PROGNAME
	string "Program name"
	default "lte_websocket"
	---help---
		This is the name of the program that will be use when the NSH ELF
		program is installed.

config EXAMPLES_LTE_WEBSOCKET_PRIORITY
	int "lte_websocket task priority"
	default 100

config EXAMPLES_LTE_WEBSOCKET_STACKSIZE
	int "lte_websocket stack size"
	default 8192

config EXAMPLES_LTE_WEBSOCKET_STACKSIZE_IN_USING_MBEDTLS
	int "lte_websocket stack size in using mbedTLS"
	default 11264

config EXAMPLES_LTE_WEBSOCKET_APN_NAME
	string "Access Point Name"
	default ""

config EXAMPLES_LTE_WEBSOCKET_APN_IPTYPE
	int "IP type"
	default 0
	range 0 2
	---help---
		IP type is selected from IP, IPv6 and IPv4/v6.
		Values are IP=0, IPv6=1 and IPv4/v6=2.

config EXAMPLES_LTE_WEBSOCKET_APN_AUTHTYPE
	int "Authentication type"
	default 0
	range 0 2
	---help---
		Authentication type is selected from NONE, PAP and CHAP.
		Values are NONE=0, PAP=1, CHAP=2.

config EXAMPLES_LTE_WEBSOCKET_APN_USERNAME
	string "Username used for authentication"
	default ""

config EXAMPLES_LTE_WEBSOCKET_APN_PASSWD
	string "Password used for authentication"
	default ""

endif
```

## examples/mpcomm_prime/Kconfig
```kconfig
#
# For a description of the syntax of this configuration file,
# see the file kconfig-language.txt in the NuttX tools repository.
#

config EXAMPLES_MPCOMM_PRIME
	tristate "Prime number calculator using multiprocessor communication"
	depends on MPCOMM
	default n
	---help---
		Enable the ELF loader example

if EXAMPLES_MPCOMM_PRIME

config EXAMPLES_MPCOMM_PRIME_PROGNAME
	string "Program name"
	default "mpcomm_prime"
	---help---
		This is the name of the program that will be use when the NSH ELF
		program is installed.

config EXAMPLES_MPCOMM_PRIME_PRIORITY
	int "mpcomm_prime task priority"
	default 100

config EXAMPLES_MPCOMM_PRIME_STACKSIZE
	int "mpcomm_prime stack size"
	default 2048

endif
```

## examples/multi_webcamera/Kconfig
```kconfig
#
# For a description of the syntax of this configuration file,
# see the file kconfig-language.txt in the NuttX tools repository.
#

config EXAMPLES_MULTIWEBCAM
	tristate "Multi Web Camera"
	default n
	---help---
		Enable the Multi Web Camera Example

if EXAMPLES_MULTIWEBCAM

config EXAMPLES_MULTIWEBCAM_USE_HTTPMJPEG
	bool "Http MJPEG is used"
	default n
	---help---
		Select the protocol of sending camera images.
		If this is set y, the protocol is Motion Jpeg over HTTP.
		If not, the protocol is a simple original protocol.

choice
	prompt "Multi Web Camera Image size"
	default EXAMPLES_MULTIWEBCAM_IMAGESIZE_VGA

config EXAMPLES_MULTIWEBCAM_IMAGESIZE_QQVGA
	bool "Quarter Quarter VGA (160 x 120)"
	---help---
		Use Quarter Quarter VGA (160 x 120)

config EXAMPLES_MULTIWEBCAM_IMAGESIZE_QVGA
	bool "Quarter VGA (320 x 240)"
	---help---
		Use Quarter VGA (320 x 240)

config EXAMPLES_MULTIWEBCAM_IMAGESIZE_VGA
	bool "VGA (640 x 480)"
	---help---
		Use VGA (640 x 480)

config EXAMPLES_MULTIWEBCAM_IMAGESIZE_HD
	bool "HD (1280 x 720)"
	---help---
		Use HD Image (1280 x 720)

endchoice

config EXAMPLES_MULTIWEBCAM_PROGNAME
	string "Program name"
	default "multiwebcam"
	---help---
		This is the name of the program that will be used when the NSH ELF
		program is installed.

config EXAMPLES_MULTIWEBCAM_PRIORITY
	int "multiwebcam task priority"
	default 100

config EXAMPLES_MULTIWEBCAM_STACKSIZE
	int "multiwebcam stack size"
	default 2048

config EXAMPLES_MULTIWEBCAM_PERF
	bool "Enable printing performance"
	default n
	---help---
		Enable displaying performance information of multiwebcam.

endif
```

## examples/pospredict_pwbimu/Kconfig
```kconfig
config EXAMPLES_POSPREDICT_PWBIMU
	tristate "Position Prediction sample."
	default n
	---help---
		This sample code is predicting position by tracking IMU data as
		a sample for implementing position predict application.

if EXAMPLES_POSPREDICT_PWBIMU

config EXAMPLES_POSPREDICT_PWBIMU_PROGNAME
	string "Program name"
	default "pospredict"
	---help---
		This is the name of the program that will be used when the NSH ELF
		program is installed.

config EXAMPLES_POSPREDICT_PWBIMU_PRIORITY
	int "pospredict_pwbimu task priority"
	default 100

config EXAMPLES_POSPREDICT_PWBIMU_STACKSIZE
	int "pospredict_pwbimu stack size"
	default 2048

endif
```

## examples/power_sleep/Kconfig
```kconfig
config EXAMPLES_POWER_SLEEP
	tristate "power_sleep app"
	default n
	---help---
		Enable the power_sleep app. This application will sleep the CXD5602
		into deep sleep or cold sleep.

if EXAMPLES_POWER_SLEEP

config EXAMPLES_POWER_SLEEP_PROGNAME
	string "Program name"
	default "power_sleep"
	---help---
		This is the name of the program that will be use when the NSH ELF
		program is installed.

config EXAMPLES_POWER_SLEEP_PRIORITY
	int "power_sleep task priority"
	default 100

config EXAMPLES_POWER_SLEEP_STACKSIZE
	int "power_sleep stack size"
	default 1024

endif
```
