## examples/accel/Kconfig
```kconfig
#
# For a description of the syntax of this configuration file,
# see the file kconfig-language.txt in the NuttX tools repository.
#

config EXAMPLES_ACCEL
	tristate "Accelerometer sensor example"
	default n
	---help---
		Enable the sensor via SCU example

if EXAMPLES_ACCEL

config EXAMPLES_ACCEL_PROGNAME
	string "Program name"
	default "accel"
	---help---
		This is the name of the program that will be use when the NSH ELF
		program is installed.

config EXAMPLES_ACCEL_PRIORITY
	int "Sensor task priority"
	default 100

config EXAMPLES_ACCEL_STACKSIZE
	int "Sensor stack size"
	default 2048

endif
```

## examples/adc/Kconfig
```kconfig
#
# For a description of the syntax of this configuration file,
# see the file kconfig-language.txt in the NuttX tools repository.
#

config EXAMPLES_ADC
	bool "ADC example"
	default n
	depends on CXD56_ADC
	---help---
		Enable the ADC example

if EXAMPLES_ADC

config EXAMPLES_ADC_PROGNAME
	string "Program name"
	default "adc"
	depends on BUILD_KERNEL
	---help---
		This is the name of the program that will be use when the NSH ELF
		program is installed.

config EXAMPLES_ADC_PRIORITY
	int "ADC example task priority"
	default 100

config EXAMPLES_ADC_STACKSIZE
	int "ADC example stack size"
	default 2048

config EXAMPLES_ADC_DEVPATH
    string "ADC device path"
    default "/dev/lpadc0"
	---help---
		The default path to the ADC device. Default: /dev/lpadc0

config EXAMPLES_ADC_READCOUNT
	int "Number of reads"
	default 10
	---help---
		Number of data reads.

config EXAMPLES_ADC_BUFSIZE
	int "Buffer size"
	default 16
	---help---
		Buffer size of ADC example.
		The maximum size that can be read with one read is minimum value
		between this size and the scu fifo size.

endif
```

## examples/adc_monitor/Kconfig
```kconfig
#
# For a description of the syntax of this configuration file,
# see the file kconfig-language.txt in the NuttX tools repository.
#

config EXAMPLES_ADC_MONITOR
	tristate "ADC monitor example"
	default n
	depends on CXD56_ADC
	---help---
		Enable the ADC_MONITOR example

if EXAMPLES_ADC_MONITOR

config EXAMPLES_ADC_MONITOR_PROGNAME
	string "Program name"
	default "adc_monitor"
	---help---
		This is the name of the program that will be use when the NSH ELF
		program is installed.

config EXAMPLES_ADC_MONITOR_PRIORITY
	int "ADC_MONITOR example task priority"
	default 100

config EXAMPLES_ADC_MONITOR_STACKSIZE
	int "ADC_MONITOR example stack size"
	default 2048

config EXAMPLES_ADC_MONITOR_DEVPATH
	string "ADC device path"
	default "/dev/lpadc0"
	---help---
		The default path to the ADC device. Default: /dev/lpadc0

config EXAMPLES_ADC_MONITOR_READCOUNT
	int "Number of reads"
	default 10
	---help---
		Number of data reads.

config EXAMPLES_ADC_MONITOR_BUFSIZE
	int "Buffer size"
	default 16
	---help---
		Buffer size of ADC_MONITOR example.
		The maximum size that can be read with one read is minimum value
		between this size and the scu fifo size.

endif
```

## examples/ahrs_pwbimu/Kconfig
```kconfig
config EXAMPLES_AHRS_PWBIMU
	tristate "AHRS example with CXD5602PWBIMU Add-on"
	default n
	---help---
		Enable the ahrs_pwbimu app

if EXAMPLES_AHRS_PWBIMU

config EXAMPLES_AHRS_PWBIMU_PROGNAME
	string "Program name"
	default "ahrs_pwbimu"
	---help---
		This is the name of the program that will be use when the NSH ELF
		program is installed.

config EXAMPLES_AHRS_PWBIMU_PRIORITY
	int "ahrs_pwbimu task priority"
	default 100

config EXAMPLES_AHRS_PWBIMU_STACKSIZE
	int "ahrs_pwbimu stack size"
	default 2048

config EXAMPLES_AHRS_PWBIMU_EXEC_GYROBIAS_ESTIMATION
	bool "ahrs_pwbimu execute gyro-bias estimation"
	default n

config EXAMPLES_AHRS_PWBIMU_GYROBIAS_ESTIMATION_TIME
	int "ahrs_pwbimu gyro-bias estimation time in seconds"
	default 10
	range 1 512
	depends on EXAMPLES_AHRS_PWBIMU_EXEC_GYROBIAS_ESTIMATION

config EXAMPLES_AHRS_PWBIMU_RECV
	bool "Include net receive server"
	default n
	---help---
		Enable a command to receive AHRS result from network.
		This program will act as a network server.

config EXAMPLES_AHRS_PWBIMU_HOST_RECV
	bool "Build receive server on PC side"
	default n
	---help---
		Receiver server will be built for Host PC side.
		Behavior is the same as on board command.

endif
```

## examples/ambient_cli/Kconfig
```kconfig
#
# For a description of the syntax of this configuration file,
# see the file kconfig-language.txt in the NuttX tools repository.
#

config EXAMPLES_AMBIENT_CLI
	tristate "Ambient CLI example"
	default n
	depends on SYSTEM_AMBIENT
	---help---
		Enable the Ambient CLI application

if EXAMPLES_AMBIENT_CLI

config EXAMPLES_AMBIENT_CLI_PROGNAME
	string "Program name"
	default "ambient_cli"
	---help---
		This is the name of the program that will be use when the NSH ELF
		program is installed.

config EXAMPLES_AMBIENT_CLI_PRIORITY
	int "Ambient CLI task priority"
	default 100

config EXAMPLES_AMBIENT_CLI_STACKSIZE
	int "Ambient CLI stack size"
	default DEFAULT_TASK_STACKSIZE

endif
```

## examples/ambient_gnsslogger/Kconfig
```kconfig
#
# For a description of the syntax of this configuration file,
# see the file kconfig-language.txt in the NuttX tools repository.
#

config EXAMPLES_AMBIENT_GNSSLOGGER
	tristate "Ambient GNSS Logger example"
	default n
	depends on SYSTEM_AMBIENT
	---help---
		Enable the Ambient GNSS Logger application

if EXAMPLES_AMBIENT_GNSSLOGGER

config EXAMPLES_AMBIENT_GNSSLOGGER_PROGNAME
	string "Program name"
	default "ambient_gnsslogger"
	---help---
		This is the name of the program that will be use when the NSH ELF
		program is installed.

config EXAMPLES_AMBIENT_GNSSLOGGER_PRIORITY
	int "Ambient GNSS Logger task priority"
	default 100

config EXAMPLES_AMBIENT_GNSSLOGGER_STACKSIZE
	int "Ambient GNSS Logger stack size"
	default DEFAULT_TASK_STACKSIZE

config EXAMPLES_AMBIENT_GNSSLOGGER_GPS_DEVNAME
	string "GNSS device name"
	default "/dev/gps2" if CXD56_GNSS_ADDON
	default "/dev/gps"

endif
```

## examples/asmp/Kconfig
```kconfig
#
# For a description of the syntax of this configuration file,
# see the file kconfig-language.txt in the NuttX tools repository.
#

config EXAMPLES_ASMP
	tristate "ASMP ELF Loader Example"
    depends on ASMP
	default n
	---help---
		Enable the ELF loader example

if EXAMPLES_ASMP

config EXAMPLES_ASMP_PROGNAME
	string "Program name"
	default "asmp"
	---help---
		This is the name of the program that will be use when the NSH ELF
		program is installed.

config EXAMPLES_ASMP_PRIORITY
	int "asmp task priority"
	default 100

config EXAMPLES_ASMP_STACKSIZE
	int "asmp stack size"
	default 2048

config EXAMPLES_ASMP_WORKER_STACKSIZE
    int "Example worker stack size"
    default 1024

endif
```

## examples/audio_beep/Kconfig
```kconfig
#
# For a description of the syntax of this configuration file,
# see the file kconfig-language.txt in the NuttX tools repository.
#

config EXAMPLES_AUDIO_BEEP
	tristate "Audio beep example"
	default n
	depends on CXD56_AUDIO
	---help---
		Enable the audio player example

if EXAMPLES_AUDIO_BEEP

config EXAMPLES_AUDIO_BEEP_PROGNAME
	string "Program name"
	default "audio_beep"

config EXAMPLES_AUDIO_BEEP_PRIORITY
	int "Audio beep task priority"
	default 150

config EXAMPLES_AUDIO_BEEP_STACKSIZE
	int "Audio beep stack size"
	default 2048

endif
```

## examples/audio_dual_players/Kconfig
```kconfig
#
# For a description of the syntax of this configuration file,
# see the file kconfig-language.txt in the NuttX tools repository.
#

config EXAMPLES_AUDIO_DUAL_PLAYERS
	tristate "Audio dual players example"
	default n
	depends on CXD56_AUDIO
	---help---
		Enable the audio dual players example

if EXAMPLES_AUDIO_DUAL_PLAYERS

choice
	prompt "Output device selection"
	default EXAMPLES_AUDIO_DUAL_PLAYERS_OUTPUT_DEV_SPHP
	---help---
		Set the device type of output to use

config EXAMPLES_AUDIO_DUAL_PLAYERS_OUTPUT_DEV_SPHP
	bool "Speaker/Headphone output"

config EXAMPLES_AUDIO_DUAL_PLAYERS_OUTPUT_DEV_I2S
	bool "I2S output"
endchoice

choice
	prompt "player mode selection"
	default EXAMPLES_AUDIO_DUAL_PLAYERS_MODE_NORMAL
	---help---
		Set the operation mode of player capability.
		To play include Hi-Res file, select Hi-Res mode.
		If it is not Hi-Res file, select Normal mode.

config EXAMPLES_AUDIO_DUAL_PLAYERS_MODE_NORMAL
	bool "Normal mode"

config EXAMPLES_AUDIO_DUAL_PLAYERS_MODE_HIRES
	bool "Hi-Res mode"
endchoice

config EXAMPLES_AUDIO_DUAL_PLAYERS_PROGNAME
	string "Program name"
	default "audio_dual_players"

config EXAMPLES_AUDIO_DUAL_PLAYERS_PRIORITY
	int "Audio dual players task priority"
	default 150

config EXAMPLES_AUDIO_DUAL_PLAYERS_STACKSIZE
	int "Audio dual players stack size"
	default 2048
endif
```

## examples/audio_oscillator/Kconfig
```kconfig
#
# For a description of the syntax of this configuration file,
# see the file kconfig-language.txt in the NuttX tools repository.
#

config EXAMPLES_AUDIO_OSCILLATOR
	tristate "Audio oscillator example"
	default n
	depends on CXD56_AUDIO
	---help---
		Enable the audio recorder example

if EXAMPLES_AUDIO_OSCILLATOR

config EXAMPLES_AUDIO_OSCILLATOR_PROGNAME
	string "Program name"
	default "audio_oscillator"

config EXAMPLES_AUDIO_OSCILLATOR_PRIORITY
	int "Audio oscillator task priority"
	default 100

config EXAMPLES_AUDIO_OSCILLATOR_STACKSIZE
	int "Audio oscillator stack size"
	default 2048

config EXAMPLES_AUDIO_OSCILLATOR_USEPOSTPROC
    bool "Use Posstprocess"
    default n

endif
```

## examples/audio_pcm_capture/Kconfig
```kconfig
#
# For a description of the syntax of this configuration file,
# see the file kconfig-language.txt in the NuttX tools repository.
#

config EXAMPLES_AUDIO_PCM_CAPTURE
	tristate "Audio pcm_capture example"
	default n
	depends on CXD56_AUDIO
	---help---
		Enable the audio pcm_capture example

if EXAMPLES_AUDIO_PCM_CAPTURE

config EXAMPLES_AUDIO_PCM_CAPTURE_PROGNAME
	string "Program name"
	default "audio_pcm_capture"

config EXAMPLES_AUDIO_PCM_CAPTURE_PRIORITY
	int "Audio pcm_capture task priority"
	default 100

config EXAMPLES_AUDIO_PCM_CAPTURE_STACKSIZE
	int "Audio pcm_capture stack size"
	default 2048

endif
```

## examples/audio_pcm_capture_objif/Kconfig
```kconfig
#
# For a description of the syntax of this configuration file,
# see the file kconfig-language.txt in the NuttX tools repository.
#

config EXAMPLES_AUDIO_PCM_CAPTURE_OBJIF
	tristate "Audio pcm_capture (use object if)example"
	default n
	depends on CXD56_AUDIO
	---help---
		Enable the audio pcm_capture with object level i/f example

if EXAMPLES_AUDIO_PCM_CAPTURE_OBJIF

config EXAMPLES_AUDIO_PCM_CAPTURE_OBJIF_PROGNAME
	string "Program name"
	default "audio_pcm_capture_objif"

config EXAMPLES_AUDIO_PCM_CAPTURE_OBJIF_PRIORITY
	int "Audio pcm_capture_objif task priority"
	default 100

config EXAMPLES_AUDIO_PCM_CAPTURE_OBJIF_STACKSIZE
	int "Audio pcm_capture_objif stack size"
	default 2048

endif
```

## examples/audio_player/Kconfig
```kconfig
#
# For a description of the syntax of this configuration file,
# see the file kconfig-language.txt in the NuttX tools repository.
#

config EXAMPLES_AUDIO_PLAYER
	tristate "Audio player example"
	default n
	depends on CXD56_AUDIO
	---help---
		Enable the audio player example

if EXAMPLES_AUDIO_PLAYER

choice
	prompt "Output device selection"
	default EXAMPLES_AUDIO_PLAYER_OUTPUT_DEV_SPHP
	---help---
		Set the device type of output to use

config EXAMPLES_AUDIO_PLAYER_OUTPUT_DEV_SPHP
	bool "Speaker/Headphone output"

config EXAMPLES_AUDIO_PLAYER_OUTPUT_DEV_I2S
	bool "I2S output"
endchoice

choice
	prompt "player mode selection"
	default EXAMPLES_AUDIO_PLAYER_MODE_NORMAL
	---help---
		Set the operation mode of player capability.
		To play include Hi-Res file, select Hi-Res mode.
		If it is not Hi-Res file, select Normal mode.

config EXAMPLES_AUDIO_PLAYER_MODE_NORMAL
	bool "Normal mode"

config EXAMPLES_AUDIO_PLAYER_MODE_HIRES
	bool "Hi-Res mode"
endchoice

config EXAMPLES_AUDIO_PLAYER_USEPOSTPROC
    bool "Use Posstprocess"
    default n

config EXAMPLES_AUDIO_PLAYER_PROGNAME
	string "Program name"
	default "audio_player"

config EXAMPLES_AUDIO_PLAYER_PRIORITY
	int "Audio player task priority"
	default 150

config EXAMPLES_AUDIO_PLAYER_STACKSIZE
	int "Audio player stack size"
	default 2048
endif
```

## examples/audio_player_objif/Kconfig
```kconfig
#
# For a description of the syntax of this configuration file,
# see the file kconfig-language.txt in the NuttX tools repository.
#

config EXAMPLES_AUDIO_PLAYER_OBJIF
	tristate "Audio player (use object if)example"
	default n
	depends on CXD56_AUDIO
	---help---
		Enable the audio player with object level i/f example

if EXAMPLES_AUDIO_PLAYER_OBJIF

choice
	prompt "Output device selection"
	default EXAMPLES_AUDIO_PLAYER_OBJIF_OUTPUT_DEV_SPHP
	---help---
		Set the device type of output to use

config EXAMPLES_AUDIO_PLAYER_OBJIF_OUTPUT_DEV_SPHP
	bool "Speaker/Headphone output"

config EXAMPLES_AUDIO_PLAYER_OBJIF_OUTPUT_DEV_I2S
	bool "I2S output"
endchoice

choice
	prompt "player mode selection"
	default EXAMPLES_AUDIO_PLAYER_OBJIF_MODE_NORMAL
	---help---
		Set the operation mode of player capability.
		To play include Hi-Res file, select Hi-Res mode.
		If it is not Hi-Res file, select Normal mode.

config EXAMPLES_AUDIO_PLAYER_OBJIF_MODE_NORMAL
	bool "Normal mode"

config EXAMPLES_AUDIO_PLAYER_OBJIF_MODE_HIRES
	bool "Hi-Res mode"
endchoice

config EXAMPLES_AUDIO_PLAYER_OBJIF_USEPOSTPROC
    bool "Use Posstprocess"
    default n

config EXAMPLES_AUDIO_PLAYER_OBJIF_PROGNAME
	string "Program name"
	default "audio_player_objif"

config EXAMPLES_AUDIO_PLAYER_OBJIF_PRIORITY
	int "Audio player task priority"
	default 150

config EXAMPLES_AUDIO_PLAYER_OBJIF_STACKSIZE
	int "Audio player stack size"
	default 2048
endif
```

## examples/audio_player_post/Kconfig
```kconfig
#
# For a description of the syntax of this configuration file,
# see the file kconfig-language.txt in the NuttX tools repository.
#

config EXAMPLES_AUDIO_PLAYER_POST
	bool "Audio player example with postfilter"
	default n
	depends on CXD56_AUDIO
	---help---
		Enable the audio player with postfilter example

if EXAMPLES_AUDIO_PLAYER_POST

choice
	prompt "Output device selection"
	default EXAMPLES_AUDIO_PLAYER_POST_OUTPUT_DEV_SPHP
	---help---
		Set the device type of output to use

config EXAMPLES_AUDIO_PLAYER_POST_OUTPUT_DEV_SPHP
	bool "Speaker/Headphone output"

config EXAMPLES_AUDIO_PLAYER_POST_OUTPUT_DEV_I2S
	bool "I2S output"
endchoice

choice
	prompt "player mode selection"
	default EXAMPLES_AUDIO_PLAYER_POST_MODE_NORMAL
	---help---
		Set the operation mode of player capability.
		To play include Hi-Res file, select Hi-Res mode.
		If it is not Hi-Res file, select Normal mode.

config EXAMPLES_AUDIO_PLAYER_MODE_POST_NORMAL
	bool "Normal mode"

config EXAMPLES_AUDIO_PLAYER_MODE_POST_HIRES
	bool "Hi-Res mode"
endchoice

config EXAMPLES_AUDIO_PLAYER_POST_PROGNAME
	string "Program name"
	default "audio_player_post"

config EXAMPLES_AUDIO_PLAYER_POST_PRIORITY
	int "Audio player pf task priority"
	default 150

config EXAMPLES_AUDIO_PLAYER_POST_STACKSIZE
	int "Audio player pf stack size"
	default 2048
endif
```
