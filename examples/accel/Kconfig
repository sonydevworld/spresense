## examples/audio_recognizer/Kconfig
```kconfig
#
# For a description of the syntax of this configuration file,
# see the file kconfig-language.txt in the NuttX tools repository.
#

config EXAMPLES_AUDIO_RECOGNIZER
	tristate "Audio recognizer example"
	default n
	depends on CXD56_AUDIO
	---help---
		Enable the audio recognizer example

if EXAMPLES_AUDIO_RECOGNIZER

config EXAMPLES_AUDIO_RECOGNIZER_PROGNAME
	string "Program name"
	default "audio_recognizer"

config EXAMPLES_AUDIO_RECOGNIZER_PRIORITY
	int "Audio recognizer task priority"
	default 100

config EXAMPLES_AUDIO_RECOGNIZER_STACKSIZE
	int "Audio recognizer stack size"
	default 2048

choice
	prompt "Pre process"
    default EXAMPLES_AUDIO_RECOGNIZER_THROUGH
	---help---
        Select pre process which is applied at Frontend
   
config EXAMPLES_AUDIO_RECOGNIZER_USEPREPROC
	bool "User custom process"
	---help---
	    Use user custom process at Frontend

config EXAMPLES_AUDIO_RECOGNIZER_SAMPLERATECONV
	bool "Sample rate converter"
	---help---
	    Use sample rate converter at Frontend

config EXAMPLES_AUDIO_RECOGNIZER_THROUGH
	bool "Through"
	---help---
	    No signal processing is applied at Frontend

endchoice

endif
```

## examples/audio_recorder/Kconfig
```kconfig
#
# For a description of the syntax of this configuration file,
# see the file kconfig-language.txt in the NuttX tools repository.
#

config EXAMPLES_AUDIO_RECORDER
	tristate "Audio recorder example"
	default n
	depends on CXD56_AUDIO
	---help---
		Enable the audio recorder example

if EXAMPLES_AUDIO_RECORDER

config EXAMPLES_AUDIO_RECORDER_PROGNAME
	string "Program name"
	default "audio_recorder"

config EXAMPLES_AUDIO_RECORDER_PRIORITY
	int "Audio recorder task priority"
	default 100

config EXAMPLES_AUDIO_RECORDER_STACKSIZE
	int "Audio recorder stack size"
	default 2048

config EXAMPLES_AUDIO_RECORDER_USEPREPROC
	bool "Use preprocess"
	default n

endif
```

## examples/audio_recorder_objif/Kconfig
```kconfig
#
# For a description of the syntax of this configuration file,
# see the file kconfig-language.txt in the NuttX tools repository.
#

config EXAMPLES_AUDIO_RECORDER_OBJIF
	tristate "Audio recorder (use object if)example"
	default n
	depends on CXD56_AUDIO
	---help---
		Enable the audio recorder with object level i/f example

if EXAMPLES_AUDIO_RECORDER_OBJIF

config EXAMPLES_AUDIO_RECORDER_OBJIF_PROGNAME
	string "Program name"
	default "audio_recorder_objif"

config EXAMPLES_AUDIO_RECORDER_OBJIF_PRIORITY
	int "Audio recorder objif task priority"
	default 100

config EXAMPLES_AUDIO_RECORDER_OBJIF_STACKSIZE
	int "Audio recorder objif stack size"
	default 2048

config EXAMPLES_AUDIO_RECORDER_OBJIF_USEPREPROC
	bool "Use preprocess"
	default n

endif
```

## examples/audio_sound_effector/Kconfig
```kconfig
#
# For a description of the syntax of this configuration file,
# see the file kconfig-language.txt in the NuttX tools repository.
#

config EXAMPLES_AUDIO_SOUND_EFFECTOR
	tristate "Audio sound effector example"
	default n
	depends on CXD56_AUDIO
	---help---
		Enable the audio sound effector with object level i/f example

if EXAMPLES_AUDIO_SOUND_EFFECTOR

config EXAMPLES_AUDIO_SOUND_EFFECTOR_PROGNAME
	string "Program name"
	default "audio_sound_effector"

config EXAMPLES_AUDIO_SOUND_EFFECTOR_PRIORITY
	int "Sound effector task priority"
	default 150

config EXAMPLES_AUDIO_SOUND_EFFECTOR_STACKSIZE
	int "Sound effector stack size"
	default 2048

endif
```

## examples/audio_through/Kconfig
```kconfig
#
# For a description of the syntax of this configuration file,
# see the file kconfig-language.txt in the NuttX tools repository.
#

config EXAMPLES_AUDIO_THROUGH
	tristate "Audio through example"
	default n
	depends on CXD56_AUDIO
	---help---
		Enable the audio through example

if EXAMPLES_AUDIO_THROUGH

config EXAMPLES_AUDIO_THROUGH_PROGNAME
	string "Program name"
	default "audio_through"

config EXAMPLES_AUDIO_THROUGH_PRIORITY
	int "Audio through task priority"
	default 150

config EXAMPLES_AUDIO_THROUGH_STACKSIZE
	int "Audio through stack size"
	default 2048

endif
```

## examples/audiolite_fft/Kconfig
```kconfig
config EXAMPLES_AUDIOLITE_FFT
	tristate "AudioLite sample : audiolite_fft app"
	default n
	---help---
		Enable the audiolite_fft app. This example includes how to make
		user original audiolite component with worker (sub-core) off-load.

if EXAMPLES_AUDIOLITE_FFT

config EXAMPLES_AUDIOLITE_FFT_PROGNAME
	string "Program name"
	default "audiolite_fft"
	---help---
		This is the name of the program that will be use when the NSH ELF
		program is installed.

config EXAMPLES_AUDIOLITE_FFT_PRIORITY
	int "audiolite_fft task priority"
	default 100

config EXAMPLES_AUDIOLITE_FFT_STACKSIZE
	int "audiolite_fft stack size"
	default 2048

endif
```

## examples/audiolite_gnss1pps_dpll/Kconfig
```kconfig
config EXAMPLES_AUDIOLITE_GNSS1PPS_DPLL
	tristate "Digital PLL synchronized with GNSS 1PPS signal"
	default n
	---help---
		Enable the audiolite_gnss1pps_dpll app

if EXAMPLES_AUDIOLITE_GNSS1PPS_DPLL

config EXAMPLES_AUDIOLITE_GNSS1PPS_DPLL_PROGNAME
	string "Program name"
	default "audiolite_gnss1pps_dpll"
	---help---
		This is the name of the program that will be use when the NSH ELF
		program is installed.

config EXAMPLES_AUDIOLITE_GNSS1PPS_DPLL_PRIORITY
	int "audiolite_gnss1pps_dpll task priority"
	default 100

config EXAMPLES_AUDIOLITE_GNSS1PPS_DPLL_STACKSIZE
	int "audiolite_gnss1pps_dpll stack size"
	default 2048

config EXAMPLES_AUDIOLITE_GNSS1PPS_DPLL_PSEUDO1PPS
	bool "Enable a command of pseudo 1pps signal generater"
	default n
	---help---
		Enable a 'pseudo1pps' command to generate pseudo 1pps signal
		from another spresense main board.

choice EXAMPLES_AUDIOLITE_GNSS1PPS_DPLL_MICASSIGN_ONEPPS
	prompt "Choose Assignment of ONEPPS MIC (MIC-A or MIC-B)"
	default EXAMPLES_AUDIOLITE_GNSS1PPS_DPLL_MICASSIGN_ONEPPS_MICA

config EXAMPLES_AUDIOLITE_GNSS1PPS_DPLL_MICASSIGN_ONEPPS_MICA
	bool "MIC-A is ONEPPS signal, MIC-B is Refecence Signal"

config EXAMPLES_AUDIOLITE_GNSS1PPS_DPLL_MICASSIGN_ONEPPS_MICB
	bool "MIC-B is ONEPPS signal, MIC-A is Refecence Signal"

endchoice

choice EXAMPLES_AUDIOLITE_GNSS1PPS_DPLL_OUTPUT_REFSIG_ASSIGN
	prompt "Choose Assignment of Reference Signal Output"
	default EXAMPLES_AUDIOLITE_GNSS1PPS_DPLL_OUTPUT_REFSIG_ASSIGN_L

config EXAMPLES_AUDIOLITE_GNSS1PPS_DPLL_OUTPUT_REFSIG_ASSIGN_L
	bool "L-Ch is Reference Signal, R-Ch is Modulated Signal"

config EXAMPLES_AUDIOLITE_GNSS1PPS_DPLL_OUTPUT_REFSIG_ASSIGN_R
	bool "R-Ch is Reference Signal, L-Ch is Modulated Signal"

endchoice

config EXAMPLES_AUDIOLITE_GNSS1PPS_DPLL_PLL_DEBUG
	bool "Enable Debug print in PLL Worker"
	default n
	---help---
		Display debug message from PLL Worker on normal UART

endif
```

## examples/audiolite_mp3player/Kconfig
```kconfig
config EXAMPLES_AUDIOLITE_MP3PLAYER
	tristate "AudioLite sample : audiolite_mp3player app"
	default n
	---help---
		Enable the audiolite_mp3player app

if EXAMPLES_AUDIOLITE_MP3PLAYER

config EXAMPLES_AUDIOLITE_MP3PLAYER_PROGNAME
	string "Program name"
	default "audiolite_mp3player"
	---help---
		This is the name of the program that will be use when the NSH ELF
		program is installed.

config EXAMPLES_AUDIOLITE_MP3PLAYER_PRIORITY
	int "audiolite_mp3player task priority"
	default 100

config EXAMPLES_AUDIOLITE_MP3PLAYER_STACKSIZE
	int "audiolite_mp3player stack size"
	default 2048

endif
```

## examples/audiolite_rec2net/Kconfig
```kconfig
config EXAMPLES_AUDIOLITE_REC2NET
	tristate "AudioLite sample : audiolite_rec2net app"
	default n
	---help---
		Enable the audiolite_rec2net app
		This app get mic audio signal(192KHz 16bit 4ch).
		And send it to connected server.

if EXAMPLES_AUDIOLITE_REC2NET

config EXAMPLES_AUDIOLITE_REC2NET_PROGNAME
	string "Program name"
	default "audiolite_rec2net"
	---help---
		This is the name of the program that will be use when the NSH ELF
		program is installed.

config EXAMPLES_AUDIOLITE_REC2NET_PRIORITY
	int "audiolite_rec2net task priority"
	default 100

config EXAMPLES_AUDIOLITE_REC2NET_STACKSIZE
	int "audiolite_rec2net stack size"
	default 2048

endif
```

## examples/audiolite_through/Kconfig
```kconfig
config EXAMPLES_AUDIOLITE_THROUGH
	tristate "audiolite_through app"
	default n
	---help---
		Enable the audiolite_through app

if EXAMPLES_AUDIOLITE_THROUGH

config EXAMPLES_AUDIOLITE_THROUGH_PROGNAME
	string "Program name"
	default "audiolite_through"
	---help---
		This is the name of the program that will be use when the NSH ELF
		program is installed.

config EXAMPLES_AUDIOLITE_THROUGH_PRIORITY
	int "audiolite_through task priority"
	default 100

config EXAMPLES_AUDIOLITE_THROUGH_STACKSIZE
	int "audiolite_through stack size"
	default 2048

config EXAMPLES_AUDIOLITE_THROUGH_WATCHDATA
	bool "Watch through data on the console"
	default n
	---help---
		Enable displaying through data from mic to spkeaker on
		terminal console.

endif
```
