## externals/cmsis/Kconfig
```kconfig
#
# For a description of the syntax of this configuration file,
# see the file kconfig-language.txt in the NuttX tools repository.
#

config EXTERNALS_CMSIS
	bool "CMSIS Libraries"
	default n
	---help---
		Enable CMSIS Libraries.
		The Cortex Microcontroller Software Interface Standard (CMSIS) is provided
		from https://github.com/ARM-software/CMSIS_5 and licensed under Apache-2.0.
		For details, see http://arm-software.github.io/CMSIS_5/General/html/index.html.

if EXTERNALS_CMSIS

config EXTERNALS_CMSIS_DSP
	bool "CMSIS DSP"
	default y
	---help---
		Enable CMSIS-DSP: Fast implementation of digital signal processing.

if EXTERNALS_CMSIS_DSP

config EXTERNALS_CMSIS_DSP_ARM_MATH_MATRIX_CHECK
	bool "CMSIS DSP MATH MATRIX CHECK"
	default n
	---help---
		Enable checking on the input and output sizes of matrices

config EXTERNALS_CMSIS_DSP_ARM_MATH_ROUNDING
	bool "CMSIS DSP MATH ROUNDING"
	default n
	---help---
		Enable rounding on support functions

endif # EXTERNALS_CMSIS_DSP

config EXTERNALS_CMSIS_NN
	bool "CMSIS NN"
	default y
	depends on EXTERNALS_CMSIS_DSP
	---help---
		Enable CMSIS-NN: Efficient neural network kernels.

endif # EXTERNALS_CMSIS
```

## externals/cobs-c/Kconfig
```kconfig
config EXTERNALS_COBS_C
	bool "COBS-C Library"
	default n
	---help---
		"cobs-c" is the OSS from https://github.com/cmcqueen/cobs-c.git.
		This option is enabled to use it.
```

## externals/eltres/Kconfig
```kconfig
#
# For a description of the syntax of this configuration file,
# see the file kconfig-language.txt in the NuttX tools repository.
#

menuconfig EXTERNALS_ELTRES
	bool "ELTRES SDK library"
	default n
	---help---
		Enable ELTRES SDK library.
		This SDK is provided from https://eltres-iot.jp and is licensed
		under the 3-Clause BSD License.

if EXTERNALS_ELTRES

choice
	prompt "ELTRES board selection"
	default EXTERNALS_ELTRES_SPEXEL

config EXTERNALS_ELTRES_SPEXEL
	bool "SPEXEL board"
	depends on CXD56_UART0
	---help---
		Use SPEXEL board provided by RISNER.
		https://eltres-iot.jp/product/product-030/

config EXTERNALS_ELTRES_ADDON
	bool "Add-on board"
	depends on CXD56_UART2
	---help---
		Use Add-on board provided by CRESCO Digital Tech.
		https://www.cresco-dt.co.jp/service/iot/iot-poc/eltres/

config EXTERNALS_ELTRES_ORIGINAL
	bool "Original board"
	---help---
		Use the original board.

endchoice

config EXTERNALS_ELTRES_DEBUG_ERROR
	bool "Debug printf for error"
	default n
	---help---
		Enable the debug printf for error.

config EXTERNALS_ELTRES_DEBUG_INFO
	bool "Debug printf for info"
	default n
	---help---
		Enable the debug printf for info.

config EXTERNALS_ELTRES_CTRL_FWUPDATE
	bool "Control firmware update"
	default n
	---help---
		Enable the Control firmware update.

config EXTERNALS_ELTRES_GNSS_FWUPDATE
	bool "GNSS firmware update"
	default n
	---help---
		Enable the GNSS firmware update.

config EXTERNALS_ELTRES_TEST_MODE
	bool "Transmission test mode"
	default n
	---help---
		Enable the transmission test mode.

endif # EXTERNALS_ELTRES
```

## externals/libjpeg/Kconfig
```kconfig
#
# For a description of the syntax of this configuration file,
# see the file kconfig-language.txt in the NuttX tools repository.
#

config EXTERNALS_LIBJPEG
	bool "libjpeg"
	default n
	---help---
		Enable libjpeg.
		libjpeg is provided from http://www.ijg.org/files/jpegsrc.v9c.tar.gz

if EXTERNALS_LIBJPEG

config EXTERNALS_LIBJPEG_TEMP_DIR
	string "Temporary directory"
	default "/mnt/spif/"
	---help---
		This is the directory path including the trailing slash '/'
		to store the temporary files created by libjpeg.

endif # EXTERNALS_LIBJPEG
```

## externals/lwm2m/Kconfig
```kconfig
#
# For a description of the syntax of this configuration file,
# see the file kconfig-language.txt in the NuttX tools repository.
#

menuconfig EXTERNALS_LWM2M
	bool "LwM2M Wakaama library"
	default n
	---help---
		Enable LwM2M Wakaama library.
		This library is provided from https://github.com/eclipse/wakaama
		and licensed under the Eclipse Public License, version 1.0/2.0.

if EXTERNALS_LWM2M

menu "Wakaama configuration"

comment "Mode"

config EXTERNALS_LWM2M_CLIENT_MODE
	bool "Client mode"
	default y
	---help---
		Enable LWM2M Client interfaces.

config EXTERNALS_LWM2M_BOOTSTRAP
	bool "Bootstrap"
	default y
	depends on EXTERNALS_LWM2M_CLIENT_MODE
	---help---
		Enable LWM2M Bootstrap support in a LWM2M Client.

config EXTERNALS_LWM2M_SERVER_MODE
	bool "Server mode"
	default n
	depends on !EXTERNALS_LWM2M_CLIENT_MODE
	---help---
		Enable LWM2M Server interfaces.

config EXTERNALS_LWM2M_BOOTSTRAP_SERVER_MODE
	bool "Bootstrap Server mode"
	default n
	depends on !EXTERNALS_LWM2M_BOOTSTRAP
	---help---
		Enable LWM2M Bootstrap Server interfaces.

comment "Content Format"

config EXTERNALS_LWM2M_SUPPORT_TLV
	bool "TLV payload"
	default y
	---help---
		Enable TLV payload support.

config EXTERNALS_LWM2M_SUPPORT_JSON
	bool "JSON payload"
	default y
	---help---
		Enable JSON payload support.

config EXTERNALS_LWM2M_SUPPORT_SENML_JSON
	bool "SenML JSON payload"
	default n
	depends on !EXTERNALS_LWM2M_VERSION_1_0
	---help---
		Enable SenML JSON payload support.

config EXTERNALS_LWM2M_OLD_CONTENT_FORMAT_SUPPORT
	bool "Old content format"
	default n
	---help---
		Support the deprecated content format values for TLV and JSON.

comment "Encryption Options"

config EXTERNALS_LWM2M_WITH_TINYDTLS
	bool "TinyDTLS"
	default y
	---help---
		Enable TinyDTLS.
		This library is provided from https://github.com/eclipse/tinydtls
		and licensed under the Eclipse Public License version 1.0 and the
		Eclipse Distribution License version 1.0.

comment "Miscellaneous Options"

config EXTERNALS_LWM2M_VERSION_1_0
	bool "Old version 1.0"
	default n
	---help---
		Specify version 1.0.

config EXTERNALS_LWM2M_RAW_BLOCK1_REQUESTS
	bool "Each unprocessed block 1 payload"
	default n
	---help---
		Enable each unprocessed block 1 payload to be passed to the application,
		typically to be stored to a flash memory.

config EXTERNALS_LWM2M_COAP_DEFAULT_BLOCK_SIZE
	int "CoAP block size"
	default 1024
	---help---
		CoAP block size used by CoAP layer when performing block-wise transfers.
		Possible values: 16, 32, 64, 128, 256, 512 and 1024.

comment "Debug Options"

config EXTERNALS_LWM2M_WITH_LOGS
	bool "Debug logs"
	default n
	---help---
		Enable debug logs.

config EXTERNALS_LWM2M_MEMORY_TRACE
	bool "Memory Trace"
	default n
	---help---
		Enable memory trace.

endmenu

endif # EXTERNALS_LWM2M
```

## externals/mbedtls/Kconfig
```kconfig
#
# For a description of the syntax of this configuration file,
# see the file kconfig-language.txt in the NuttX tools repository.
#

config EXTERNALS_MBEDTLS
	bool "mbed TLS Library"
	default n
	---help---
		Enable mbed TLS Library.
		And when you select this, make sure CONFIG_LTE_NET_MBEDTLS is disabled. Those are exclusive items.
		ARM mbed TLS is provided from https://github.com/ARMmbed/mbedtls
		and licensed under Apache-2.0.
```

## externals/mbedtls_webclient/Kconfig
```kconfig
#
# For a description of the syntax of this configuration file,
# see the file kconfig-language.txt in the NuttX tools repository.
#

config EXTERNALS_MBEDTLS_WEBCLIENT
	bool "mbedTLS webclient support"
	default n
	depends on NET_TCP && (EXTERNALS_MBEDTLS || LTE_NET_MBEDTLS)
	select NETUTILS_WEBCLIENT
	---help---
		Enable support mbedTLS webclient

if EXTERNALS_MBEDTLS_WEBCLIENT

config EXTERNALS_MBEDTLS_WEBCLIENT_TIMEOUT
	int "Request and receive timeouts"
	default 10

config EXTERNALS_MBEDTLS_WEBCLIENT_CERTS_PATH
	string "Directory path for TLS certification files"
	default "/mnt/spif/CERTS"

endif
```

## externals/micro-ecc/Kconfig
```kconfig
#
# For a description of the syntax of this configuration file,
# see the file kconfig-language.txt in the NuttX tools repository.
#

config EXTERNALS_MICRO_ECC
	bool "micro-ecc"
	default n
	---help---
		Enable micro-ecc library.
		This library is provided from https://github.com/kmackay/micro-ecc.git
		and is licensed under 2-Clause BSD License.
```

## externals/mossfw/Kconfig
```kconfig
#
# For a description of the syntax of this configuration file,
# see the file kconfig-language.txt in the NuttX tools repository.
#

config EXTERNALS_MOSSFW
	bool "Motion Sensor Software framework"
	default n
	---help---
		Enable Motion Sensor Software Framework library from
		https://github.com/SonySemiconductorSolutions/mossfw.git

if EXTERNALS_MOSSFW

config EXTERNALS_MOSSFW_SEONSORLIB
	bool "Use sensor libraries"
	default n
	---help---
		Enable sensor library.

endif # EXTERNALS_MOSSFW
```

## externals/mqtt/Kconfig
```kconfig
#
# For a description of the syntax of this configuration file,
# see the file kconfig-language.txt in the NuttX tools repository.
#

config EXTERNALS_MQTT
	bool "MQTT Library"
	default n
	---help---
		Enable MQTT (Message Queuing Telemetry Transport) Library.
		MQTT Library is provided from https://github.com/eclipse/paho.mqtt.embedded-c
		and licensed under EPL-1.0 and EDL-1.0.
```

## externals/nnablart/Kconfig
```kconfig
#
# For a description of the syntax of this configuration file,
# see the file kconfig-language.txt in the NuttX tools repository.
#

config EXTERNALS_NNABLART
	bool
	default n
```

## externals/nrf52/Kconfig
```kconfig
#
# For a description of the syntax of this configuration file,
# see the file kconfig-language.txt in the NuttX tools repository.
#

config EXTERNALS_NRF52
	bool "NRF52 Libraries"
	depends on BLUETOOTH_NRF52
	default n
	---help---
		Enable NRF52 Libraries.
		from https://www.nordicsemi.com/Products/Development-software/nRF5-SDK/Download
		For details, see https://infocenter.nordicsemi.com/index.jsp?topic=%2Fstruct_sdk%2Fstruct%2Fsdk_nrf5_latest.html .

if EXTERNALS_NRF52

choice
	prompt "nRF52xxx & Soft Device"
	default EXTERNALS_NRF52_S132

config EXTERNALS_NRF52_S132
	bool "Select nRF52832 & SoftDevice S132"

endchoice

config EXTERNALS_NRF52_OUTPUT_LOG_LEVEL
	int "Output log level"
	default 2
	range 0 4
	---help---
		Set output log level, whose value means the following:
		- 0: off
		- 1: error
		- 2: warning
		- 3: information
		- 4: debug
		The log levels of each components can be adjusted by the following
		configurations:
		- EXTERNALS_NRF52_NRF_QUEUE_LOG_LEVEL
		- EXTERNALS_NRF52_NRF_SDH_BLE_LOG_LEVEL
		- EXTERNALS_NRF52_SER_HAL_TRANSPORT_LOG_LEVEL
		- EXTERNALS_NRF52_SER_SD_TRANPORT_LOG_LEVEL
		- EXTERNALS_NRF52_SER_SD_HANDLER_LOG_LEVEL
		- EXTERNALS_NRF52_SER_PHY_UART_LOG_LEVEL
		The log levels of each components are valid only if they are
		EXTERNALS_NRF52_OUTPUT_LOG_LEVEL value or less.
		Therefore, EXTERNALS_NRF52_OUTPUT_LOG_LEVEL needs to be set to more detailed
		setting, when more detailed log of each components is needed.

if EXTERNALS_NRF52_OUTPUT_LOG_LEVEL > 0
config EXTERNALS_NRF52_NRF_QUEUE_LOG_LEVEL
	int "Log level of nrf_queue component"
	default 4
	range 0 4
	---help---
		Set log level of nrf_queue component.

config EXTERNALS_NRF52_NRF_SDH_BLE_LOG_LEVEL
	int "Log level of nrf_sdh_ble component"
	default 4
	range 0 4
	---help---
		Set log level of nrf_sdh_ble component.

config EXTERNALS_NRF52_SER_HAL_TRANSPORT_LOG_LEVEL
	int "Log level of ser_hal_transport component"
	default 4
	range 0 4
	---help---
		Set log level of ser_hal_transport component.

config EXTERNALS_NRF52_SER_SD_TRANSPORT_LOG_LEVEL
	int "Log level of ser_sd_transport component"
	default 4
	range 0 4
	---help---
		Set log level of ser_sd_transport component.

config EXTERNALS_NRF52_SER_SD_HANDLER_LOG_LEVEL
	int "Log level of ser_sd_handler component"
	default 4
	range 0 4
	---help---
		Set log level of ser_sd_handler component.

config EXTERNALS_NRF52_SER_PHY_UART_LOG_LEVEL
	int "Log level of ser_phy_uart component"
	default 4
	range 0 4
	---help---
		Set log level of ser_phy_uart component.

endif # EXTERNALS_NRF52_OUTPUT_LOG_LEVEL > 0

config EXTERNALS_NRF52_EVTTASK_STACKSIZE
	int "Event task stack size"
	default 4096
	---help---
		Stack size of event task which calls callback functions to notify
		asynchronous event from nRF52

if NRF52_LESC
choice
	prompt "nRF52 cryptography library backend"
	default EXTERNALS_NRF52_CRYPTOGRAPHY_MICRO_ECC

config EXTERNALS_NRF52_CRYPTOGRAPHY_MICRO_ECC
	bool "Use micro-ecc backend"
	depends on EXTERNALS_MICRO_ECC

config EXTERNALS_NRF52_CRYPTOGRAPHY_MBEDTLS
	bool "Use mbedtls backend"
	depends on EXTERNALS_MBEDTLS
endchoice
endif # NRF52_LESC
endif # EXTERNALS_NRF52
```

## externals/sslutils/Kconfig
```kconfig
#
# For a description of the syntax of this configuration file,
# see the file kconfig-language.txt in the NuttX tools repository.
#

config EXTERNALS_SSLUTILS
	bool "mbedTLS connection utility support"
	default y if EXTERNALS_MBEDTLS || LTE_NET_MBEDTLS
	depends on NET_TCP && (EXTERNALS_MBEDTLS || LTE_NET_MBEDTLS)
	---help---
		Enable support mbedTLS connection utility. Some examples are using
		this utility for connection TLS socket.

if EXTERNALS_SSLUTILS

config EXTERNALS_SSLUTILS_LOGLEVEL
	int "mbedTLS debug log level (0 to 5)"
	range 0 5
	default 0
	---help---
		Set debug log level of mbedTLS library.
		0 is no log message. If set this more than 0, you can see debug log
		mbedTLS library outputs. 5 is the maximum (Most verbose).

endif
```

## externals/tensorflow/Kconfig
```kconfig
#
# For a description of the syntax of this configuration file,
# see the file kconfig-language.txt in the NuttX tools repository.
#

config EXTERNALS_TENSORFLOW
	bool "Tensorflow lite micro"
	default n
	---help---
		Download Tensorflow lite micro from https://github.com/tensorflow/tensorflow,
		and build it on Spresense SDK. The version to download is v2.4.0.
		and it is licensed under the Apache License v2.0.
		Please check License file in the repository for more details.

if EXTERNALS_TENSORFLOW

choice
	prompt "Tensorflow lite micro example"
	default EXTERNALS_TENSORFLOW_EXAMPLE_NONE

config EXTERNALS_TENSORFLOW_EXAMPLE_NONE
	bool "No example"

config EXTERNALS_TENSORFLOW_EXAMPLE_HELLOWORLD
	bool "Helloworld example"
	---help---
		Tensorflow lite micro's "Hello world" example.
		Source code is in tensorflow/tensorflow/lite/micro/examples/hello_world.

config EXTERNALS_TENSORFLOW_EXAMPLE_MICROSPEECH
	bool "Micro speech example"
	---help---
		Tensorflow lite micro's "Micro speech" example.
		Source code is in tensorflow/tensorflow/lite/micro/examples/micro_speech.

config EXTERNALS_TENSORFLOW_EXAMPLE_PERSONDETECTION
	bool "Person Detection example"
	---help---
		Tensorflow lite micro's "Person detection" example.
		Source code is in tensorflow/tensorflow/lite/micro/examples/person_detection.

endchoice

endif # EXTERNALS_TENSORFLOW
```

## externals/vtun/Kconfig
```kconfig
#
# For a description of the syntax of this configuration file,
# see the file kconfig-language.txt in the NuttX tools repository.
#

config EXTERNALS_VTUN
	bool "VTUN Command"
	default n
	select EXTERNALS_MBEDTLS
	---help---
		Download VTUN from https://jaist.dl.sourceforge.net/project/vtun,
		and build it on Spresense SDK. The version to download is v3.0.4.
		and it is licensed under the GNU General Public License version 2.0.
		Please check License file in the sourceforge for more details.

if EXTERNALS_VTUN

config EXTERNALS_VTUN_PROGNAME
	string "Program name"
	default "vtun"
	---help---
		This is the name of the program that will be use when the NSH ELF
		program is installed.

config EXTERNALS_VTUN_PRIORITY
	int "vtun task priority"
	default 100

config EXTERNALS_VTUN_STACKSIZE
	int "vtun stack size"
	default 8192

config EXTERNALS_VTUN_CFG_FILE
	string "vtun default config file"
	default "/mnt/spif/vtund.conf"

config EXTERNALS_VTUN_PID_FILE
	string "vtun pid file"
	default "/mnt/spif/vtun.pid"

config EXTERNALS_VTUN_STAT_DIR
	string "vtun stat file destination"
	default "/mnt/spif"

config EXTERNALS_VTUN_LOCK_DIR
	string "vtun lock file destination"
	default "/mnt/spif"

endif
```
