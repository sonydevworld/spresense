## examples/tlstest/Kconfig
```kconfig
#
# For a description of the syntax of this configuration file,
# see the file kconfig-language.txt in the NuttX tools repository.
#

config EXAMPLES_TLSTEST
	bool "mbedtls test"
	default n
	---help---
		Enable the mbedtls test

if EXAMPLES_TLSTEST

config EXAMPLES_TLSTEST_PROGNAME
	string "Program name"
	default "tlstest"
	depends on BUILD_KERNEL
	---help---
		This is the name of the program that will be use when the NSH ELF
		program is installed.

config EXAMPLES_TLSTEST_PRIORITY
	int "tlstest task priority"
	default 100

config EXAMPLES_TLSTEST_STACKSIZE
	int "tlstest stack size"
	default 2048

endif
```

## examples/transport_mode/Kconfig
```kconfig
#
# For a description of the syntax of this configuration file,
# see the file kconfig-language.txt in the NuttX tools repository.
#

config EXAMPLES_SENSOR_TRAM
	bool "Transport mode sensor example"
	default n
	---help---
		Enable the transport-mode sensor example

if EXAMPLES_SENSOR_TRAM

config EXAMPLES_SENSOR_TRAM_PROGNAME
	string "Program name"
	default "transport_mode"
	depends on BUILD_KERNEL
	---help---
		This is the name of the program that will be use when the NSH ELF
		program is installed.

config EXAMPLES_SENSOR_TRAM_PRIORITY
	int "Transport mode task priority"
	default 100

config EXAMPLES_SENSOR_TRAM_STACKSIZE
	int "Transport mode stack size"
	default 2048

config EXAMPLES_SENSOR_TRAM_CHANGE_SCU_SIGNO
    int "Accelerator sensor's inner changing SCU setting signal"
    default 16

config EXAMPLES_SENSOR_TRAM_ACCEL_TM_SIGNO
    int "Accelerator sensor's inner timer signal"
    default 15

config EXAMPLES_SENSOR_TRAM_ACCEL_WM_SIGNO
    int "Accelerator sensor signal for waterMark"
    default 14

config EXAMPLES_SENSOR_TRAM_ACCEL_EV_SIGNO
    int "Accelerator sensor signal for event"
    default 13

config EXAMPLES_SENSOR_TRAM_MAG_SIGNO
    int "Magnetometer sensor signal"
    default 12

config EXAMPLES_SENSOR_TRAM_PRESS_SIGNO
    int "Pressure sensor signal"
    default 11

config EXAMPLES_SENSOR_TRAM_TEMP_SIGNO
    int "Temperature sensor signal"
    default 10

config EXAMPLES_SENSOR_TRAM_DETAILED_INFO
    bool "Enable detailed information"
    default n
    select LIBC_FLOATINGPOINT
    ---help---
      Enable to get likelihood of all modes

endif
```

## examples/uart_bridge/Kconfig
```kconfig
config EXAMPLES_UART_BRIDGE
	tristate "UART Bridge Example"
	default n
	---help---
		Enable the uart_bridge app. This app is bridging data between UART0 and UART2.

if EXAMPLES_UART_BRIDGE

config EXAMPLES_UART_BRIDGE_PROGNAME
	string "Program name"
	default "uart_bridge"
	---help---
		This is the name of the program that will be use when the NSH ELF
		program is installed.

config EXAMPLES_UART_BRIDGE_PRIORITY
	int "uart_bridge task priority"
	default 100

config EXAMPLES_UART_BRIDGE_STACKSIZE
	int "uart_bridge stack size"
	default 2048

endif
```

## examples/voice_call/Kconfig
```kconfig
#
# For a description of the syntax of this configuration file,
# see the file kconfig-language.txt in the NuttX tools repository.
#

config EXAMPLES_VOICE_CALL
	bool "Voice call example"
	default n
	depends on CXD56_AUDIO
	---help---
		Enable the voice call example

if EXAMPLES_VOICE_CALL

config EXAMPLES_VOICE_CALL_PROGNAME
	string "Program name"
	default "voice_call"
	
config EXAMPLES_VOICE_CALL_PRIORITY
	int "voice_call task priority"
	default 100

config EXAMPLES_VOICE_CALL_STACKSIZE
	int "oice_call stack size"
	default 2048

endif
```

## examples/voice_command/Kconfig
```kconfig
#
# For a description of the syntax of this configuration file,
# see the file kconfig-language.txt in the NuttX tools repository.
#

config EXAMPLES_VOICE_COMMAND
	bool "Voice command example"
	default n
	depends on CXD56_AUDIO
	---help---
		Enable the voice command example

if EXAMPLES_VOICE_COMMAND

config EXAMPLES_VOICE_COMMAND_PROGNAME
	string "Program name"
	default "voice_command"

config EXAMPLES_VOICE_COMMAND_PRIORITY
	int "voice_command task priority"
	default 100

config EXAMPLES_VOICE_COMMAND_STACKSIZE
	int "voice_command stack size"
	default 2048

endif
```

## examples/websocket_bitbank/Kconfig
```kconfig
#
# For a description of the syntax of this configuration file,
# see the file kconfig-language.txt in the NuttX tools repository.
#

config EXAMPLES_WEBSOCKET_BITBANK
	tristate "WebSocket sample application using bitbank"
	default n
	depends on EXTERNALS_WEBSOCKET
	depends on LTE_NET_MBEDTLS || EXTERNALS_MBEDTLS
	---help---
		Enable the websocket sample application using bitbank

if EXAMPLES_WEBSOCKET_BITBANK

config EXAMPLES_WEBSOCKET_BITBANK_PROGNAME
	string "Program name"
	default "websocket_bitbank"
	---help---
		This is the name of the program that will be use when the NSH ELF
		program is installed.

config EXAMPLES_WEBSOCKET_BITBANK_PRIORITY
	int "websocket_bitbank task priority"
	default 100

config EXAMPLES_WEBSOCKET_BITBANK_STACKSIZE
	int "websocket_bitbank stack size"
	default 1024

config EXAMPLES_WEBSOCKET_BITBANK_ROOT_CA_FILE
	string "Root CA file for bitbank WebSocket API"
	default "/mnt/sd0/BaltimoreCyberTrustRoot.crt.pem"

config EXAMPLES_WEBSOCKET_BITBANK_TASK_PRIORITY
	int "websocket_bitbank websockt task priority"
	default 95

config EXAMPLES_WEBSOCKET_BITBANK_TASK_STACKSIZE
	int "websocket_bitbank websockt stack size"
	default 10240

endif
```

## examples/websocket_gmocoin/Kconfig
```kconfig
#
# For a description of the syntax of this configuration file,
# see the file kconfig-language.txt in the NuttX tools repository.
#

config EXAMPLES_WEBSOCKET_GMOCOIN
	tristate "WebSocket sample application using GMO coin"
	default n
	depends on EXTERNALS_WEBSOCKET
	depends on LTE_NET_MBEDTLS || EXTERNALS_MBEDTLS
	---help---
		Enable the websocket sample application using GMO coin

if EXAMPLES_WEBSOCKET_GMOCOIN

config EXAMPLES_WEBSOCKET_GMOCOIN_PROGNAME
	string "Program name"
	default "websocket_gmocoin"
	---help---
		This is the name of the program that will be use when the NSH ELF
		program is installed.

config EXAMPLES_WEBSOCKET_GMOCOIN_PRIORITY
	int "websocket_gmocoin task priority"
	default 100

config EXAMPLES_WEBSOCKET_GMOCOIN_STACKSIZE
	int "websocket_gmocoin stack size"
	default 1024

config EXAMPLES_WEBSOCKET_GMOCOIN_ROOT_CA_FILE
	string "Root CA file for GMO coin WebSocket API"
	default "/mnt/sd0/rootcacert_r3.cer"

config EXAMPLES_WEBSOCKET_GMOCOIN_TASK_PRIORITY
	int "websocket_gmocoin websockt task priority"
	default 95

config EXAMPLES_WEBSOCKET_GMOCOIN_TASK_STACKSIZE
	int "websocket_gmocoin websockt stack size"
	default 10240

endif
```

## examples/wget/Kconfig
```kconfig
config EXAMPLES_SPRESENSE_WGET
	tristate "wget app"
	default n
	select NSH_DISABLE_WGET
	---help---
		Enable the wget app with TLS

if EXAMPLES_SPRESENSE_WGET

config EXAMPLES_SPRESENSE_WGET_PROGNAME
	string "Program name"
	default "wget"
	---help---
		This is the name of the program that will be use when the NSH ELF
		program is installed.

config EXAMPLES_SPRESENSE_WGET_PRIORITY
	int "wget task priority"
	default 100

config EXAMPLES_SPRESENSE_WGET_STACKSIZE
	int "wget stack size"
	default 8192

config EXAMPLES_SPRESENSE_WGET_URL
  string "File URL"
  default ""
  ---help---
    The URL of the file to get

config EXAMPLES_SPRESENSE_WGET_NOMAC
  bool "Use Canned MAC Address"
  depends on !NSH_NETINIT
  default n

config EXAMPLES_SPRESENSE_WGET_IPADDR
  hex "Target IP address"
  default 0x0a000002

config EXAMPLES_SPRESENSE_WGET_DRIPADDR
  hex "Default Router IP address (Gateway)"
  default 0x0a000001

config EXAMPLES_SPRESENSE_WGET_NETMASK
  hex "Network Mask"
  default 0xffffff00

endif
```

## externals/ahrs/Kconfig
```kconfig
#
# For a description of the syntax of this configuration file,
# see the file kconfig-language.txt in the NuttX tools repository.
#

config EXTERNALS_XIO_AHRS
	bool "AHRS library from x-io"
	default n
	---help---
		Enable support AHRS library.
		This library is from https://x-io.co.uk/downloads/madgwick_algorithm_c.zip
```

## externals/awsiot/Kconfig
```kconfig
#
# For a description of the syntax of this configuration file,
# see the file kconfig-language.txt in the NuttX tools repository.
#

menuconfig EXTERNALS_AWSIOT
	bool "AWS IoT Device SDK for Embedded C"
	default n
	---help---
		Enable AWS IoT Device SDK for Embedded C.
		This SDK is provided from https://github.com/aws/aws-iot-device-sdk-embedded-c.git
		and licensed under the Apache License, Version 2.0.

if EXTERNALS_AWSIOT
menu "AWS-IoT console"
config EXTERNALS_AWSIOT_AWS_IOT_MQTT_HOST
	string "AWS_IOT_MQTT_HOST"
	default ""
	---help---
		Customer specific MQTT HOST. The same will be used for Thing Shadow.

config EXTERNALS_AWSIOT_AWS_IOT_MQTT_PORT
	int "AWS_IOT_MQTT_PORT"
	default 443
	---help---
		default port for MQTT/S.

config EXTERNALS_AWSIOT_AWS_IOT_MQTT_CLIENT_ID
	string "AWS_IOT_MQTT_CLIENT_ID"
	default "AWS-IoT-C-SDK"
	---help---
		MQTT client ID should be unique for every device.

config EXTERNALS_AWSIOT_AWS_IOT_MY_THING_NAME
	string "AWS_IOT_MY_THING_NAME"
	default "AWS-IoT-C-SDK"
	---help---
		Thing Name of the Shadow this device is associated with.

config EXTERNALS_AWSIOT_AWS_IOT_ROOT_CA_FILENAME
	string "AWS_IOT_ROOT_CA_FILENAME"
	default "rootCA.crt"
	---help---
		Root CA file name.
		This file can be downloaded from AWS-IoT console.

config EXTERNALS_AWSIOT_AWS_IOT_CERTIFICATE_FILENAME
	string "AWS_IOT_CERTIFICATE_FILENAME"
	default "cert.pem"
	---help---
		Device signed certificate file name.
		This file can be downloaded from AWS-IoT console.

config EXTERNALS_AWSIOT_AWS_IOT_PRIVATE_KEY_FILENAME
	string "AWS_IOT_PRIVATE_KEY_FILENAME"
	default "privkey.pem"
	---help---
		Device private key filename.
		This file can be downloaded from AWS-IoT console.

endmenu # AWS-IoT console


menu "MQTT layer"
config EXTERNALS_AWSIOT_AWS_IOT_MQTT_RX_BUF_LEN
	int "AWS_IOT_MQTT_RX_BUF_LEN"
	default 512
	---help---
		Any message that comes into the device should be less than this buffer size.
		If a received message is bigger than this buffer size the message will be dropped.


config EXTERNALS_AWSIOT_AWS_IOT_MQTT_TX_BUF_LEN
	int "AWS_IOT_MQTT_TX_BUF_LEN"
	default 512
	---help---
		Any time a message is sent out through the MQTT layer.
		The message is copied into this buffer anytime a publish is done.
		This will also be used in the case of Thing Shadow.

config EXTERNALS_AWSIOT_AWS_IOT_MQTT_NUM_SUBSCRIBE_HANDLERS
	int "AWS_IOT_MQTT_NUM_SUBSCRIBE_HANDLERS"
	default 5
	---help---
		Maximum number of topic filters the MQTT client can handle at any given time.
		This should be increased appropriately when using Thing Shadow.

endmenu # MQTT layer

menu "Thing Shadow and Job"
menu "Common for Thing Shadow and Job"
config EXTERNALS_AWSIOT_MAX_SIZE_OF_UNIQUE_CLIENT_ID_BYTES
	int "MAX_SIZE_OF_UNIQUE_CLIENT_ID_BYTES"
	default 80
	---help---
		Maximum size of the Unique Client Id. For More info on the Client Id refer \ref response "Acknowledgments".

config EXTERNALS_AWSIOT_MAX_SIZE_CLIENT_ID_WITH_SEQUENCE
	int "MAX_SIZE_CLIENT_ID_WITH_SEQUENCE"
	default 90
	---help---
		This is size of the extra sequence number that will be appended to the Unique client Id.

config EXTERNALS_AWSIOT_MAX_SIZE_CLIENT_TOKEN_CLIENT_SEQUENCE
	int "MAX_SIZE_CLIENT_TOKEN_CLIENT_SEQUENCE"
	default 100
	---help---
		This is size of the the total clientToken key and value pair in the JSON.


config EXTERNALS_AWSIOT_MAX_SIZE_OF_THING_NAME
	int "MAX_SIZE_OF_THING_NAME"
	default 30
	---help---
		The Thing Name should not be bigger than this value. Modify this if the Thing Name needs to be bigger.
endmenu # Common for Thing Shadow and Job

menu "Thing Shadow specific"
config EXTERNALS_AWSIOT_SHADOW_MAX_SIZE_OF_RX_BUFFER
	int "SHADOW_MAX_SIZE_OF_RX_BUFFER"
	default 512
	---help---
		Maximum size of the SHADOW buffer to store the received Shadow message.

config EXTERNALS_AWSIOT_MAX_ACKS_TO_COMEIN_AT_ANY_GIVEN_TIME
	int "MAX_ACKS_TO_COMEIN_AT_ANY_GIVEN_TIME"
	default 10
	---help---
		At Any given time we will wait for this many responses.
		 This will correlate to the rate at which the shadow actions are requested.

config EXTERNALS_AWSIOT_MAX_THINGNAME_HANDLED_AT_ANY_GIVEN_TIME
	int "MAX_THINGNAME_HANDLED_AT_ANY_GIVEN_TIME"
	default 10
	---help---
		We could perform shadow action on any thing Name and this is maximum Thing Names we can act on at any given time.

config EXTERNALS_AWSIOT_MAX_JSON_TOKEN_EXPECTED
	int "MAX_JSON_TOKEN_EXPECTED"
	default 120
	---help---
		These are the max tokens that is expected to be in the Shadow JSON document. Include the metadata that gets published.

config EXTERNALS_AWSIOT_MAX_SHADOW_TOPIC_LENGTH_WITHOUT_THINGNAME
	int "MAX_SHADOW_TOPIC_LENGTH_WITHOUT_THINGNAME"
	default 60
	---help---
		All shadow actions have to be published or subscribed to a topic which is of the format $aws/things/{thingName}/shadow/update/accepted.
		This refers to the size of the topic without the Thing Name

config EXTERNALS_AWSIOT_MAX_SHADOW_TOPIC_LENGTH_BYTES
	int "MAX_SHADOW_TOPIC_LENGTH_BYTES"
	default 180
	---help---
		This size includes the length of topic with Thing Name.

endmenu # Thing Shadow specific

menu "Job specific"
config EXTERNALS_AWSIOT_DISABLE_IOT_JOBS
	bool "DISABLE_IOT_JOBS"
	default n
	---help---
		Disable AWS-IoT jobs.

if !EXTERNALS_AWSIOT_DISABLE_IOT_JOBS
config EXTERNALS_AWSIOT_MAX_SIZE_OF_JOB_ID
	int "MAX_SIZE_OF_JOB_ID"
	default 64
	---help---
		Max size of job id.

config EXTERNALS_AWSIOT_MAX_JOB_JSON_TOKEN_EXPECTED
	int "MAX_JOB_JSON_TOKEN_EXPECTED"
	default 120
	---help---
		These are the max tokens that is expected to be in the Job JSON document.

config EXTERNALS_AWSIOT_MAX_SIZE_OF_JOB_REQUEST
	int "MAX_SIZE_OF_JOB_REQUEST"
	default 512
	---help---
		Max size of Job request.

config EXTERNALS_AWSIOT_MAX_JOB_TOPIC_LENGTH_WITHOUT_JOB_ID_OR_THING_NAME
	int "MAX_JOB_TOPIC_LENGTH_WITHOUT_JOB_ID_OR_THING_NAME"
	default 40
	---help---
		Max length of Job topic without Job Id/Thing name.

config EXTERNALS_AWSIOT_MAX_JOB_TOPIC_LENGTH_BYTES
	int "MAX_JOB_TOPIC_LENGTH_BYTES"
	default 96
	---help---
		Max length of Job topic.

endif # !EXTERNALS_AWSIOT_DISABLE_IOT_JOBS
endmenu # Job specific
endmenu # Thing Shadow and Job

menu "Auto Reconnect"
config EXTERNALS_AWSIOT_AWS_IOT_MQTT_MIN_RECONNECT_WAIT_INTERVAL
	int "AWS_IOT_MQTT_MIN_RECONNECT_WAIT_INTERVAL"
	default 1000
	---help---
		Minimum time before the First reconnect attempt is made as part of the exponential back-off algorithm.

config EXTERNALS_AWSIOT_AWS_IOT_MQTT_MAX_RECONNECT_WAIT_INTERVAL
	int "AWS_IOT_MQTT_MAX_RECONNECT_WAIT_INTERVAL"
	default 128000
	---help---
		Maximum time interval after which exponential back-off will stop attempting to reconnect.
endmenu # Auto Reconnect

menu "Metrics"
config EXTERNALS_AWSIOT_DISABLE_METRICS
	bool "DISABLE_METRICS"
	default	n
	---help---
		Disable the collection of metrics by setting this to true.
endmenu # Metrics

menu "Debug"
config EXTERNALS_AWSIOT_ENABLE_IOT_DEBUG
	bool "ENABLE_IOT_DEBUG"
	default n
	---help---
		Enable IOT_DEBUG macro.

config EXTERNALS_AWSIOT_ENABLE_IOT_TRACE
        bool "ENABLE_IOT_TRACE"
        default n
        ---help---
                Enable FUNC_ENTRY, FUNC_EXIT, and FINC_EXIT_RC macros.

config EXTERNALS_AWSIOT_ENABLE_IOT_INFO
        bool "ENABLE_IOT_INFO"
        default n
        ---help---
                Enable IOT_INFO macro.

config EXTERNALS_AWSIOT_ENABLE_IOT_WARN
        bool "ENABLE_IOT_WARN"
        default n
        ---help---
                Enable IOT_WARN macro.

config EXTERNALS_AWSIOT_ENABLE_IOT_ERROR
        bool "ENABLE_IOT_ERROR"
        default n
        ---help---
                Enable IOT_ERROR macro.


endmenu # Debug
endif # EXTERNALS_AWSIOT
```
