/****************************************************************************
 * examples/tlstest/ssl_sub.c
 *
 *   Copyright 2018 Sony Corporation
 *
 * Redistribution and use in source and binary forms, with or without
 * modification, are permitted provided that the following conditions
 * are met:
 *
 * 1. Redistributions of source code must retain the above copyright
 *    notice, this list of conditions and the following disclaimer.
 * 2. Redistributions in binary form must reproduce the above copyright
 *    notice, this list of conditions and the following disclaimer in
 *    the documentation and/or other materials provided with the
 *    distribution.
 * 3. Neither the name NuttX nor Sony nor the names of its contributors
 *    may be used to endorse or promote products derived from this software
 *    without specific prior written permission.
 *
 * THIS SOFTWARE IS PROVIDED BY THE COPYRIGHT HOLDERS AND CONTRIBUTORS
 * "AS IS" AND ANY EXPRESS OR IMPLIED WARRANTIES, INCLUDING, BUT NOT
 * LIMITED TO, THE IMPLIED WARRANTIES OF MERCHANTABILITY AND FITNESS
 * FOR A PARTICULAR PURPOSE ARE DISCLAIMED. IN NO EVENT SHALL THE
 * COPYRIGHT OWNER OR CONTRIBUTORS BE LIABLE FOR ANY DIRECT, INDIRECT,
 * INCIDENTAL, SPECIAL, EXEMPLARY, OR CONSEQUENTIAL DAMAGES (INCLUDING,
 * BUT NOT LIMITED TO, PROCUREMENT OF SUBSTITUTE GOODS OR SERVICES; LOSS
 * OF USE, DATA, OR PROFITS; OR BUSINESS INTERRUPTION) HOWEVER CAUSED
 * AND ON ANY THEORY OF LIABILITY, WHETHER IN CONTRACT, STRICT
 * LIABILITY, OR TORT (INCLUDING NEGLIGENCE OR OTHERWISE) ARISING IN
 * ANY WAY OUT OF THE USE OF THIS SOFTWARE, EVEN IF ADVISED OF THE
 * POSSIBILITY OF SUCH DAMAGE.
 *
 ****************************************************************************/

/****************************************************************************
 * Included Files
 ****************************************************************************/

#include <stdio.h>
#include <string.h>
#include <errno.h>

#include <mbedtls/config.h>
#include <mbedtls/ctr_drbg.h>
#include <mbedtls/entropy.h>
#include <mbedtls/net.h>
#include <mbedtls/x509_crt.h>
#include <mbedtls/platform.h>
#include <mbedtls/ssl.h>

#include "ssl_sub.h"


/****************************************************************************
 * Pre-processor Definitions
 ****************************************************************************/

#define TLS_MAX_SOCKETS     4
#define TLS_MAX_SESSIONS    6
#define TLS_RANDOM_SEED     "MBEDTLS_SSL_RANDOM_SEED"
#define TLS_READ_TIMEOUT    10000
#define TLS_CRTINFO_BUFSIZE 1024

/****************************************************************************
 * Private Types
 ****************************************************************************/

typedef struct
  {
    int tcp_socket;
    mbedtls_ssl_context *tls_context;
    mbedtls_net_context tls_net_context;
  } tls_socket_t;

typedef struct
  {
    mbedtls_ssl_session *session;
    char *host;
  } tls_session_t;

typedef struct
  {
    const unsigned char *cert_data;
    size_t cert_size;
  } rootca_cert_t;

/****************************************************************************
 * Private Data
 ****************************************************************************/

static int ssl_status = 0;
static mbedtls_entropy_context ssl_entropy;
static mbedtls_ctr_drbg_context ssl_ctr_drbg;
static mbedtls_ssl_config ssl_conf;
static mbedtls_x509_crt ssl_ca;
//static mbedtls_x509_crt ssl_cli;
static mbedtls_pk_context ssl_pkey;
//static mbedtls_x509_crl ssl_crl;
static tls_socket_t ssl_sockets[TLS_MAX_SOCKETS];
static tls_session_t ssl_sessions[TLS_MAX_SESSIONS];
static int cache_enabled = 1;

/* subject:/C=US/O=GeoTrust Inc./CN=GeoTrust Global CA */
/* issuer :/C=US/O=GeoTrust Inc./CN=GeoTrust Global CA */
static const unsigned char GeoTrustGlobalCA_certificate[856]={
0x30,0x82,0x03,0x54,0x30,0x82,0x02,0x3C,0xA0,0x03,0x02,0x01,0x02,0x02,0x03,0x02,
0x34,0x56,0x30,0x0D,0x06,0x09,0x2A,0x86,0x48,0x86,0xF7,0x0D,0x01,0x01,0x05,0x05,
0x00,0x30,0x42,0x31,0x0B,0x30,0x09,0x06,0x03,0x55,0x04,0x06,0x13,0x02,0x55,0x53,
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0xC2,0x05,0x66,0x80,0xA1,0xCB,0xE6,0x33,
};

/* subject:/C=BE/O=GlobalSign nv-sa/OU=Root CA/CN=GlobalSign Root CA */
/* issuer :/C=BE/O=GlobalSign nv-sa/OU=Root CA/CN=GlobalSign Root CA */
static const unsigned char GlobalSignRootCA_certificate[889]={
0x30,0x82,0x03,0x75,0x30,0x82,0x02,0x5D,0xA0,0x03,0x02,0x01,0x02,0x02,0x0B,0x04,
0x00,0x00,0x00,0x00,0x01,0x15,0x4B,0x5A,0xC3,0x94,0x30,0x0D,0x06,0x09,0x2A,0x86,
0x48,0x86,0xF7,0x0D,0x01,0x01,0x05,0x05,0x00,0x30,0x57,0x31,0x0B,0x30,0x09,0x06,
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0x55,0xE2,0xFC,0x48,0xC9,0x29,0x26,0x69,0xE0,
};

static size_t num_rootca_certs = 2;

static const rootca_cert_t rootca_certs[] =
  {
    {GeoTrustGlobalCA_certificate, 856},
    {GlobalSignRootCA_certificate, 889},
  };


/****************************************************************************
 * Private Functions
 ****************************************************************************/

static size_t rootca_number_of_certificates(void)
{
  return num_rootca_certs;
}

static const unsigned char *rootca_get_certificate(size_t index)
{
  if (index >= num_rootca_certs)
    {
      return NULL;
    }
  return rootca_certs[index].cert_data;
}

static size_t rootca_get_certificate_size(size_t index)
{
  if (index >= num_rootca_certs)
    {
      return 0;
    }
  return rootca_certs[index].cert_size;
}


static mbedtls_ssl_session *tls_session_find(const char *host)
{
  if (cache_enabled)
    {
      for (size_t i = 0; i < TLS_MAX_SESSIONS; i++)
        {
          if ((ssl_sessions[i].session != NULL)
              && (strncmp(host, ssl_sessions[i].host, strlen(host)) == 0))
            {
              printf("tls_session_find : [%d]\n", i);
              return ssl_sessions[i].session;
            }
        }
    }
  return NULL;
}

static void tls_session_update(mbedtls_ssl_context *ctx, const char *host)
{
  int idx = -1;

  if (!cache_enabled)
    {
      return;
    }

  // Find an empty slot or a matching entry
  for (size_t i = 0; i < TLS_MAX_SESSIONS; i++)
    {
      if (ssl_sessions[i].session == NULL)
        {
          if (idx < 0)
            {
              idx = i;
            }
        }
      else if (strncmp(host, ssl_sessions[i].host, strlen(host)) == 0)
        {
          idx = i;
          break;
        }
    }
  if (idx < 0)
    {
      // Table is full, and no entry matches. Delete the oldest entry (at index 0).
      mbedtls_ssl_session_free(ssl_sessions[0].session);
      free(ssl_sessions[0].session);
      free(ssl_sessions[0].host);
      for (size_t i = 0; i < TLS_MAX_SESSIONS - 1; i++)
        {
          memmove(&ssl_sessions[i], &ssl_sessions[i+1], sizeof(tls_session_t));
        }
      idx = TLS_MAX_SESSIONS - 1;
      ssl_sessions[idx].session = NULL;
      ssl_sessions[idx].host = NULL;
    }

  if (ssl_sessions[idx].session == NULL)
    {
      ssl_sessions[idx].session = calloc(1, sizeof(mbedtls_ssl_session));
    }
  else
    {
      mbedtls_ssl_session_free(ssl_sessions[idx].session);
    }
  mbedtls_ssl_session_init(ssl_sessions[idx].session);

  if (ssl_sessions[idx].host == NULL)
    {
      ssl_sessions[idx].host = calloc(1, strlen(host));
      strncpy(ssl_sessions[idx].host, host, strlen(host));
    }

  if (mbedtls_ssl_get_session(ctx, ssl_sessions[idx].session))
    {
      mbedtls_ssl_session_free(ssl_sessions[idx].session);
      free(ssl_sessions[idx].session);
      ssl_sessions[idx].session = NULL;
      free(ssl_sessions[idx].host);
      ssl_sessions[idx].host = NULL;
      return;
  }

  printf("tls_session_update : [%d]\n", idx);
}

static int ssl_verify_cert(void *data, mbedtls_x509_crt *crt, int depth, uint32_t *flags)
{
  int ret;
  char buf[TLS_CRTINFO_BUFSIZE];

  printf("Verify requested for depth %d\n", depth);
  memset(buf, 0, TLS_CRTINFO_BUFSIZE);
  ret = mbedtls_x509_crt_info(buf, TLS_CRTINFO_BUFSIZE, "", crt);
  printf("CrtInfo [%d bytes] :\n", ret);
  printf("%s", buf);

  if ((*flags) == 0)
    {
      printf("This certificate has no flags\n");
    }
  else
    {
      printf("This certificate has flags : %d\n", *flags);
    }

  return 0;
}

/****************************************************************************
 * Public Functions
 ****************************************************************************/

void ssl_init(const char** cafile, int verify)
{
  int ret;
  size_t cnt;

  if (ssl_status)
    {
      return;
    }    

  // Initialize
  mbedtls_ctr_drbg_init(&ssl_ctr_drbg);
  mbedtls_ssl_config_init(&ssl_conf);
  mbedtls_entropy_init(&ssl_entropy);
  mbedtls_x509_crt_init(&ssl_ca);
//  mbedtls_x509_crt_init(&ssl_cli);
  mbedtls_pk_init(&ssl_pkey);
//  mbedtls_x509_crl_init(&ssl_crl);

  for (cnt=0; cnt<TLS_MAX_SOCKETS; cnt++)
    {
      ssl_sockets[cnt].tcp_socket = -1;
      ssl_sockets[cnt].tls_context = NULL;
      ssl_sockets[cnt].tls_net_context.fd = -1;
    }
  for (cnt=0; cnt<TLS_MAX_SESSIONS; cnt++)
    {
      ssl_sessions[cnt].session = NULL;
      ssl_sessions[cnt].host = NULL;
    }

  // Set up for random bits generation
  if ((ret = mbedtls_ctr_drbg_seed(&ssl_ctr_drbg, NULL, &ssl_entropy,
       (const unsigned char*)TLS_RANDOM_SEED, strlen(TLS_RANDOM_SEED))) != 0)
    {
      printf("mbedtls_ctr_drbg_seed error : -0x%x\n", -ret);
      ssl_fin();
      return;
    }
  mbedtls_ssl_conf_rng(&ssl_conf, NULL, &ssl_ctr_drbg);

  // General configuration
  printf("mbedtls_ssl_config_defaults : CLIENT = %d\n", MBEDTLS_SSL_IS_CLIENT);
  if ((ret = mbedtls_ssl_config_defaults(&ssl_conf, MBEDTLS_SSL_IS_CLIENT,
       MBEDTLS_SSL_TRANSPORT_STREAM, MBEDTLS_SSL_PRESET_DEFAULT)) != 0)
    {
      printf("mbedtls_ssl_config_defaults error : -0x%x\n", -ret);
      ssl_fin();
      return;
    }

  // Install the root certificate(s), and set up for server authentication
  if (cafile == NULL)
    {
      for (cnt=0; cnt<rootca_number_of_certificates(); cnt++)
        {
          if ((ret = mbedtls_x509_crt_parse_der(&ssl_ca, rootca_get_certificate(cnt),
               rootca_get_certificate_size(cnt))) != 0)
            {
              printf("mbedtls_x509_crt_parse_der error : -0x%x\n", -ret);
              ssl_fin();
              return;
            }
        }
    }
  else
    {
      while (*cafile != NULL)
        {
          printf("mbedtls root certificate : add [%s]\n", *cafile);
          if ((ret = mbedtls_x509_crt_parse_file(&ssl_ca, *cafile)) != 0)
            {
              printf("mbedtls_x509_crt_parse_file error : -0x%x\n", -ret);
              ssl_fin();
              return;
            }
          cafile++;
        }
    }
  mbedtls_ssl_conf_ca_chain(&ssl_conf, &ssl_ca, NULL);

  switch (verify)
    {
      case TLSTEST_SSL_VERIFY_REQUIRED:
        {
          mbedtls_ssl_conf_authmode(&ssl_conf, MBEDTLS_SSL_VERIFY_REQUIRED);
          break;
        }
      case TLSTEST_SSL_VERIFY_CALLBACK:
        {
          mbedtls_ssl_conf_authmode(&ssl_conf, MBEDTLS_SSL_VERIFY_OPTIONAL);
          mbedtls_ssl_conf_verify(&ssl_conf, ssl_verify_cert, NULL);
          break;
        }
      default:
        {
          mbedtls_ssl_conf_authmode(&ssl_conf, MBEDTLS_SSL_VERIFY_NONE);
          break;
        }
    }

  // Set timeout
  mbedtls_ssl_conf_read_timeout(&ssl_conf, TLS_READ_TIMEOUT);

  printf("ssl_init : success\n");
  ssl_status = 1;
  return;
}


void ssl_fin()
{
  size_t cnt;

  for (cnt=0; cnt<TLS_MAX_SOCKETS; cnt++)
    {
      if (ssl_sockets[cnt].tcp_socket >= 0)
        {
          printf("ssl_fin socket released : [%d]\n", cnt);
          ssl_disconnect(cnt);
        }
    }
  for (cnt=0; cnt<TLS_MAX_SESSIONS; cnt++)
    {
      if (ssl_sessions[cnt].session != NULL)
        {
          mbedtls_ssl_session_free(ssl_sessions[cnt].session);
          free(ssl_sessions[cnt].session);
          ssl_sessions[cnt].session = NULL;
          printf("ssl_fin session released : [%d]\n", cnt);
        }
      if (ssl_sessions[cnt].host != NULL)
        {
          free(ssl_sessions[cnt].host);
          ssl_sessions[cnt].host = NULL;
        }
    }

  mbedtls_ssl_config_free(&ssl_conf);
  mbedtls_ctr_drbg_free(&ssl_ctr_drbg);
  mbedtls_entropy_free(&ssl_entropy);
  mbedtls_x509_crt_free(&ssl_ca);
//  mbedtls_x509_crt_free(&ssl_cli);
  mbedtls_pk_free(&ssl_pkey);
//  mbedtls_x509_crl_free(&ssl_crl);

  ssl_status = 0;

  printf("ssl_fin : success\n");
  return;
}


int ssl_disconnect(int sock)
{
  int ret;

  if ((sock < 0) || (sock >= TLS_MAX_SOCKETS) || (ssl_sockets[sock].tcp_socket < 0))
    {
      return -EPERM;
    }
  tls_socket_t *socket = &ssl_sockets[sock];

  if (socket->tls_context != NULL)
    {
      do
        {
          ret = mbedtls_ssl_close_notify(socket->tls_context);
        } while (ret == MBEDTLS_ERR_SSL_WANT_WRITE);

      mbedtls_net_free(&socket->tls_net_context);
      mbedtls_ssl_free(socket->tls_context);
      free(socket->tls_context);
      socket->tls_context = NULL;
      socket->tcp_socket = -1;
    }

  printf("ssl_disconnect [%d] success\n", sock);
  return 0;
}


int ssl_connect(int tcp, const char *host, const char *port, int *sock)
{
  int ret;
  int cnt;
  tls_socket_t *socket = NULL;

  for (cnt=0; cnt<TLS_MAX_SOCKETS; cnt++)
    {
      socket = &ssl_sockets[cnt];
      if (socket->tcp_socket < 0)
        {
          break;
        }
    }
  if (cnt >= TLS_MAX_SOCKETS)
    {
      printf("No more socket is available.\n");
      return -ENFILE;
    }

  mbedtls_ssl_context *tls_context = calloc(1, sizeof(mbedtls_ssl_context));
  if (tls_context == NULL)
    {
      printf("No more memory is available.\n");
      return -ENOMEM;
    }

  mbedtls_ssl_init(tls_context);
  if ((ret = mbedtls_ssl_setup(tls_context, &ssl_conf)) != 0)
    {
      printf("mbedtls_ssl_setup error : -0x%x\n", -ret);
      mbedtls_ssl_free(tls_context);
      free(tls_context);
      return ret;
    }

  if ((ret = mbedtls_net_connect(&socket->tls_net_context, host, port, tcp)) != 0)
    {
      printf("mbedtls_net_connect error : -0x%x\n", -ret);
      mbedtls_net_free(&socket->tls_net_context);
      mbedtls_ssl_free(tls_context);
      free(tls_context);
      return ret;
    }
  socket->tls_context = tls_context;
  socket->tcp_socket = socket->tls_net_context.fd;

  if ((ret = mbedtls_ssl_set_hostname(tls_context, host)) != 0)
    {
      printf("mbedtls_ssl_set_hostname error : -0x%x\n", -ret);
      ssl_disconnect(cnt);
      return ret;
    }
  mbedtls_ssl_set_bio(tls_context, &socket->tls_net_context, NULL, NULL, NULL);

  mbedtls_ssl_session *session = tls_session_find(host);
  if (session != NULL)
    {
      mbedtls_ssl_set_session(tls_context, session);
    }
  while ((ret = mbedtls_ssl_handshake(tls_context)) != 0)
    {
      if ((ret != MBEDTLS_ERR_SSL_WANT_READ) && (ret != MBEDTLS_ERR_SSL_WANT_WRITE))
        {
          printf("mbedtls_ssl_handshake error : -0x%x\n", -ret);
          ssl_disconnect(cnt);
          return ret;
        }
    }

  if ((ret = mbedtls_ssl_get_verify_result(tls_context)) != 0)
    {
      printf("mbedtls_ssl_get_verify_result error : -0x%x\n", -ret);
      ssl_disconnect(cnt);
      return ret;
    }

  tls_session_update(tls_context, host);

  printf("ssl_connect [%d/%d] success\n", cnt, socket->tcp_socket);
  *sock = cnt;

  return 0;
}


int ssl_recv(int sock, char *buf, size_t len)
{
  if ((sock < 0 || (sock >= TLS_MAX_SOCKETS)
                || (ssl_sockets[sock].tcp_socket < 0)
                || ssl_sockets[sock].tls_context == NULL))
    {
      return -EPERM;
    }
  return mbedtls_ssl_read(ssl_sockets[sock].tls_context, (unsigned char *)buf, len);
}


int ssl_send(int sock, const char *buf, size_t len)
{
  if ((sock < 0 || (sock >= TLS_MAX_SOCKETS)
                || (ssl_sockets[sock].tcp_socket < 0)
                || ssl_sockets[sock].tls_context == NULL))
    {
      return -EPERM;
    }
  return mbedtls_ssl_write(ssl_sockets[sock].tls_context, (unsigned char *)buf, len);
}


int ssl_sendrecv(int sock, int get, const char* host, const char* path, const char* data)
{
  int ret;
  int total = 0;
  char buf[TLSTEST_SSL_BUFFER_SIZE];

  if ((sock < 0 || (sock >= TLS_MAX_SOCKETS)
                || (ssl_sockets[sock].tcp_socket < 0)
                || ssl_sockets[sock].tls_context == NULL))
    {
      printf("ssl_sendrecv : illegal argument\n");
      return -EPERM;
    }

  /* Send and return code check */
  if (get == TLSTEST_SSL_GET)
    {
      snprintf(buf, TLSTEST_SSL_BUFFER_SIZE,
               "GET %s HTTP/1.0\r\nHOST: %s\r\nConnection: close\r\n\r\n",
               path, host);
      printf("Network send (GET) : %s\n", host);
    }
  else if (get == TLSTEST_SSL_POST)
    {
      snprintf(buf, TLSTEST_SSL_BUFFER_SIZE,
               "POST %s HTTP/1.0\r\nHOST: %s\r\nConnection: close\r\nContent-Length: %d\r\n\r\n",
               path, host, strlen(data));
      strncat(buf, data, TLSTEST_SSL_BUFFER_SIZE);
      strncat(buf, "\r\n", TLSTEST_SSL_BUFFER_SIZE);
      printf("Network send (POST) : %s\n", host);
    }
  else if (get == TLSTEST_SSL_HEAD)
    {
      snprintf(buf, TLSTEST_SSL_BUFFER_SIZE,
               "HEAD %s HTTP/1.0\r\nHOST: %s\r\nConnection: close\r\n\r\n",
               path, host);
      printf("Network send (HEAD) : %s\n", host);
    }
  else {
      printf("ssl_sendrecv : illegal argument\n");
      return -EPERM;
  }

  ret = ssl_send(sock, buf, strlen(buf));
  if (ret < 0)
    {
      printf("ssl_send error : -0x%x\n", -ret);
      return ret;
    }

  while (1)
    {
      memset(buf, 0, TLSTEST_SSL_BUFFER_SIZE);
      ret = ssl_recv(sock, buf, TLSTEST_SSL_BUFFER_SIZE);
      if (ret < 0)
        {
          if (ret == MBEDTLS_ERR_SSL_PEER_CLOSE_NOTIFY)
//          if ((ret == MBEDTLS_ERR_SSL_PEER_CLOSE_NOTIFY) || (ret == MBEDTLS_ERR_SSL_BAD_INPUT_DATA))
            {
              break;
            }
          if ((ret == MBEDTLS_ERR_SSL_WANT_READ) || (ret == MBEDTLS_ERR_SSL_WANT_WRITE))
            {
              continue;
            }
          printf("ssl_recv error : -0x%x\n", -ret);
          return ret;
        }
      if (ret == 0)
        {
          break;
        }
//      printf("%s", buf);
      total += ret;
    }

  return total;
}


